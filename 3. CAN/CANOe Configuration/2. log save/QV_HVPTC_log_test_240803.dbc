VERSION ""

NS_ :

BS_:

BU_: L_3HKBD L_FHPTC L_ATCU L_2HKBD L_PCM L_HKBD L_RHPTC

BO_ 3221225472 VECTOR__INDEPENDENT_SIG_MSG: 0 Vector__XXX
 SG_ Test_SaveIdx : 0|8@1- (1,0) [0|0] "" Vector__XXX
 SG_ HKBD_Fr_DrTempDnSw : 0|1@1+ (1,0) [0|0] "" Vector__XXX
 SG_ HKBD_Fr_DrTempUpSw : 0|1@1+ (1,0) [0|0] "" Vector__XXX
 SG_ HKBD_Fr_PsBlwDnSw : 0|1@1+ (1,0) [0|0] "" Vector__XXX
 SG_ HKBD_Fr_PsBlwDnOffSw : 0|1@1+ (1,0) [0|0] "" Vector__XXX
 SG_ HKBD_Fr_PsBlwUpSw : 0|1@1+ (1,0) [0|0] "" Vector__XXX
 SG_ HKBD_Fr_PsBlwSet : 0|4@1+ (1,0) [0|0] "" Vector__XXX
 SG_ HKBD_Fr_RrDrTempDnSw : 0|1@1+ (1,0) [0|0] "" Vector__XXX
 SG_ HKBD_Fr_RrDrTempUpSw : 0|1@1+ (1,0) [0|0] "" Vector__XXX
 SG_ HKBD_Fr_PsTempDnSw : 0|1@1+ (1,0) [0|0] "" Vector__XXX
 SG_ HKBD_Fr_RrDrBlwDnSw : 0|1@1+ (1,0) [0|0] "" Vector__XXX
 SG_ HKBD_Fr_RrDrBlwDnOffSw : 0|1@1+ (1,0) [0|0] "" Vector__XXX
 SG_ HKBD_Fr_RrDrBlwUpSw : 0|1@1+ (1,0) [0|0] "" Vector__XXX
 SG_ HKBD_Fr_RrDrBlwSet : 0|4@1+ (1,0) [0|0] "" Vector__XXX
 SG_ HKBD_Fr_RrDrModDnSw : 0|1@1+ (1,0) [0|0] "" Vector__XXX
 SG_ HKBD_Fr_RrDrModUpSw : 0|1@1+ (1,0) [0|0] "" Vector__XXX
 SG_ HKBD_Fr_RrDrModVntSw : 0|1@1+ (1,0) [0|0] "" Vector__XXX
 SG_ HKBD_Fr_PsTempUpSw : 0|1@1+ (1,0) [0|0] "" Vector__XXX
 SG_ HKBD_Fr_RrDrModFlrSw : 0|1@1+ (1,0) [0|0] "" Vector__XXX
 SG_ HKBD_Fr_RrDrModBiLvlSw : 0|1@1+ (1,0) [0|0] "" Vector__XXX
 SG_ HKBD_Fr_RrDrAutoSw : 0|1@1+ (1,0) [0|0] "" Vector__XXX
 SG_ HKBD_Fr_RrDrMultiAutoSw : 0|3@1+ (1,0) [0|0] "" Vector__XXX
 SG_ HKBD_Fr_RrOffSw : 0|1@1+ (1,0) [0|0] "" Vector__XXX
 SG_ HKBD_Fr_RrSyncSw : 0|1@1+ (1,0) [0|0] "" Vector__XXX
 SG_ HKBD_Fr_RLStHeatSw : 0|1@1+ (1,0) [0|0] "" Vector__XXX
 SG_ HKBD_Fr_RLStVentSw : 0|1@1+ (1,0) [0|0] "" Vector__XXX
 SG_ HKBD_Fr_DrBlwDnSw : 0|1@1+ (1,0) [0|0] "" Vector__XXX
 SG_ HKBD_Fr_RRStHeatSw : 0|1@1+ (1,0) [0|0] "" Vector__XXX
 SG_ HKBD_Fr_RRStVentSw : 0|1@1+ (1,0) [0|0] "" Vector__XXX
 SG_ HKBD_Fr_RLStTumblrSw : 0|2@1+ (1,0) [0|0] "" Vector__XXX
 SG_ HKBD_Fr_RRStTumblrSw : 0|2@1+ (1,0) [0|0] "" Vector__XXX
 SG_ HKBD_Fr_RrPsModDnSw : 0|1@1+ (1,0) [0|0] "" Vector__XXX
 SG_ HKBD_Fr_RrPsModUpSw : 0|1@1+ (1,0) [0|0] "" Vector__XXX
 SG_ HKBD_Fr_RrPsModVntSw : 0|1@1+ (1,0) [0|0] "" Vector__XXX
 SG_ HKBD_Fr_RrPsModFlrSw : 0|1@1+ (1,0) [0|0] "" Vector__XXX
 SG_ HKBD_Fr_DrBlwDnOffSw : 0|1@1+ (1,0) [0|0] "" Vector__XXX
 SG_ HKBD_Fr_RrLockSw : 0|1@1+ (1,0) [0|0] "" Vector__XXX
 SG_ HKBD_Fr_RrPsModBiLvlSw : 0|1@1+ (1,0) [0|0] "" Vector__XXX
 SG_ HKBD_Fr_RrDrModSw : 0|1@1+ (1,0) [0|0] "" Vector__XXX
 SG_ HKBD_Fr_RrPsModSw : 0|1@1+ (1,0) [0|0] "" Vector__XXX
 SG_ HKBD_Fr_RrPsBlwSet : 0|4@1+ (1,0) [0|0] "" Vector__XXX
 SG_ HKBD_Fr_RrPsBlwUpSw : 0|1@1+ (1,0) [0|0] "" Vector__XXX
 SG_ HKBD_Fr_RrPsBlwDnSw : 0|1@1+ (1,0) [0|0] "" Vector__XXX
 SG_ HKBD_Fr_DrBlwUpSw : 0|1@1+ (1,0) [0|0] "" Vector__XXX
 SG_ HKBD_Fr_RrPsBlwDnOffSw : 0|1@1+ (1,0) [0|0] "" Vector__XXX
 SG_ HKBD_Fr_RrPsTempDnSw : 0|1@1+ (1,0) [0|0] "" Vector__XXX
 SG_ HKBD_Fr_RrPsTempUpSw : 0|1@1+ (1,0) [0|0] "" Vector__XXX
 SG_ HKBD_Fr_DrBlwSet : 0|4@1+ (1,0) [0|0] "" Vector__XXX
 SG_ L_ATCU_PCMActTgtPos : 0|4@1+ (1,0) [0|0] "" Vector__XXX
 SG_ L_ATCU_VehPowerIGN2 : 0|1@1+ (1,0) [0|0] "" Vector__XXX
 SG_ L_ATCU_VehPowerISGB : 0|1@1+ (1,0) [0|0] "" Vector__XXX
 SG_ L_ATCU_Blwr1TgtSpd : 0|4@1+ (1,0) [0|0] "" Vector__XXX
 SG_ L_ATCU_Blwr2TgtSpd : 0|4@1+ (1,0) [0|0] "" Vector__XXX
 SG_ L_ATCU_CurrentDy : 0|8@1+ (1,0) [0|0] "" Vector__XXX
 SG_ L_ATCU_CurrentMon : 0|4@1+ (1,0) [0|0] "" Vector__XXX
 SG_ L_ATCU_CurrentYrPre : 0|3@1+ (1,0) [0|0] "" Vector__XXX
 SG_ L_ATCU_CurrentYrPost : 0|8@1+ (1,0) [0|0] "" Vector__XXX
 SG_ L_ATCU_PCMActTgtSpd : 0|4@1+ (0.5,0) [0|0] "RPM" Vector__XXX
 SG_ L_ATCU_VehPowerBatt : 0|1@1+ (1,0) [0|0] "" Vector__XXX
 SG_ L_ATCU_VehPowerIGN1_3 : 0|1@1+ (1,0) [0|0] "" Vector__XXX
 SG_ HKBD_Fr_3rdRrTempDnSw : 0|1@1+ (1,0) [0|0] "" Vector__XXX
 SG_ HKBD_Fr_3rdRrTempUpSw : 0|1@1+ (1,0) [0|0] "" Vector__XXX
 SG_ HKBD_Fr_3rdRrModUpSw : 0|1@1+ (1,0) [0|0] "" Vector__XXX
 SG_ HKBD_Fr_3rdRrModVntSw : 0|1@1+ (1,0) [0|0] "" Vector__XXX
 SG_ HKBD_Fr_3rdRrModFlrSw : 0|1@1+ (1,0) [0|0] "" Vector__XXX
 SG_ HKBD_Fr_3rdRrAutoSw : 0|1@1+ (1,0) [0|0] "" Vector__XXX
 SG_ HKBD_Fr_3rdRrMultiAutoSw : 0|3@1+ (1,0) [0|0] "" Vector__XXX
 SG_ HKBD_Fr_3rdRrOffSw : 0|1@1+ (1,0) [0|0] "" Vector__XXX
 SG_ HKBD_Fr_3rdRrSyncSw : 0|1@1+ (1,0) [0|0] "" Vector__XXX
 SG_ HKBD_Fr_3rdRrLockSw : 0|1@1+ (1,0) [0|0] "" Vector__XXX
 SG_ HKBD_Fr_3rdRrBlwDnSw : 0|1@1+ (1,0) [0|0] "" Vector__XXX
 SG_ HKBD_Fr_3rdRrModBiLvlSw : 0|1@1+ (1,0) [0|0] "" Vector__XXX
 SG_ HKBD_FrRrTglSet : 0|2@1+ (1,0) [0|0] "" Vector__XXX
 SG_ HKBD_FrRrScrnSet : 0|2@1+ (1,0) [0|0] "" Vector__XXX
 SG_ HKBD_Fr_OnOffSet : 0|2@1+ (1,0) [0|0] "" Vector__XXX
 SG_ HKBD_Fr_RrOnOffSet : 0|2@1+ (1,0) [0|0] "" Vector__XXX
 SG_ HKBD_Fr_3rdRrOnOffSet : 0|2@1+ (1,0) [0|0] "" Vector__XXX
 SG_ HKBD_Fr_3rdRrBlwDnOffSw : 0|1@1+ (1,0) [0|0] "" Vector__XXX
 SG_ HKBD_Fr_RrPsAutoSw : 0|1@1+ (1,0) [0|0] "" Vector__XXX
 SG_ HKBD_Fr_RrPsMultiAutoSw : 0|3@1+ (1,0) [0|0] "" Vector__XXX
 SG_ HKBD_Fr_3rdRrModSw : 0|1@1+ (1,0) [0|0] "" Vector__XXX
 SG_ HKBD_Fr_3rdRrBlwUpSw : 0|1@1+ (1,0) [0|0] "" Vector__XXX
 SG_ HKBD_Fr_3rdRrBlwSet : 0|4@1+ (1,0) [0|0] "" Vector__XXX
 SG_ HKBD_Fr_3rdRrModDnSw : 0|1@1+ (1,0) [0|0] "" Vector__XXX
 SG_ HKBD_SwBtnTyp : 0|40@1+ (1,0) [0|0] "" Vector__XXX
 SG_ HKBD_Fr_RrDrTempClickCnt : 0|8@1+ (1,0) [0|0] "" Vector__XXX
 SG_ HKBD_Fr_RrPsTempClickCnt : 0|8@1+ (1,0) [0|0] "" Vector__XXX
 SG_ HKBD_Fr_RrPsBlwClickCnt : 0|8@1+ (1,0) [0|0] "" Vector__XXX
 SG_ HKBD_Fr_3rdRrTempClickCnt : 0|8@1+ (1,0) [0|0] "" Vector__XXX
 SG_ HKBD_Fr_3rdRrBlwClickCnt : 0|8@1+ (1,0) [0|0] "" Vector__XXX
 SG_ HKBD_Fr_RrTempKnobCnt : 0|2@1+ (1,0) [0|0] "" Vector__XXX
 SG_ HKBD_Fr_RrBlwKnobCnt : 0|2@1+ (1,0) [0|0] "" Vector__XXX
 SG_ HKBD_Fr_3rdTempKnobCnt : 0|2@1+ (1,0) [0|0] "" Vector__XXX
 SG_ HKBD_Fr_3rdBlwKnobCnt : 0|2@1+ (1,0) [0|0] "" Vector__XXX
 SG_ HKBD_Fr_RrDrBlwClickCnt : 0|8@1+ (1,0) [0|0] "" Vector__XXX
 SG_ HKBD_SwOpt1 : 0|6@1+ (1,0) [0|0] "" Vector__XXX
 SG_ HKBD_GatewayMode : 0|2@1+ (1,0) [0|0] "" Vector__XXX
 SG_ HKBD_Typ1 : 0|8@1+ (1,0) [0|0] "" Vector__XXX
 SG_ HKBD_Typ2 : 0|8@1+ (1,0) [0|0] "" Vector__XXX
 SG_ HKBD_Typ3 : 0|8@1+ (1,0) [0|0] "" Vector__XXX
 SG_ HKBD_SwOpt2 : 0|6@1+ (1,0) [0|0] "" Vector__XXX
 SG_ HKBD_Fr_DrModDnSw : 0|1@1+ (1,0) [0|0] "" Vector__XXX
 SG_ HKBD_Fr_DrModUpSw : 0|1@1+ (1,0) [0|0] "" Vector__XXX
 SG_ HKBD_Fr_DrMultiAutoSw : 0|3@1+ (1,0) [0|0] "" Vector__XXX
 SG_ HKBD_Fr_PsAutoSw : 0|1@1+ (1,0) [0|0] "" Vector__XXX
 SG_ HKBD_Fr_PsMultiAutoSw : 0|3@1+ (1,0) [0|0] "" Vector__XXX
 SG_ HKBD_Fr_AcSw : 0|1@1+ (1,0) [0|0] "" Vector__XXX
 SG_ HKBD_Fr_DefSw : 0|1@1+ (1,0) [0|0] "" Vector__XXX
 SG_ HKBD_Fr_RecSw : 0|1@1+ (1,0) [0|0] "" Vector__XXX
 SG_ HKBD_Fr_DrModVntSw : 0|1@1+ (1,0) [0|0] "" Vector__XXX
 SG_ HKBD_Fr_FreSw : 0|1@1+ (1,0) [0|0] "" Vector__XXX
 SG_ HKBD_Fr_IntakeTglSw : 0|1@1+ (1,0) [0|0] "" Vector__XXX
 SG_ HKBD_Fr_OffSw : 0|1@1+ (1,0) [0|0] "" Vector__XXX
 SG_ HKBD_Fr_SyncSw : 0|1@1+ (1,0) [0|0] "" Vector__XXX
 SG_ HKBD_Fr_RrDefInd : 0|1@1+ (1,0) [0|0] "" Vector__XXX
 SG_ HKBD_Fr_RrDefSw : 0|1@1+ (1,0) [0|0] "" Vector__XXX
 SG_ HKBD_Fr_ArclnSw : 0|1@1+ (1,0) [0|0] "" Vector__XXX
 SG_ HKBD_Fr_DrOnlySw : 0|1@1+ (1,0) [0|0] "" Vector__XXX
 SG_ HKBD_Fr_ClimateSw : 0|1@1+ (1,0) [0|0] "" Vector__XXX
 SG_ HKBD_Fr_PerfumeSw : 0|1@1+ (1,0) [0|0] "" Vector__XXX
 SG_ HKBD_Fr_DrModFlrSw : 0|1@1+ (1,0) [0|0] "" Vector__XXX
 SG_ HKBD_Fr_HptIntnstySta : 0|4@1+ (1,0) [0|0] "" Vector__XXX
 SG_ HKBD_Fr_StrWhlHeatSw : 0|1@1+ (1,0) [0|0] "" Vector__XXX
 SG_ HKBD_FLStHeatSw : 0|1@1+ (1,0) [0|0] "" Vector__XXX
 SG_ HKBD_FLStVentSw : 0|1@1+ (1,0) [0|0] "" Vector__XXX
 SG_ HKBD_FRStHeatSw : 0|1@1+ (1,0) [0|0] "" Vector__XXX
 SG_ HKBD_FRStVentSw : 0|1@1+ (1,0) [0|0] "" Vector__XXX
 SG_ HKBD_FLStTumblrSw : 0|2@1+ (1,0) [0|0] "" Vector__XXX
 SG_ HKBD_Fr_DrModDefSw : 0|1@1+ (1,0) [0|0] "" Vector__XXX
 SG_ HKBD_FRStTumblrSw : 0|2@1+ (1,0) [0|0] "" Vector__XXX
 SG_ HKBD_Fr_FrWndShldHtSw : 0|1@1+ (1,0) [0|0] "" Vector__XXX
 SG_ HKBD_Fr_DrAutoDnSw : 0|1@1+ (1,0) [0|0] "" Vector__XXX
 SG_ HKBD_Fr_DrAutoUpSw : 0|1@1+ (1,0) [0|0] "" Vector__XXX
 SG_ HKBD_Fr_DrModSw : 0|1@1+ (1,0) [0|0] "" Vector__XXX
 SG_ HKBD_Fr_PsModSw : 0|1@1+ (1,0) [0|0] "" Vector__XXX
 SG_ HKBD_Fr_PsModDnSw : 0|1@1+ (1,0) [0|0] "" Vector__XXX
 SG_ HKBD_Fr_PsModUpSw : 0|1@1+ (1,0) [0|0] "" Vector__XXX
 SG_ HKBD_Fr_PsModVntSw : 0|1@1+ (1,0) [0|0] "" Vector__XXX
 SG_ HKBD_Fr_PsModFlrSw : 0|1@1+ (1,0) [0|0] "" Vector__XXX
 SG_ HKBD_Fr_DrAutoSw : 0|1@1+ (1,0) [0|0] "" Vector__XXX
 SG_ HKBD_Fr_DrTempClickCnt : 0|8@1+ (1,0) [0|0] "" Vector__XXX
 SG_ HKBD_Fr_RrTempClickCnt : 0|8@1+ (1,0) [0|0] "" Vector__XXX
 SG_ HKBD_Fr_DrBlwClickCnt : 0|8@1+ (1,0) [0|0] "" Vector__XXX
 SG_ HKBD_Fr_PsBlwClickCnt : 0|8@1+ (1,0) [0|0] "" Vector__XXX
 SG_ HKBD_FrTempKnobCnt : 0|2@1+ (1,0) [0|0] "" Vector__XXX
 SG_ HKBD_FrBlwKnobCnt : 0|2@1+ (1,0) [0|0] "" Vector__XXX
 SG_ HKBD_Fr_PsTempClickCnt : 0|8@1+ (1,0) [0|0] "" Vector__XXX
 SG_ L_3HKBD_SwOpt1 : 0|8@1+ (1,1) [0|0] "" Vector__XXX
 SG_ L_3HKBD_Typ2 : 0|8@1+ (1,0) [0|0] "" Vector__XXX
 SG_ L_3HKBD_Typ1 : 0|8@1+ (1,0) [0|0] "" Vector__XXX
 SG_ L_3HKBD_SwBtnTyp : 0|20@1+ (1,0) [0|0] "" Vector__XXX
 SG_ L_3HKBD_Rr_TempActrFB : 0|10@1+ (1,0) [0|0] "AD" Vector__XXX
 SG_ L_3HKBD_Rr_TempActrSt : 0|2@1+ (1,0) [0|0] "" Vector__XXX
 SG_ L_3HKBD_Rr_TempAsstActrFB : 0|10@1+ (1,0) [0|0] "AD" Vector__XXX
 SG_ L_3HKBD_Rr_TempAsstActrSt : 0|2@1+ (1,0) [0|0] "" Vector__XXX
 SG_ L_3HKBD_Rr_ModeActrFB : 0|10@1+ (1,0) [0|0] "AD" Vector__XXX
 SG_ L_3HKBD_Rr_ModeActrSt : 0|2@1+ (1,0) [0|0] "" Vector__XXX
 SG_ L_3HKBD_Rr_BLDCError : 0|4@1+ (1,0) [0|0] "" Vector__XXX
 SG_ L_3HKBD_Rr_EvapVolVal : 0|8@1+ (0.02,0) [0|0] "V" Vector__XXX
 SG_ L_3HKBD_Rr_HVACBLDCRpmFB : 0|16@1+ (5,0) [0|0] "RPM" Vector__XXX
 SG_ HKBD_Fr_IncarRaw : 0|10@1+ (0.01,0) [0|0] "V" Vector__XXX
 SG_ L_3HKBD_RrFlrDuctSnsr : 0|9@1+ (0.5,-41) [0|0] "¡É" Vector__XXX
 SG_ L_3HKBD_RrVntDuctSnsr : 0|9@1+ (0.5,-41) [0|0] "¡É" Vector__XXX
 SG_ L_3HKBD_RrTempDnSw : 0|1@1+ (1,1) [0|0] "" Vector__XXX
 SG_ L_3HKBD_RrTempUpSw : 0|1@1+ (1,1) [0|0] "" Vector__XXX
 SG_ L_3HKBD_RrAutoSw : 0|1@1+ (1,0) [0|0] "" Vector__XXX
 SG_ L_3HKBD_RrOffSw : 0|1@1+ (1,0) [0|0] "" Vector__XXX
 SG_ L_3HKBD_RrSyncSw : 0|1@1+ (1,0) [0|0] "" Vector__XXX
 SG_ L_3HKBD_RLStHtrSwReq : 0|1@1+ (1,0) [0|0] "" Vector__XXX
 SG_ L_3HKBD_RLStVentSwReq : 0|1@1+ (1,0) [0|0] "" Vector__XXX
 SG_ L_3HKBD_RRStHtrSwReq : 0|1@1+ (1,0) [0|0] "" Vector__XXX
 SG_ L_3HKBD_RRStVentSwReq : 0|1@1+ (1,0) [0|0] "" Vector__XXX
 SG_ L_3HKBD_RrBlwDnOffSw : 0|1@1+ (1,0) [0|0] "" Vector__XXX
 SG_ L_3HKBD_RrOnOffSet : 0|2@1+ (1,0) [0|0] "" Vector__XXX
 SG_ L_3HKBD_RrBlwDnSw : 0|1@1+ (1,0) [0|0] "" Vector__XXX
 SG_ L_3HKBD_RrBlwUpSw : 0|1@1+ (1,0) [0|0] "" Vector__XXX
 SG_ L_3HKBD_RrModeDnSw : 0|1@1+ (1,0) [0|0] "" Vector__XXX
 SG_ L_3HKBD_RrModeUpSw : 0|1@1+ (1,0) [0|0] "" Vector__XXX
 SG_ L_3HKBD_RrModeSw : 0|1@1+ (1,0) [0|0] "" Vector__XXX
 SG_ L_3HKBD_RrModeVentSw : 0|1@1+ (1,0) [0|0] "" Vector__XXX
 SG_ L_3HKBD_RrModeFloorSw : 0|1@1+ (1,0) [0|0] "" Vector__XXX
 SG_ L_3HKBD_RrModeBiLvlSw : 0|1@1+ (1,0) [0|0] "" Vector__XXX
 SG_ L_3HKBD_RrTempClickCnt : 0|8@1+ (1,1) [0|0] "" Vector__XXX
 SG_ L_3HKBD_TempKnobCnt : 0|2@1+ (1,1) [0|0] "" Vector__XXX
 SG_ L_3HKBD_BlwKnobCnt : 0|2@1+ (1,1) [0|0] "" Vector__XXX
 SG_ L_3HKBD_RrBlwrClickCnt : 0|8@1+ (1,1) [0|0] "" Vector__XXX
 SG_ PCM_Cart2UsdDay : 0|8@1+ (1,0) [0|0] "" Vector__XXX
 SG_ PCM_Cart2UsdYrPre2 : 0|3@1+ (1,0) [0|0] "" Vector__XXX
 SG_ PCM_Cart2UsedYrPost2 : 0|8@1+ (1,0) [0|0] "" Vector__XXX
 SG_ PCM_Cart2VectorX : 0|8@1+ (1,0) [0|0] "" Vector__XXX
 SG_ PCM_Cart2VectorY : 0|8@1+ (1,0) [0|0] "" Vector__XXX
 SG_ PCM_Cart2Rmn : 0|24@1+ (1E-006,0) [0|16.581375] "g" Vector__XXX
 SG_ PCM_Cart2UsdMon : 0|4@1+ (1,0) [0|0] "" Vector__XXX
 SG_ PCM_Cart1UsdDay : 0|8@1+ (1,0) [0|0] "" Vector__XXX
 SG_ PCM_Cart1UsdYrPre2 : 0|3@1+ (1,0) [0|0] "" Vector__XXX
 SG_ PCM_Cart1UsedYrPost2 : 0|8@1+ (1,0) [0|0] "" Vector__XXX
 SG_ PCM_Cart1VectorX : 0|8@1+ (1,0) [0|0] "" Vector__XXX
 SG_ PCM_Cart1VectorY : 0|8@1+ (1,0) [0|0] "" Vector__XXX
 SG_ PCM_Cart1Rmn : 0|24@1+ (1E-006,0) [0|16.581375] "g" Vector__XXX
 SG_ PCM_Cart1UsdMon : 0|4@1+ (1,0) [0|0] "" Vector__XXX
 SG_ PCM_ActPosFB : 0|4@1+ (1,0) [0|0] "" Vector__XXX
 SG_ PCM_ActFailStall : 0|1@1+ (1,0) [0|0] "" Vector__XXX
 SG_ PCM_ActFailMtrOpnShrt : 0|1@1+ (1,0) [0|0] "" Vector__XXX
 SG_ PCM_ActFailMtrOverTemp : 0|1@1+ (1,0) [0|0] "" Vector__XXX
 SG_ PCM_ActFaillnVtg : 0|1@1+ (1,0) [0|0] "" Vector__XXX
 SG_ PCM_Blwr1Sta : 0|4@1+ (1,0) [0|0] "" Vector__XXX
 SG_ PCM_Blwr1SpdFB : 0|4@1+ (1,0) [0|0] "" Vector__XXX
 SG_ PCM_Blwr2Sta : 0|4@1+ (1,0) [0|0] "" Vector__XXX
 SG_ PCM_Blwr2SpdFB : 0|4@1+ (1,0) [0|0] "" Vector__XXX
 SG_ PCM_Blwr1FailCircuitShrt : 0|1@1+ (1,0) [0|0] "" Vector__XXX
 SG_ PCM_Blwr1FailMtrLck : 0|1@1+ (1,0) [0|0] "" Vector__XXX
 SG_ PCM_Blwr1FailOverCurrent : 0|1@1+ (1,0) [0|0] "" Vector__XXX
 SG_ PCM_Blwr1FailOverTemp : 0|1@1+ (1,0) [0|0] "" Vector__XXX
 SG_ PCM_Blwr1FailUnderVtg : 0|1@1+ (1,0) [0|0] "" Vector__XXX
 SG_ PCM_Blwr1FailOverVtg : 0|1@1+ (1,0) [0|0] "" Vector__XXX
 SG_ PCM_Blwr2FailCircuitShrt : 0|1@1+ (1,0) [0|0] "" Vector__XXX
 SG_ PCM_Blwr2FailMtrLck : 0|1@1+ (1,0) [0|0] "" Vector__XXX
 SG_ PCM_ActSpdFB_RPM : 0|4@1+ (0.5,0) [0|7.5] "RPM" Vector__XXX
 SG_ PCM_Blwr2FailOverCurrent : 0|1@1+ (1,0) [0|0] "" Vector__XXX
 SG_ PCM_Blwr2FailOverTemp : 0|1@1+ (1,0) [0|0] "" Vector__XXX
 SG_ PCM_Blwr2FailUnderVtg : 0|1@1+ (1,0) [0|0] "" Vector__XXX
 SG_ PCM_Blwr2FailOverVtg : 0|1@1+ (1,0) [0|0] "" Vector__XXX
 SG_ PCM_Cart1Sta : 0|2@1+ (1,0) [0|0] "" Vector__XXX
 SG_ PCM_Cart1GenuinePart : 0|2@1+ (1,0) [0|0] "" Vector__XXX
 SG_ PCM_Cart1Kinds : 0|4@1+ (1,0) [0|0] "" Vector__XXX
 SG_ PCM_Cart2Sta : 0|2@1+ (1,0) [0|0] "" Vector__XXX
 SG_ PCM_Cart2GenuinePart : 0|2@1+ (1,0) [0|0] "" Vector__XXX
 SG_ PCM_Cart2Kinds : 0|4@1+ (1,0) [0|0] "" Vector__XXX
 SG_ PCM_ActSta : 0|4@1+ (1,0) [0|0] "" Vector__XXX
 SG_ L_2HKBD_RrDrTempClickCnt : 0|8@1+ (1,0) [0|0] "" Vector__XXX
 SG_ L_2HKBD_RrPsTempClickCnt : 0|8@1+ (1,0) [0|0] "" Vector__XXX
 SG_ L_2HKBD_RrPsBlwrClickCnt : 0|8@1+ (1,0) [0|0] "" Vector__XXX
 SG_ L_2HKBD_RrTempKnobCnt : 0|2@1+ (1,0) [0|0] "" Vector__XXX
 SG_ L_2HKBD_RrBlwKnobCnt : 0|2@1+ (1,0) [0|0] "" Vector__XXX
 SG_ L_2HKBD_RrDrBlwrClickCnt : 0|8@1+ (1,0) [0|0] "" Vector__XXX
 SG_ L_ATCU_DrTempCDis : 0|8@1+ (0.5,14) [0|0] "¡É" Vector__XXX
 SG_ L_ATCU_DrTempFDis : 0|8@1+ (1,56) [0|0] "¢µ" Vector__XXX
 SG_ L_ATCU_PassTempFDis : 0|8@1+ (1,56) [0|0] "¢µ" Vector__XXX
 SG_ L_ATCU_FrDrModDis : 0|4@1+ (1,0) [0|0] "" Vector__XXX
 SG_ L_ATCU_FrPassModDis : 0|4@1+ (1,0) [0|0] "" Vector__XXX
 SG_ L_ATCU_FrDrBlwDis : 0|4@1+ (1,0) [0|0] "" Vector__XXX
 SG_ L_ATCU_FrPassBlwDis : 0|4@1+ (1,0) [0|0] "" Vector__XXX
 SG_ L_ATCU_DrAutoDis : 0|2@1+ (1,0) [0|0] "" Vector__XXX
 SG_ L_ATCU_PassAutoDis : 0|2@1+ (1,0) [0|0] "" Vector__XXX
 SG_ L_ATCU_DrMultiAutoBlwDis : 0|2@1+ (1,0) [0|0] "" Vector__XXX
 SG_ L_ATCU_PassMultiAutoBlwDis : 0|2@1+ (1,0) [0|0] "" Vector__XXX
 SG_ L_ATCU_AcDis : 0|2@1+ (1,0) [0|0] "" Vector__XXX
 SG_ L_ATCU_IntakeDis : 0|2@1+ (1,0) [0|0] "" Vector__XXX
 SG_ L_ATCU_SyncDis : 0|2@1+ (1,0) [0|0] "" Vector__XXX
 SG_ L_ATCU_FrDefDis : 0|2@1+ (1,0) [0|0] "" Vector__XXX
 SG_ L_ATCU_PassTempCDis : 0|8@1+ (0.5,14) [0|0] "¡É" Vector__XXX
 SG_ L_ATCU_DrOnlyDis : 0|2@1+ (1,0) [0|0] "" Vector__XXX
 SG_ L_ATCU_SmrtVntDis : 0|2@1+ (1,0) [0|0] "" Vector__XXX
 SG_ L_ATCU_FrWndShldHtInd : 0|2@1+ (1,0) [0|0] "" Vector__XXX
 SG_ L_ATCU_SchedClimate_EnIndSta : 0|1@1+ (1,0) [0|0] "" Vector__XXX
 SG_ L_ATCU_LanguageInfo : 0|8@1+ (1,0) [0|0] "" Vector__XXX
 SG_ L_ATCU_RrDefInd : 0|1@1+ (1,0) [0|0] "" Vector__XXX
 SG_ L_ATCU_AftBlwInfo : 0|2@1+ (1,0) [0|0] "" Vector__XXX
 SG_ L_ATCU_Reserve_Venti_Indi : 0|1@1+ (1,0) [0|0] "" Vector__XXX
 SG_ L_ATCU_IncarMtrOnReq : 0|1@1+ (1,0) [0|0] "" Vector__XXX
 SG_ L_ATCU_FLStHeatSwHInd : 0|1@1+ (1,0) [0|0] "" Vector__XXX
 SG_ L_ATCU_FLStHeatSwMInd : 0|1@1+ (1,0) [0|0] "" Vector__XXX
 SG_ L_ATCU_ADSBlinkDis : 0|2@1+ (1,0) [0|0] "" Vector__XXX
 SG_ L_ATCU_FLStHeatSwLInd : 0|1@1+ (1,0) [0|0] "" Vector__XXX
 SG_ L_ATCU_FLStVntSwHInd : 0|1@1+ (1,0) [0|0] "" Vector__XXX
 SG_ L_ATCU_FLStVntSwMInd : 0|1@1+ (1,0) [0|0] "" Vector__XXX
 SG_ L_ATCU_FLStVntSwLInd : 0|1@1+ (1,0) [0|0] "" Vector__XXX
 SG_ L_ATCU_FRStHeatSwHInd : 0|1@1+ (1,0) [0|0] "" Vector__XXX
 SG_ L_ATCU_FRStHeatSwMInd : 0|1@1+ (1,0) [0|0] "" Vector__XXX
 SG_ L_ATCU_FRStHeatSwLInd : 0|1@1+ (1,0) [0|0] "" Vector__XXX
 SG_ L_ATCU_FRStVntSwHInd : 0|1@1+ (1,0) [0|0] "" Vector__XXX
 SG_ L_ATCU_FRStVntSwMInd : 0|1@1+ (1,0) [0|0] "" Vector__XXX
 SG_ L_ATCU_FRStVntSwLInd : 0|1@1+ (1,0) [0|0] "" Vector__XXX
 SG_ L_ATCU_StrWhlHeatInd : 0|2@1+ (1,0) [0|0] "" Vector__XXX
 SG_ L_ATCU_RhstaLvlSta : 0|5@1+ (1,0) [0|0] "" Vector__XXX
 SG_ L_ATCU_IntTailOnOff : 0|1@1+ (1,0) [0|0] "" Vector__XXX
 SG_ L_ATCU_AutoLightSta : 0|1@1+ (1,0) [0|0] "" Vector__XXX
 SG_ L_ATCU_FrBckLightSta : 0|1@1+ (1,0) [0|0] "" Vector__XXX
 SG_ L_ATCU_ADSOffDis : 0|2@1+ (1,0) [0|0] "" Vector__XXX
 SG_ L_ATCU_DisplayTheme : 0|2@1+ (1,0) [0|0] "" Vector__XXX
 SG_ L_ATCU_GUIBlankDis : 0|1@1+ (1,0) [0|0] "" Vector__XXX
 SG_ L_ATCU_HptFdbckLvl : 0|4@1+ (1,0) [0|0] "" Vector__XXX
 SG_ L_ATCU_TlltLmpDis : 0|3@1+ (1,0) [0|0] "" Vector__XXX
 SG_ L_ATCU_AvTailOnOff : 0|1@1+ (1,0) [0|0] "" Vector__XXX
 SG_ L_ATCU_AirClnDis : 0|2@1+ (1,0) [0|0] "" Vector__XXX
 SG_ L_ATCU_CO2WrngDis : 0|2@1+ (1,0) [0|0] "" Vector__XXX
 SG_ L_2HKBD_RrDrModeDnSw : 0|1@1+ (1,0) [0|0] "" Vector__XXX
 SG_ L_2HKBD_RrDrModeUpSw : 0|1@1+ (1,0) [0|0] "" Vector__XXX
 SG_ L_2HKBD_RrDrAutoSw : 0|1@1+ (1,0) [0|0] "" Vector__XXX
 SG_ L_2HKBD_Rr_OffSw : 0|1@1+ (1,0) [0|0] "" Vector__XXX
 SG_ L_2HKBD_RrSyncSw : 0|1@1+ (1,0) [0|0] "" Vector__XXX
 SG_ L_2HKBD_RrAcSw : 0|1@1+ (1,0) [0|0] "" Vector__XXX
 SG_ L_2HKBD_RLStHtrSwReq : 0|1@1+ (1,0) [0|0] "" Vector__XXX
 SG_ L_2HKBD_RLStVentSwReq : 0|1@1+ (1,0) [0|0] "" Vector__XXX
 SG_ L_2HKBD_RRStHtrSwReq : 0|1@1+ (1,0) [0|0] "" Vector__XXX
 SG_ L_2HKBD_RRStVentSwReq : 0|1@1+ (1,0) [0|0] "" Vector__XXX
 SG_ L_2HKBD_RrDrMultiAutoSw : 0|3@1+ (1,0) [0|0] "" Vector__XXX
 SG_ L_2HKBD_RrDrModeSw : 0|1@1+ (1,0) [0|0] "" Vector__XXX
 SG_ L_2HKBD_RrPsModeSw : 0|1@1+ (1,0) [0|0] "" Vector__XXX
 SG_ L_2HKBD_RrPsModeDnSw : 0|1@1+ (1,0) [0|0] "" Vector__XXX
 SG_ L_2HKBD_RrPsModeUpSw : 0|1@1+ (1,0) [0|0] "" Vector__XXX
 SG_ L_2HKBD_RrPsModeVentSw : 0|1@1+ (1,0) [0|0] "" Vector__XXX
 SG_ L_2HKBD_RrPsModeFloorSw : 0|1@1+ (1,0) [0|0] "" Vector__XXX
 SG_ L_2HKBD_RrPsModeBiLvlSw : 0|1@1+ (1,0) [0|0] "" Vector__XXX
 SG_ L_2HKBD_RrPsTempDnSw : 0|1@1+ (1,0) [0|0] "" Vector__XXX
 SG_ L_2HKBD_RrPsTempUpSw : 0|1@1+ (1,0) [0|0] "" Vector__XXX
 SG_ L_2HKBD_RrPsBlwUpSw : 0|1@1+ (1,0) [0|0] "" Vector__XXX
 SG_ L_2HKBD_RrDRModeVentSw : 0|1@1+ (1,0) [0|0] "" Vector__XXX
 SG_ L_2HKBD_RrPsBlwDnSw : 0|1@1+ (1,0) [0|0] "" Vector__XXX
 SG_ L_2HKBD_RrPsAutoSw : 0|1@1+ (1,0) [0|0] "" Vector__XXX
 SG_ L_2HKBD_RrPsMultiAutoSw : 0|3@1+ (1,0) [0|0] "" Vector__XXX
 SG_ L_2HKBD_RrDrBlwDnOffSw : 0|1@1+ (1,0) [0|0] "" Vector__XXX
 SG_ L_2HKBD_RrPsBlwDnOffSw : 0|1@1+ (1,0) [0|0] "" Vector__XXX
 SG_ L_2HKBD_RrOnOffSet : 0|2@1+ (1,0) [0|0] "" Vector__XXX
 SG_ L_2HKBD_RrDrModeFloorSw : 0|1@1+ (1,0) [0|0] "" Vector__XXX

CM_ BO_ 3221225472 "This is a message for not used signals, created by Vector CANdb++ DBC OLE DB Provider.";
CM_ SG_ 3221225472 HKBD_Fr_DrTempDnSw "HKBD_Front_DriverTemperatureDownSwitch";
CM_ SG_ 3221225472 HKBD_Fr_DrTempUpSw "HKBD_Front_DriverTemperatureUpSwitch";
CM_ SG_ 3221225472 HKBD_Fr_PsBlwDnSw "HKBD_Front_PassengerBlowerDownSwitch";
CM_ SG_ 3221225472 HKBD_Fr_PsBlwDnOffSw "HKBD_Front_PasengerBlowerDownOffSwitch";
CM_ SG_ 3221225472 HKBD_Fr_PsBlwUpSw "HKBD_Front_PassengerBlowerUpSwitch";
CM_ SG_ 3221225472 HKBD_Fr_PsBlwSet "HKBD_Front_PassengerBlowerSet";
CM_ SG_ 3221225472 HKBD_Fr_RrDrTempDnSw "HKBD_Front_RearDriverTemperatureDownSwitch";
CM_ SG_ 3221225472 HKBD_Fr_RrDrTempUpSw "HKBD_Front_RearDriverTemperatureUpSwitch";
CM_ SG_ 3221225472 HKBD_Fr_PsTempDnSw "HKBD_Front_PassengerTemperatureDownSwitch";
CM_ SG_ 3221225472 HKBD_Fr_RrDrBlwDnSw "HKBD_Front_RearDriverBlowerDownSwitch";
CM_ SG_ 3221225472 HKBD_Fr_RrDrBlwDnOffSw "HKBD_Front_RearDriverBlowerDownOffSwitch";
CM_ SG_ 3221225472 HKBD_Fr_RrDrBlwUpSw "HKBD_Front_RearDriverBlowerUpSwitch";
CM_ SG_ 3221225472 HKBD_Fr_RrDrBlwSet "HKBD_Front_RearDriverBlowerSet";
CM_ SG_ 3221225472 HKBD_Fr_RrDrModDnSw "HKBD_Front_RearDriverModeDownSiwtch";
CM_ SG_ 3221225472 HKBD_Fr_RrDrModUpSw "HKBD_Front_RearDriverModeUpSwitch";
CM_ SG_ 3221225472 HKBD_Fr_RrDrModVntSw "HKBD_Front_RearDriverModeVentSwitch";
CM_ SG_ 3221225472 HKBD_Fr_PsTempUpSw "HKBD_Front_PassengerTemperatureUpSwitch";
CM_ SG_ 3221225472 HKBD_Fr_RrDrModFlrSw "HKBD_Front_RearDriverModeFloorSwitch";
CM_ SG_ 3221225472 HKBD_Fr_RrDrModBiLvlSw "HKBD_Front_RearDriverModeBiLevelSwitch";
CM_ SG_ 3221225472 HKBD_Fr_RrDrAutoSw "HKBD_Front_RearDriverAutoSwitch";
CM_ SG_ 3221225472 HKBD_Fr_RrDrMultiAutoSw "HKBD_Front_RearDriverMultiAutoSwitch";
CM_ SG_ 3221225472 HKBD_Fr_RrOffSw "HKBD_Front_RearOffSwitch";
CM_ SG_ 3221225472 HKBD_Fr_RrSyncSw "HKBD_Front_RearSyncSwitch";
CM_ SG_ 3221225472 HKBD_Fr_RLStHeatSw "HKBD_Front_RearLeftSeatHeatSwitch";
CM_ SG_ 3221225472 HKBD_Fr_RLStVentSw "HKBD_Front_RearLeftSeatVentSwitch";
CM_ SG_ 3221225472 HKBD_Fr_DrBlwDnSw "HKBD_Front_DriverBLowerDownSwitch";
CM_ SG_ 3221225472 HKBD_Fr_RRStHeatSw "HKBD_Front_RearRightSeatHeatSwitch";
CM_ SG_ 3221225472 HKBD_Fr_RRStVentSw "HKBD_Front_RearRightSeatVentSwitch";
CM_ SG_ 3221225472 HKBD_Fr_RLStTumblrSw "HKBD_Front_RearLeftSeatTumblerSwitch";
CM_ SG_ 3221225472 HKBD_Fr_RRStTumblrSw "HKBD_Front_RearRightSeatTumblerSwitch";
CM_ SG_ 3221225472 HKBD_Fr_RrPsModDnSw "HKBD_Front_RearPassengerModeDownSwitch";
CM_ SG_ 3221225472 HKBD_Fr_RrPsModUpSw "HKBD_Front_RearPassengerModeUpSwitch";
CM_ SG_ 3221225472 HKBD_Fr_RrPsModVntSw "HKBD_Front_RearPassengerModeVentSwitch";
CM_ SG_ 3221225472 HKBD_Fr_RrPsModFlrSw "HKBD_Front_RearPassengerModeFloorSwitch";
CM_ SG_ 3221225472 HKBD_Fr_DrBlwDnOffSw "HKBD_Front_DriverBlowerDownOffSwitch";
CM_ SG_ 3221225472 HKBD_Fr_RrLockSw "HKBD_Front_RearLockSwitch";
CM_ SG_ 3221225472 HKBD_Fr_RrPsModBiLvlSw "HKBD_Front_RearPassengerrModeBiLevelSwitch";
CM_ SG_ 3221225472 HKBD_Fr_RrDrModSw "HKBD_Front_RearDriverModeSwitch";
CM_ SG_ 3221225472 HKBD_Fr_RrPsModSw "HKBD_Front_RearPassengerModeSwitch";
CM_ SG_ 3221225472 HKBD_Fr_RrPsBlwSet "HKBD_Front_RearPassengerBlowerSet";
CM_ SG_ 3221225472 HKBD_Fr_RrPsBlwUpSw "HKBD_Front_RearPassengerBlowerUpSwitch";
CM_ SG_ 3221225472 HKBD_Fr_RrPsBlwDnSw "HKBD_Front_RearPassengerBlowerDownSwitch";
CM_ SG_ 3221225472 HKBD_Fr_DrBlwUpSw "HKBD_Front_DriverBlowerUpSwitch";
CM_ SG_ 3221225472 HKBD_Fr_RrPsBlwDnOffSw "HKBD_Front_RearPassengerBlowerDownOffSwitch";
CM_ SG_ 3221225472 HKBD_Fr_RrPsTempDnSw "HKBD_Front_RearPassengerTemperatureDownSwitch";
CM_ SG_ 3221225472 HKBD_Fr_RrPsTempUpSw "HKBD_Front_RearPassengerTemperatureUpSwitch";
CM_ SG_ 3221225472 HKBD_Fr_DrBlwSet "HKBD_Front_DriverBlowerSet";
CM_ SG_ 3221225472 L_ATCU_PCMActTgtPos "ATCU_PCMActTgtPos";
CM_ SG_ 3221225472 L_ATCU_VehPowerIGN2 "ATCU_VehPowerIGN2";
CM_ SG_ 3221225472 L_ATCU_VehPowerISGB "ATCU_VehPowerISGB";
CM_ SG_ 3221225472 L_ATCU_Blwr1TgtSpd "ATCU_Blwr1TgtSpd";
CM_ SG_ 3221225472 L_ATCU_Blwr2TgtSpd "ATCU_Blwr2TgtSpd";
CM_ SG_ 3221225472 L_ATCU_CurrentDy "ATCU_CurrentDy";
CM_ SG_ 3221225472 L_ATCU_CurrentMon "ATCU_CurrentMon";
CM_ SG_ 3221225472 L_ATCU_CurrentYrPre "ATCU_CurrentYrPre";
CM_ SG_ 3221225472 L_ATCU_CurrentYrPost "ATCU_CurrentYrPost";
CM_ SG_ 3221225472 L_ATCU_PCMActTgtSpd "ATCU_PCMActTgtSpd";
CM_ SG_ 3221225472 L_ATCU_VehPowerBatt "ATCU_VehPowerBatt";
CM_ SG_ 3221225472 L_ATCU_VehPowerIGN1_3 "ATCU_VehPowerIGN1_3";
CM_ SG_ 3221225472 HKBD_Fr_3rdRrTempDnSw "HKBD_Front_3rdRearTemperatureDownSwitch";
CM_ SG_ 3221225472 HKBD_Fr_3rdRrTempUpSw "HKBD_Front_3rdRearTemperatureUpSwitch";
CM_ SG_ 3221225472 HKBD_Fr_3rdRrModUpSw "HKBD_Front_3rdRearModeUpSwitch";
CM_ SG_ 3221225472 HKBD_Fr_3rdRrModVntSw "HKBD_Front_3rdRearModeVentSwitch";
CM_ SG_ 3221225472 HKBD_Fr_3rdRrModFlrSw "HKBD_Front_3rdRearModeFloorSwitch";
CM_ SG_ 3221225472 HKBD_Fr_3rdRrAutoSw "HKBD_Front_3rdRearAutoSwitch";
CM_ SG_ 3221225472 HKBD_Fr_3rdRrMultiAutoSw "HKBD_Front_3rdRearMultiAutoSwitch";
CM_ SG_ 3221225472 HKBD_Fr_3rdRrOffSw "HKBD_Front_3rdRearOffSwitch";
CM_ SG_ 3221225472 HKBD_Fr_3rdRrSyncSw "HKBD_Front_3rdRearSyncSwitch";
CM_ SG_ 3221225472 HKBD_Fr_3rdRrLockSw "HKBD_Front_3rdRearLockSwitch";
CM_ SG_ 3221225472 HKBD_Fr_3rdRrBlwDnSw "HKBD_Front_3rdRearBlowerDownSwitch";
CM_ SG_ 3221225472 HKBD_Fr_3rdRrModBiLvlSw "HKBD_Front_3rdRearModeBiLevelSwitch";
CM_ SG_ 3221225472 HKBD_FrRrTglSet "HKBD_FrontRearToggleSet";
CM_ SG_ 3221225472 HKBD_FrRrScrnSet "HKBD_FrontRearScreenSet";
CM_ SG_ 3221225472 HKBD_Fr_OnOffSet "HKBD_Front_OnOffSet";
CM_ SG_ 3221225472 HKBD_Fr_RrOnOffSet "HKBD_Front_RearOnOffSet";
CM_ SG_ 3221225472 HKBD_Fr_3rdRrOnOffSet "HKBD_Front_3rdRearOnOffSet";
CM_ SG_ 3221225472 HKBD_Fr_3rdRrBlwDnOffSw "HKBD_Front_3rdRearBlowerDownOffSwitch";
CM_ SG_ 3221225472 HKBD_Fr_RrPsAutoSw "HKBD_Front_RearPassengerAutoSwitch";
CM_ SG_ 3221225472 HKBD_Fr_RrPsMultiAutoSw "HKBD_Front_RearPassengerMultiAutoSwitch";
CM_ SG_ 3221225472 HKBD_Fr_3rdRrModSw "HKBD_Front_3rdRearModeSwitch";
CM_ SG_ 3221225472 HKBD_Fr_3rdRrBlwUpSw "HKBD_Front_3rdRearBlowerUpSwitch";
CM_ SG_ 3221225472 HKBD_Fr_3rdRrBlwSet "HKBD_Front_3rdRearBlowerSet";
CM_ SG_ 3221225472 HKBD_Fr_3rdRrModDnSw "HKBD_Front_3rdRearModeDownSwitch";
CM_ SG_ 3221225472 HKBD_SwBtnTyp "HKBD_SwitchButtonType";
CM_ SG_ 3221225472 HKBD_Fr_RrDrTempClickCnt "HKBD_Front_RearDriverTemperatureClickCount";
CM_ SG_ 3221225472 HKBD_Fr_RrPsTempClickCnt "HKBD_Front_RearPassengerTemperatureClickCount";
CM_ SG_ 3221225472 HKBD_Fr_RrPsBlwClickCnt "HKBD_Front_RearPassengerBlowerClickCount";
CM_ SG_ 3221225472 HKBD_Fr_3rdRrTempClickCnt "HKBD_Front_3rdRearTepmperatureClickCount";
CM_ SG_ 3221225472 HKBD_Fr_3rdRrBlwClickCnt "HKBD_Front_3rdRearBlowerClickCount";
CM_ SG_ 3221225472 HKBD_Fr_RrTempKnobCnt "HKBD_Front_RearTemperatureKnobCount (for knobs rotate count)";
CM_ SG_ 3221225472 HKBD_Fr_RrBlwKnobCnt "HKBD_Front_RearBlowerKnobCount (for knobs rotate count)";
CM_ SG_ 3221225472 HKBD_Fr_3rdTempKnobCnt "HKBD_Front_3rdTemperatureKnobCount (for knobs rotate count)";
CM_ SG_ 3221225472 HKBD_Fr_3rdBlwKnobCnt "HKBD_Front_3rdBlowerKnobCount (for knobs rotate count)";
CM_ SG_ 3221225472 HKBD_Fr_RrDrBlwClickCnt "HKBD_Front_RearDriverBlowerClickCount";
CM_ SG_ 3221225472 HKBD_SwOpt1 "Control Panel Switch Option signal";
CM_ SG_ 3221225472 HKBD_GatewayMode "HKBD_GatewayMode";
CM_ SG_ 3221225472 HKBD_Typ1 "HKBD_Type1";
CM_ SG_ 3221225472 HKBD_Typ2 "HKBD_Type2";
CM_ SG_ 3221225472 HKBD_Typ3 "HKBD_Type3";
CM_ SG_ 3221225472 HKBD_SwOpt2 "Control Panel Switch Option signal";
CM_ SG_ 3221225472 HKBD_Fr_DrModDnSw "HKBD_Front_DriverModeDownSwitch";
CM_ SG_ 3221225472 HKBD_Fr_DrModUpSw "HKBD_Front_DriverModeUpSwitch";
CM_ SG_ 3221225472 HKBD_Fr_DrMultiAutoSw "HKBD_Front_DriverMultiAutoSiwtch";
CM_ SG_ 3221225472 HKBD_Fr_PsAutoSw "HKBD_Front_PassengerAutoSwitch";
CM_ SG_ 3221225472 HKBD_Fr_PsMultiAutoSw "HKBD_Front_PassengerMultiAutoSwitch";
CM_ SG_ 3221225472 HKBD_Fr_AcSw "HKBD_Front_ACSwitch";
CM_ SG_ 3221225472 HKBD_Fr_DefSw "HKBD_Front_DEFSwitch";
CM_ SG_ 3221225472 HKBD_Fr_RecSw "HKBD_Front_RecirculationSwitch";
CM_ SG_ 3221225472 HKBD_Fr_DrModVntSw "HKBD_Front_DriverModeVentSwitch";
CM_ SG_ 3221225472 HKBD_Fr_FreSw "HKBD_Front_FreshSwitch";
CM_ SG_ 3221225472 HKBD_Fr_IntakeTglSw "HKBD_Front_IntakeToggleSwitch";
CM_ SG_ 3221225472 HKBD_Fr_OffSw "HKBD_Front_OffSwitch";
CM_ SG_ 3221225472 HKBD_Fr_SyncSw "HKBD_Front_SyncSwitch";
CM_ SG_ 3221225472 HKBD_Fr_RrDefInd "HKBD_Front_RearDEFIndicator";
CM_ SG_ 3221225472 HKBD_Fr_RrDefSw "HKBD_Front_RearDEFSwitch";
CM_ SG_ 3221225472 HKBD_Fr_ArclnSw "HKBD_Front_AirCleaningIndicatorSwitch";
CM_ SG_ 3221225472 HKBD_Fr_DrOnlySw "HKBD_Front_DriverOnlySwitch";
CM_ SG_ 3221225472 HKBD_Fr_ClimateSw "HKBD_Front_ClimateSwitch";
CM_ SG_ 3221225472 HKBD_Fr_PerfumeSw "HKBD_Front_PerfumeSwitch";
CM_ SG_ 3221225472 HKBD_Fr_DrModFlrSw "HKBD_Front_DriverModeFloorSwitch";
CM_ SG_ 3221225472 HKBD_Fr_HptIntnstySta "HKBD_Front_HapticIntensityState";
CM_ SG_ 3221225472 HKBD_Fr_StrWhlHeatSw "HKBD_Front_SteeringWheelHeatSwitch";
CM_ SG_ 3221225472 HKBD_FLStHeatSw "HKBD_FrontLeftSeatHeatSwitch";
CM_ SG_ 3221225472 HKBD_FLStVentSw "HKBD_FrontLeftSeatVentSwitch";
CM_ SG_ 3221225472 HKBD_FRStHeatSw "HBKD_FrontRightSeatHeatSwitch";
CM_ SG_ 3221225472 HKBD_FRStVentSw "HKBD_FrontRightSeatVentSwitch";
CM_ SG_ 3221225472 HKBD_FLStTumblrSw "HKBD_FrontLeftSeatTumblerSwitch";
CM_ SG_ 3221225472 HKBD_Fr_DrModDefSw "HKBD_Front_DriverModeDEFSwitch";
CM_ SG_ 3221225472 HKBD_FRStTumblrSw "HKBD_FrontRightSeatTumblerSwitch";
CM_ SG_ 3221225472 HKBD_Fr_FrWndShldHtSw "HKBD_Front_FrontWindShieldHeatSwitch";
CM_ SG_ 3221225472 HKBD_Fr_DrAutoDnSw "HKBD_Front_DriverAutoDownSwitch";
CM_ SG_ 3221225472 HKBD_Fr_DrAutoUpSw "HKBD_Front_DriverAutoUpSwitch";
CM_ SG_ 3221225472 HKBD_Fr_DrModSw "HKBD_Front_DriverModeSwitch";
CM_ SG_ 3221225472 HKBD_Fr_PsModSw "HKBD_Front_PassengerModeSwitch";
CM_ SG_ 3221225472 HKBD_Fr_PsModDnSw "HKBD_Front_PassengerModeDownSwitch";
CM_ SG_ 3221225472 HKBD_Fr_PsModUpSw "HKBD_Front_PassengerModeUpSwitch";
CM_ SG_ 3221225472 HKBD_Fr_PsModVntSw "HKBD_Front_PassengerModeVentSwitch";
CM_ SG_ 3221225472 HKBD_Fr_PsModFlrSw "HKBD_Front_PasengerModeFloorSwitch";
CM_ SG_ 3221225472 HKBD_Fr_DrAutoSw "HKBD_Front_DriverAutoSwitch";
CM_ SG_ 3221225472 HKBD_Fr_DrTempClickCnt "HKBD_Front_DriverTemperatureClickCount";
CM_ SG_ 3221225472 HKBD_Fr_RrTempClickCnt "HKBD_Front_RearTemperatureClickCount";
CM_ SG_ 3221225472 HKBD_Fr_DrBlwClickCnt "HKBD_Front_DriverBlowerClickCount";
CM_ SG_ 3221225472 HKBD_Fr_PsBlwClickCnt "HKBD_Front_PassengerBlowerClickCount";
CM_ SG_ 3221225472 HKBD_FrTempKnobCnt "HKBD_FrontTempKnobCount (for knobs rotate count)";
CM_ SG_ 3221225472 HKBD_FrBlwKnobCnt "HKBD_FrontBlowerKnobCount (for knobs rotate count)";
CM_ SG_ 3221225472 HKBD_Fr_PsTempClickCnt "HKBD_Front_PassengerTemperatureClickCount";
CM_ SG_ 3221225472 L_3HKBD_SwOpt1 "3HKBD_SwitchOption1";
CM_ SG_ 3221225472 L_3HKBD_Typ2 "3HKBD_Type2";
CM_ SG_ 3221225472 L_3HKBD_Typ1 "3HKBD_Type1";
CM_ SG_ 3221225472 L_3HKBD_SwBtnTyp "3HKBD_SwitchButtonType";
CM_ SG_ 3221225472 L_3HKBD_Rr_TempActrFB "3HKBD_Rear_TempActuatorFeedback";
CM_ SG_ 3221225472 L_3HKBD_Rr_TempActrSt "3HKBD_Rear_TempActuatorStatus";
CM_ SG_ 3221225472 L_3HKBD_Rr_TempAsstActrFB "3HKBD_Rear_TempAssistActuatorFeedback";
CM_ SG_ 3221225472 L_3HKBD_Rr_TempAsstActrSt "3HKBD_Rear_TempAssistActuatorStatus";
CM_ SG_ 3221225472 L_3HKBD_Rr_ModeActrFB "3HKBD_Rear_ModeActuatorFeedback";
CM_ SG_ 3221225472 L_3HKBD_Rr_ModeActrSt "3HKBD_Rear_ModeActuatorStatus";
CM_ SG_ 3221225472 L_3HKBD_Rr_BLDCError "3HKBD_Rear_BLDCError";
CM_ SG_ 3221225472 L_3HKBD_Rr_EvapVolVal "3HKBD_Rear_EvaporatorVoltageValue";
CM_ SG_ 3221225472 L_3HKBD_Rr_HVACBLDCRpmFB "3HKBD_Rear_HVACBLDCRpmFeedBack";
CM_ SG_ 3221225472 HKBD_Fr_IncarRaw "HKBD_Front_IncarSensorRawValue";
CM_ SG_ 3221225472 L_3HKBD_RrFlrDuctSnsr "3HKBD_RearFloorDuctSensor";
CM_ SG_ 3221225472 L_3HKBD_RrVntDuctSnsr "3HKBD_RearVentDuctSensor";
CM_ SG_ 3221225472 L_3HKBD_RrTempDnSw "3HKBD_RearTemperatureDownSwitch";
CM_ SG_ 3221225472 L_3HKBD_RrTempUpSw "3HKBD_RearTemperatureUpSwitch";
CM_ SG_ 3221225472 L_3HKBD_RrAutoSw "3HKBD_RearAutoSwitch";
CM_ SG_ 3221225472 L_3HKBD_RrOffSw "3HKBD_RearOffSwitch";
CM_ SG_ 3221225472 L_3HKBD_RrSyncSw "3HKBD_RearSyncSwitch";
CM_ SG_ 3221225472 L_3HKBD_RLStHtrSwReq "3HKBD_RearLeftSeatHeaterSwitchRequest";
CM_ SG_ 3221225472 L_3HKBD_RLStVentSwReq "3HKBD_RearLeftSeatVentSwitchRequest";
CM_ SG_ 3221225472 L_3HKBD_RRStHtrSwReq "3HKBD_RearRightSeatHeaterSwitchRequest";
CM_ SG_ 3221225472 L_3HKBD_RRStVentSwReq "3HKBD_RearRightSeatVentSwitchRequest";
CM_ SG_ 3221225472 L_3HKBD_RrBlwDnOffSw "3HKBD_RearBlowerDownOffSwitch";
CM_ SG_ 3221225472 L_3HKBD_RrOnOffSet "3HKBD_RearOnOffSet";
CM_ SG_ 3221225472 L_3HKBD_RrBlwDnSw "3HKBD_RearBlowerDownSwitch";
CM_ SG_ 3221225472 L_3HKBD_RrBlwUpSw "3HKBD_RearBlowerUpSwitch";
CM_ SG_ 3221225472 L_3HKBD_RrModeDnSw "3HKBD_RearModeDownSwitch";
CM_ SG_ 3221225472 L_3HKBD_RrModeUpSw "3HKBD_RearModeUpSwitch";
CM_ SG_ 3221225472 L_3HKBD_RrModeSw "3HKBD_RearModeSwitch";
CM_ SG_ 3221225472 L_3HKBD_RrModeVentSw "3HKBD_RearModeVentSwitch";
CM_ SG_ 3221225472 L_3HKBD_RrModeFloorSw "3HKBD_RearModeFloorSwitch";
CM_ SG_ 3221225472 L_3HKBD_RrModeBiLvlSw "3HKBD_RearModeBiLevelSwitch";
CM_ SG_ 3221225472 L_3HKBD_RrTempClickCnt "3HKBD_RearTemperatureClickCount";
CM_ SG_ 3221225472 L_3HKBD_TempKnobCnt "3HKBD_TempKnobCount (for knobs rotate count)";
CM_ SG_ 3221225472 L_3HKBD_BlwKnobCnt "3HKBD_BlowerKnobCount (for knobs rotate count)";
CM_ SG_ 3221225472 L_3HKBD_RrBlwrClickCnt "3HKBD_RearBlowerClickCount";
CM_ SG_ 3221225472 PCM_Cart2UsdDay "PCM_Cart2UsdDay";
CM_ SG_ 3221225472 PCM_Cart2UsdYrPre2 "PCM_Cart2UsdYrPre2";
CM_ SG_ 3221225472 PCM_Cart2UsedYrPost2 "PCM_Cart2UsedYrPost2";
CM_ SG_ 3221225472 PCM_Cart2VectorX "PCM_Cart2VectorX";
CM_ SG_ 3221225472 PCM_Cart2VectorY "PCM_Cart2VectorY";
CM_ SG_ 3221225472 PCM_Cart2Rmn "PCM_Cart2Rmn";
CM_ SG_ 3221225472 PCM_Cart2UsdMon "PCM_Cart2UsdMon";
CM_ SG_ 3221225472 PCM_Cart1UsdDay "PCM_Cart1UsdDay";
CM_ SG_ 3221225472 PCM_Cart1UsdYrPre2 "PCM_Cart1UsdYrPre2";
CM_ SG_ 3221225472 PCM_Cart1UsedYrPost2 "PCM_Cart1UsedYrPost2";
CM_ SG_ 3221225472 PCM_Cart1VectorX "PCM_Cart1VectorX";
CM_ SG_ 3221225472 PCM_Cart1VectorY "PCM_Cart1VectorY";
CM_ SG_ 3221225472 PCM_Cart1Rmn "PCM_Cart1Rmn";
CM_ SG_ 3221225472 PCM_Cart1UsdMon "PCM_Cart1UsdMon";
CM_ SG_ 3221225472 PCM_ActPosFB "PCM_ActPosFB";
CM_ SG_ 3221225472 PCM_ActFailStall "PCM_ActFailStall";
CM_ SG_ 3221225472 PCM_ActFailMtrOpnShrt "PCM_ActFailMtrOpnShrt";
CM_ SG_ 3221225472 PCM_ActFailMtrOverTemp "PCM_ActFailMtrOverTemp";
CM_ SG_ 3221225472 PCM_ActFaillnVtg "PCM_ActFaillnVtg";
CM_ SG_ 3221225472 PCM_Blwr1Sta "PCM_Blwr1Sta";
CM_ SG_ 3221225472 PCM_Blwr1SpdFB "PCM_Blwr1SpdFB";
CM_ SG_ 3221225472 PCM_Blwr2Sta "PCM_Blwr2Sta";
CM_ SG_ 3221225472 PCM_Blwr2SpdFB "PCM_Blwr2SpdFB";
CM_ SG_ 3221225472 PCM_Blwr1FailCircuitShrt "PCM_Blwr1FailCircuitShrt";
CM_ SG_ 3221225472 PCM_Blwr1FailMtrLck "PCM_Blwr1FailMtrLck";
CM_ SG_ 3221225472 PCM_Blwr1FailOverCurrent "PCM_Blwr1FailOverCurrent";
CM_ SG_ 3221225472 PCM_Blwr1FailOverTemp "PCM_Blwr1FailOverTemp";
CM_ SG_ 3221225472 PCM_Blwr1FailUnderVtg "PCM_Blwr1FailUnderVtg";
CM_ SG_ 3221225472 PCM_Blwr1FailOverVtg "PCM_Blwr1FailOverVtg";
CM_ SG_ 3221225472 PCM_Blwr2FailCircuitShrt "PCM_Blwr2FailCircuitShrt";
CM_ SG_ 3221225472 PCM_Blwr2FailMtrLck "PCM_Blwr2FailMtrLck";
CM_ SG_ 3221225472 PCM_ActSpdFB_RPM "PCM_ActSpdFB_RPM";
CM_ SG_ 3221225472 PCM_Blwr2FailOverCurrent "PCM_Blwr2FailOverCurrent";
CM_ SG_ 3221225472 PCM_Blwr2FailOverTemp "PCM_Blwr2FailOverTemp";
CM_ SG_ 3221225472 PCM_Blwr2FailUnderVtg "PCM_Blwr2FailUnderVtg";
CM_ SG_ 3221225472 PCM_Blwr2FailOverVtg "PCM_Blwr2FailOverVtg";
CM_ SG_ 3221225472 PCM_Cart1Sta "PCM_Cart1Sta";
CM_ SG_ 3221225472 PCM_Cart1GenuinePart "PCM_Cart1GenuinePart";
CM_ SG_ 3221225472 PCM_Cart1Kinds "PCM_Cart1Kinds";
CM_ SG_ 3221225472 PCM_Cart2Sta "PCM_Cart2Sta";
CM_ SG_ 3221225472 PCM_Cart2GenuinePart "PCM_Cart2GenuinePart";
CM_ SG_ 3221225472 PCM_Cart2Kinds "PCM_Cart2Kinds";
CM_ SG_ 3221225472 PCM_ActSta "PCM_ActSta";
CM_ SG_ 3221225472 L_2HKBD_RrDrTempClickCnt "2HKBD_RearDriverTempClickCount";
CM_ SG_ 3221225472 L_2HKBD_RrPsTempClickCnt "2HKBD_RearPassengerTempClickCount";
CM_ SG_ 3221225472 L_2HKBD_RrPsBlwrClickCnt "2HKBD_RearPassengerBlowerClickCount";
CM_ SG_ 3221225472 L_2HKBD_RrTempKnobCnt "2HKBD_RearTemperatureKnobCount (for knobs rotate count)";
CM_ SG_ 3221225472 L_2HKBD_RrBlwKnobCnt "2HKBD_RearBlowerKnobCount (for knobs rotate count)";
CM_ SG_ 3221225472 L_2HKBD_RrDrBlwrClickCnt "2HKBD_RearDriverBlowerClickCount";
CM_ SG_ 3221225472 L_ATCU_DrTempCDis "ATCU_DrvierTemperatureDisplay(¡É)";
CM_ SG_ 3221225472 L_ATCU_DrTempFDis "ATCU_DriverTemperatureDisplay(¢µ)";
CM_ SG_ 3221225472 L_ATCU_PassTempFDis "ATCU_PassengerTemperatureDisplay(¢µ)";
CM_ SG_ 3221225472 L_ATCU_FrDrModDis "ATCU_FrontDriverModeDisplay";
CM_ SG_ 3221225472 L_ATCU_FrPassModDis "ATCU_FrontPassengerModeDisplay";
CM_ SG_ 3221225472 L_ATCU_FrDrBlwDis "ATCU_FrontDriverBlowerDisplay";
CM_ SG_ 3221225472 L_ATCU_FrPassBlwDis "ATCU_FrontPassengerBlowerDisplay";
CM_ SG_ 3221225472 L_ATCU_DrAutoDis "ATCU_DriverAutoDisplay";
CM_ SG_ 3221225472 L_ATCU_PassAutoDis "ATCU_PassengerAutoDisplay";
CM_ SG_ 3221225472 L_ATCU_DrMultiAutoBlwDis "ATCU_DriverMultiAutoBlowerDisplay";
CM_ SG_ 3221225472 L_ATCU_PassMultiAutoBlwDis "ATCU_PassengerMultiAutoBlowerDisplay";
CM_ SG_ 3221225472 L_ATCU_AcDis "ATCU_AcDisplay";
CM_ SG_ 3221225472 L_ATCU_IntakeDis "ATCU_IntakeDisplay";
CM_ SG_ 3221225472 L_ATCU_SyncDis "ATCU_SyncDisplay";
CM_ SG_ 3221225472 L_ATCU_FrDefDis "ATCU_FrontDefrostDisplay";
CM_ SG_ 3221225472 L_ATCU_PassTempCDis "ATCU_PassengerTemperatureDisplay(¡É)";
CM_ SG_ 3221225472 L_ATCU_DrOnlyDis "ATCU_DriverOnlyDisplay";
CM_ SG_ 3221225472 L_ATCU_SmrtVntDis "ATCU_SmartVentilationDisplay";
CM_ SG_ 3221225472 L_ATCU_FrWndShldHtInd "ATCU_FrontWindShieldHeaterIndicator";
CM_ SG_ 3221225472 L_ATCU_SchedClimate_EnIndSta "ScheduledClimate EnableIndicatorStatus";
CM_ SG_ 3221225472 L_ATCU_LanguageInfo "ATCU_LanguageInformation";
CM_ SG_ 3221225472 L_ATCU_RrDefInd "ATCU_RearDEFIndicator";
CM_ SG_ 3221225472 L_ATCU_AftBlwInfo "ATCU_AfterBlowerInformation";
CM_ SG_ 3221225472 L_ATCU_Reserve_Venti_Indi "ATCU_Reservation_Ventilation_Indicator";
CM_ SG_ 3221225472 L_ATCU_IncarMtrOnReq "ATCU_IncarMotorOnRequest";
CM_ SG_ 3221225472 L_ATCU_FLStHeatSwHInd "ATCU_FrontLeftSeatHeatSwitchHighIndicator";
CM_ SG_ 3221225472 L_ATCU_FLStHeatSwMInd "ATCU_FrontLeftSeatHeatSwitchMiddleIndicator";
CM_ SG_ 3221225472 L_ATCU_ADSBlinkDis "ATCU_ADSBlinkDisplay";
CM_ SG_ 3221225472 L_ATCU_FLStHeatSwLInd "ATCU_FrontLeftSeatHeatSwitchLowIndicator";
CM_ SG_ 3221225472 L_ATCU_FLStVntSwHInd "ATCU_FrontLeftSeatVentilationSwitchHighIndicator";
CM_ SG_ 3221225472 L_ATCU_FLStVntSwMInd "ATCU_FrontLeftSeatVentilationSwitchMiddleIndicator";
CM_ SG_ 3221225472 L_ATCU_FLStVntSwLInd "ATCU_FrontLeftSeatVentilationSwitchLowIndicator";
CM_ SG_ 3221225472 L_ATCU_FRStHeatSwHInd "ATCU_FrontRightSeatHeatSwitchHighIndicator";
CM_ SG_ 3221225472 L_ATCU_FRStHeatSwMInd "ATCU_FrontRightSeatHeatSwitchMiddleIndicator";
CM_ SG_ 3221225472 L_ATCU_FRStHeatSwLInd "ATCU_FrontRightSeatHeatSwitchLowIndicator";
CM_ SG_ 3221225472 L_ATCU_FRStVntSwHInd "ATCU_FrontRightSeatVentilationSwitchHighIndicator";
CM_ SG_ 3221225472 L_ATCU_FRStVntSwMInd "ATCU_FrontRightSeatVentilationSwitchMiddleIndicator";
CM_ SG_ 3221225472 L_ATCU_FRStVntSwLInd "ATCU_FrontRightSeatVentilationSwitchLowIndicator";
CM_ SG_ 3221225472 L_ATCU_StrWhlHeatInd "ATCU_SteeringWheelHeatIndicator";
CM_ SG_ 3221225472 L_ATCU_RhstaLvlSta "ATCU_RheostatLevelStatus";
CM_ SG_ 3221225472 L_ATCU_IntTailOnOff "ATCU_InternalTailOnOff";
CM_ SG_ 3221225472 L_ATCU_AutoLightSta "ATCU_AutoLightStatus";
CM_ SG_ 3221225472 L_ATCU_FrBckLightSta "ATCU_FrontBackLightStatus";
CM_ SG_ 3221225472 L_ATCU_ADSOffDis "ATCU_ADSOffDisplay";
CM_ SG_ 3221225472 L_ATCU_DisplayTheme "ATCU_DisplayTheme";
CM_ SG_ 3221225472 L_ATCU_GUIBlankDis "ATCU_GUIBlankDisplay";
CM_ SG_ 3221225472 L_ATCU_HptFdbckLvl "ATCU_HapticFeedbackLevel";
CM_ SG_ 3221225472 L_ATCU_TlltLmpDis "ATCU_TelltaleLampDisplay";
CM_ SG_ 3221225472 L_ATCU_AvTailOnOff "ATCU_AVTailOnOff";
CM_ SG_ 3221225472 L_ATCU_AirClnDis "ATCU_AirCleaningDisplay";
CM_ SG_ 3221225472 L_ATCU_CO2WrngDis "ATCU_CO2WarningDisplay";
CM_ SG_ 3221225472 L_2HKBD_RrDrModeDnSw "2HKBD_RearDriverModeDownSwitch";
CM_ SG_ 3221225472 L_2HKBD_RrDrModeUpSw "2HKBD_RearDriverModeUpSwitch";
CM_ SG_ 3221225472 L_2HKBD_RrDrAutoSw "2HKBD_RearDriverAutoSwitch";
CM_ SG_ 3221225472 L_2HKBD_Rr_OffSw "2HKBD_Rear_OffSwitch";
CM_ SG_ 3221225472 L_2HKBD_RrSyncSw "2HKBD_Rear_SyncSwitch";
CM_ SG_ 3221225472 L_2HKBD_RrAcSw "2HKBD_Rear_ACSwitch";
CM_ SG_ 3221225472 L_2HKBD_RLStHtrSwReq "2HKBD_RearLeftSeatHeaterSwitchRequest";
CM_ SG_ 3221225472 L_2HKBD_RLStVentSwReq "2HKBD_RearLeftSeatVentSwitchRequest";
CM_ SG_ 3221225472 L_2HKBD_RRStHtrSwReq "2HKBD_RearRightSeatHeaterSwitchRequest";
CM_ SG_ 3221225472 L_2HKBD_RRStVentSwReq "2HKBD_RearRightSeatVentSwitchRequest";
CM_ SG_ 3221225472 L_2HKBD_RrDrMultiAutoSw "2HKBD_RearDriverMultiAutoSwitch";
CM_ SG_ 3221225472 L_2HKBD_RrDrModeSw "2HKBD_RearDriverModeSwitch";
CM_ SG_ 3221225472 L_2HKBD_RrPsModeSw "2HKBD_RearPassengerModeSwitch";
CM_ SG_ 3221225472 L_2HKBD_RrPsModeDnSw "2HKBD_RearPassengerModeDownSwitch";
CM_ SG_ 3221225472 L_2HKBD_RrPsModeUpSw "2HKBD_RearPassengerModeUpSwitch";
CM_ SG_ 3221225472 L_2HKBD_RrPsModeVentSw "2HKBD_RearPassengerModeVentSwitch";
CM_ SG_ 3221225472 L_2HKBD_RrPsModeFloorSw "2HKBD_RearPassengerModeFloorSwitch";
CM_ SG_ 3221225472 L_2HKBD_RrPsModeBiLvlSw "2HKBD_RearPassengerModeBiLevelSwitch";
CM_ SG_ 3221225472 L_2HKBD_RrPsTempDnSw "2HKBD_RearPassengerTemperatureDownSwitch";
CM_ SG_ 3221225472 L_2HKBD_RrPsTempUpSw "2HKBD_RearPassengerTemperatureUpSwitch";
CM_ SG_ 3221225472 L_2HKBD_RrPsBlwUpSw "2HKBD_RearPassengerBlowerUpSwitch";
CM_ SG_ 3221225472 L_2HKBD_RrDRModeVentSw "2HKBD_RearDriverModeVentSwitch";
CM_ SG_ 3221225472 L_2HKBD_RrPsBlwDnSw "2HKBD_RearPassengerBlowerDownSwitch";
CM_ SG_ 3221225472 L_2HKBD_RrPsAutoSw "2HKBD_RearPassengerAutoSwitch";
CM_ SG_ 3221225472 L_2HKBD_RrPsMultiAutoSw "2HKBD_RearPassengerMultiAutoSwitch";
CM_ SG_ 3221225472 L_2HKBD_RrDrBlwDnOffSw "2HKBD_RearDriverBlowerDownOffSwitch";
CM_ SG_ 3221225472 L_2HKBD_RrPsBlwDnOffSw "2HKBD_ReaerPassengerBlowerDownOffSwitch";
CM_ SG_ 3221225472 L_2HKBD_RrOnOffSet "2HKBD_RearOnOffSet";
CM_ SG_ 3221225472 L_2HKBD_RrDrModeFloorSw "2HKBD_RearDriverModeFloorSwitch";
BA_DEF_ BO_  "UsrMsgIDSforwardDeviation" INT 0 100;
BA_DEF_ BO_  "UsrMsgIDSbackwardDeviation" INT 50 1000;
BA_DEF_  "BusType" STRING ;
BA_DEF_  "DBName" STRING ;
BA_DEF_  "Baudrate" INT 50000 1000000;
BA_DEF_  "GenEnvVarEndingDsp" STRING ;
BA_DEF_  "GenEnvVarEndingSnd" STRING ;
BA_DEF_  "GenEnvVarPrefix" STRING ;
BA_DEF_  "GenNWMApBusSleep" STRING ;
BA_DEF_  "GenNWMApCanNormal" STRING ;
BA_DEF_  "GenNWMApCanOff" STRING ;
BA_DEF_  "GenNWMApCanOn" STRING ;
BA_DEF_  "GenNWMApCanSleep" STRING ;
BA_DEF_  "GenNWMApCanWakeUp" STRING ;
BA_DEF_  "GenNWMGotoMode_Awake" STRING ;
BA_DEF_  "GenNWMGotoMode_BusSleep" STRING ;
BA_DEF_  "GenNWMSleepTime" INT 1375 1650;
BA_DEF_  "GenNWMTalkNM" STRING ;
BA_DEF_  "Manufacturer" STRING ;
BA_DEF_  "NmBaseAddress" HEX 0 2047;
BA_DEF_  "NmMessageCount" INT 0 128;
BA_DEF_  "NmType" STRING ;
BA_DEF_  "SamplePointMax" INT 50 85;
BA_DEF_  "SamplePointMin" INT 55 85;
BA_DEF_  "SyncJumpWidthMax" INT 1 8;
BA_DEF_  "SyncJumpWidthMin" INT 1 4;
BA_DEF_  "VersionDay" INT 1 31;
BA_DEF_  "VersionMonth" INT 1 12;
BA_DEF_  "VersionNumber" INT 0 999999;
BA_DEF_  "VersionNumberInternal" INT 0 9999;
BA_DEF_  "VersionWeek" INT 1 53;
BA_DEF_  "VersionYear" INT 0 9999;
BA_DEF_ BU_  "NmStationAddress" HEX 0 127;
BA_DEF_ BU_  "NmNode" ENUM  "No","Yes";
BA_DEF_ BU_  "GenNodSleepTime" INT 1375 1650;
BA_DEF_ BU_  "ILUsed" ENUM  "No","Yes";
BA_DEF_ BU_  "NmCAN" INT 1 2;
BA_DEF_ BU_  "NodeLayerModules" STRING ;
BA_DEF_ BU_  "NWM_Knoten" ENUM  "No","Yes";
BA_DEF_ BO_  "GenMsgCycleTime" INT 0 2000;
BA_DEF_ BO_  "GenMsgStartDelayTime" INT 0 2000;
BA_DEF_ BO_  "GenMsgSendType" ENUM  "Cyclic","NoMsgSendType";
BA_DEF_ BO_  "GenMsgCycleTimeFast" INT 0 500;
BA_DEF_ BO_  "GenMsgDelayTime" INT 0 20;
BA_DEF_ BO_  "GenMsgILSupport" ENUM  "No","Yes";
BA_DEF_ BO_  "GenMsgNrOfRepetition" INT 0 3;
BA_DEF_ BO_  "VFrameFormat" ENUM  "StandardCAN","ExtendedCAN","reserved","reserved","reserved","reserved","reserved","reserved","reserved","reserved","reserved","reserved","reserved","reserved","StandardCAN_FD","ExtendedCAN_FD";
BA_DEF_ SG_  "UserSigValidity" ENUM  "B+","ACC","IG","IG1","IG2","IG3","IG1 or IG2","IG1 or IG3","Undef";
BA_DEF_ SG_  "UsrSigPurpose" ENUM  "Undef","FN","DIAG","DIAG(Req)","DIAG(Res)","DIAG(Phy)","DEV","CCP(Req)","CCP(Res)","NM","TP";
BA_DEF_ SG_  "GenSigStartValue" INT 0 1215752192;
BA_DEF_ SG_  "NetworkRequestHoldingTime" INT 0 65535;
BA_DEF_ SG_  "Description" STRING ;
BA_DEF_ SG_  "Version" STRING ;
BA_DEF_ SG_  "GenSigEnvVarType" ENUM  "Int","Float","Undef";
BA_DEF_ SG_  "GenSigSendType" ENUM  "Cyclic","OnWrite","OnWriteWithRepetition","OnChange","OnChangeWithRepetition","IfActive","IfActiveWithRepetition","NoSigSendType","OnChangeAndIfActive","OnChangeAndIfActiveWithRepetition";
BA_DEF_ SG_  "GwSigLatencyTime" INT 0 65536;
BA_DEF_ SG_  "GwSigMissingSourceType" ENUM  "Undef","OldValue","DefaultValue","InitialValue";
BA_DEF_ SG_  "NWM-WakeupAllowed" ENUM  "<n.a.>";
BA_DEF_ SG_  "RoutingFactor" INT 1 1215752192;
BA_DEF_REL_ BU_SG_REL_  "GenSigTimeoutTime" INT 0 7000;
BA_DEF_DEF_  "UsrMsgIDSforwardDeviation" 10;
BA_DEF_DEF_  "UsrMsgIDSbackwardDeviation" 100;
BA_DEF_DEF_  "BusType" "CAN";
BA_DEF_DEF_  "DBName" "";
BA_DEF_DEF_  "Baudrate" 500000;
BA_DEF_DEF_  "GenEnvVarEndingDsp" "Dsp_";
BA_DEF_DEF_  "GenEnvVarEndingSnd" "_";
BA_DEF_DEF_  "GenEnvVarPrefix" "Env";
BA_DEF_DEF_  "GenNWMApBusSleep" "AppNmCanBusSleep()";
BA_DEF_DEF_  "GenNWMApCanNormal" "AppNmCanNormal()";
BA_DEF_DEF_  "GenNWMApCanOff" "ApplCanOffline()";
BA_DEF_DEF_  "GenNWMApCanOn" "ApplCanOnline()";
BA_DEF_DEF_  "GenNWMApCanSleep" "ApplNmCanSleep()";
BA_DEF_DEF_  "GenNWMApCanWakeUp" "ApplCanWakeUp()";
BA_DEF_DEF_  "GenNWMGotoMode_Awake" "GotoMode_Awake()";
BA_DEF_DEF_  "GenNWMGotoMode_BusSleep" "GotoMode_BusSleep()";
BA_DEF_DEF_  "GenNWMSleepTime" 1500;
BA_DEF_DEF_  "GenNWMTalkNM" "TalkNM()";
BA_DEF_DEF_  "Manufacturer" "HMC";
BA_DEF_DEF_  "NmBaseAddress" 1280;
BA_DEF_DEF_  "NmMessageCount" 128;
BA_DEF_DEF_  "NmType" "Vector";
BA_DEF_DEF_  "SamplePointMax" 80;
BA_DEF_DEF_  "SamplePointMin" 80;
BA_DEF_DEF_  "SyncJumpWidthMax" 3;
BA_DEF_DEF_  "SyncJumpWidthMin" 2;
BA_DEF_DEF_  "VersionDay" 1;
BA_DEF_DEF_  "VersionMonth" 1;
BA_DEF_DEF_  "VersionNumber" 0;
BA_DEF_DEF_  "VersionNumberInternal" 0;
BA_DEF_DEF_  "VersionWeek" 1;
BA_DEF_DEF_  "VersionYear" 0;
BA_DEF_DEF_  "NmStationAddress" 0;
BA_DEF_DEF_  "NmNode" "Yes";
BA_DEF_DEF_  "GenNodSleepTime" 1500;
BA_DEF_DEF_  "ILUsed" "Yes";
BA_DEF_DEF_  "NmCAN" 1;
BA_DEF_DEF_  "NodeLayerModules" "oseknm01.dll,CANoeILNLVector.dll";
BA_DEF_DEF_  "NWM_Knoten" "Yes";
BA_DEF_DEF_  "GenMsgCycleTime" 200;
BA_DEF_DEF_  "GenMsgStartDelayTime" 0;
BA_DEF_DEF_  "GenMsgSendType" "NoMsgSendType";
BA_DEF_DEF_  "GenMsgCycleTimeFast" 40;
BA_DEF_DEF_  "GenMsgDelayTime" 20;
BA_DEF_DEF_  "GenMsgILSupport" "Yes";
BA_DEF_DEF_  "GenMsgNrOfRepetition" 3;
BA_DEF_DEF_  "VFrameFormat" "StandardCAN";
BA_DEF_DEF_  "UserSigValidity" "IG";
BA_DEF_DEF_  "UsrSigPurpose" "FN";
BA_DEF_DEF_  "GenSigStartValue" 0;
BA_DEF_DEF_  "NetworkRequestHoldingTime" 0;
BA_DEF_DEF_  "Description" "";
BA_DEF_DEF_  "Version" "";
BA_DEF_DEF_  "GenSigEnvVarType" "Undef";
BA_DEF_DEF_  "GenSigSendType" "NoSigSendType";
BA_DEF_DEF_  "GwSigLatencyTime" 40;
BA_DEF_DEF_  "GwSigMissingSourceType" "Undef";
BA_DEF_DEF_  "NWM-WakeupAllowed" "<n.a.>";
BA_DEF_DEF_  "RoutingFactor" 1;
BA_DEF_DEF_REL_ "GenSigTimeoutTime" 500;
BA_ "VersionYear" 1;
BA_ "VersionNumber" 230902;
BA_ "DBName" "Local_HS";
BA_ "NmNode" BU_ L_3HKBD 0;
BA_ "NmNode" BU_ L_FHPTC 0;
BA_ "NmNode" BU_ L_ATCU 0;
BA_ "NmNode" BU_ L_2HKBD 0;
BA_ "NmNode" BU_ L_PCM 0;
BA_ "NmNode" BU_ L_HKBD 0;
BA_ "NmNode" BU_ L_RHPTC 0;
BA_ "GenSigSendType" SG_ 3221225472 HKBD_Fr_DrTempDnSw 4;
BA_ "UserSigValidity" SG_ 3221225472 HKBD_Fr_DrTempDnSw 7;
BA_ "Version" SG_ 3221225472 HKBD_Fr_DrTempDnSw "23.08.13";
BA_ "GenSigSendType" SG_ 3221225472 HKBD_Fr_DrTempUpSw 4;
BA_ "UserSigValidity" SG_ 3221225472 HKBD_Fr_DrTempUpSw 7;
BA_ "Version" SG_ 3221225472 HKBD_Fr_DrTempUpSw "23.08.13";
BA_ "GenSigSendType" SG_ 3221225472 HKBD_Fr_PsBlwDnSw 4;
BA_ "UserSigValidity" SG_ 3221225472 HKBD_Fr_PsBlwDnSw 7;
BA_ "Version" SG_ 3221225472 HKBD_Fr_PsBlwDnSw "23.08.13";
BA_ "GenSigSendType" SG_ 3221225472 HKBD_Fr_PsBlwDnOffSw 4;
BA_ "UserSigValidity" SG_ 3221225472 HKBD_Fr_PsBlwDnOffSw 7;
BA_ "Version" SG_ 3221225472 HKBD_Fr_PsBlwDnOffSw "23.08.13";
BA_ "GenSigSendType" SG_ 3221225472 HKBD_Fr_PsBlwUpSw 4;
BA_ "UserSigValidity" SG_ 3221225472 HKBD_Fr_PsBlwUpSw 7;
BA_ "Version" SG_ 3221225472 HKBD_Fr_PsBlwUpSw "23.08.13";
BA_ "GenSigSendType" SG_ 3221225472 HKBD_Fr_PsBlwSet 4;
BA_ "UserSigValidity" SG_ 3221225472 HKBD_Fr_PsBlwSet 7;
BA_ "Version" SG_ 3221225472 HKBD_Fr_PsBlwSet "23.08.13";
BA_ "GenSigSendType" SG_ 3221225472 HKBD_Fr_RrDrTempDnSw 4;
BA_ "UserSigValidity" SG_ 3221225472 HKBD_Fr_RrDrTempDnSw 7;
BA_ "Version" SG_ 3221225472 HKBD_Fr_RrDrTempDnSw "23.08.13";
BA_ "GenSigSendType" SG_ 3221225472 HKBD_Fr_RrDrTempUpSw 4;
BA_ "UserSigValidity" SG_ 3221225472 HKBD_Fr_RrDrTempUpSw 7;
BA_ "Version" SG_ 3221225472 HKBD_Fr_RrDrTempUpSw "23.08.13";
BA_ "GenSigSendType" SG_ 3221225472 HKBD_Fr_PsTempDnSw 4;
BA_ "UserSigValidity" SG_ 3221225472 HKBD_Fr_PsTempDnSw 7;
BA_ "Version" SG_ 3221225472 HKBD_Fr_PsTempDnSw "23.08.13";
BA_ "GenSigSendType" SG_ 3221225472 HKBD_Fr_RrDrBlwDnSw 4;
BA_ "UserSigValidity" SG_ 3221225472 HKBD_Fr_RrDrBlwDnSw 7;
BA_ "Version" SG_ 3221225472 HKBD_Fr_RrDrBlwDnSw "23.08.13";
BA_ "GenSigSendType" SG_ 3221225472 HKBD_Fr_RrDrBlwDnOffSw 4;
BA_ "UserSigValidity" SG_ 3221225472 HKBD_Fr_RrDrBlwDnOffSw 7;
BA_ "Version" SG_ 3221225472 HKBD_Fr_RrDrBlwDnOffSw "23.08.13";
BA_ "GenSigSendType" SG_ 3221225472 HKBD_Fr_RrDrBlwUpSw 4;
BA_ "UserSigValidity" SG_ 3221225472 HKBD_Fr_RrDrBlwUpSw 7;
BA_ "Version" SG_ 3221225472 HKBD_Fr_RrDrBlwUpSw "23.08.13";
BA_ "GenSigSendType" SG_ 3221225472 HKBD_Fr_RrDrBlwSet 4;
BA_ "UserSigValidity" SG_ 3221225472 HKBD_Fr_RrDrBlwSet 7;
BA_ "Version" SG_ 3221225472 HKBD_Fr_RrDrBlwSet "23.08.13";
BA_ "GenSigSendType" SG_ 3221225472 HKBD_Fr_RrDrModDnSw 4;
BA_ "UserSigValidity" SG_ 3221225472 HKBD_Fr_RrDrModDnSw 7;
BA_ "Version" SG_ 3221225472 HKBD_Fr_RrDrModDnSw "23.08.13";
BA_ "GenSigSendType" SG_ 3221225472 HKBD_Fr_RrDrModUpSw 4;
BA_ "UserSigValidity" SG_ 3221225472 HKBD_Fr_RrDrModUpSw 7;
BA_ "Version" SG_ 3221225472 HKBD_Fr_RrDrModUpSw "23.08.13";
BA_ "GenSigSendType" SG_ 3221225472 HKBD_Fr_RrDrModVntSw 4;
BA_ "UserSigValidity" SG_ 3221225472 HKBD_Fr_RrDrModVntSw 7;
BA_ "Version" SG_ 3221225472 HKBD_Fr_RrDrModVntSw "23.08.13";
BA_ "GenSigSendType" SG_ 3221225472 HKBD_Fr_PsTempUpSw 4;
BA_ "UserSigValidity" SG_ 3221225472 HKBD_Fr_PsTempUpSw 7;
BA_ "Version" SG_ 3221225472 HKBD_Fr_PsTempUpSw "23.08.13";
BA_ "GenSigSendType" SG_ 3221225472 HKBD_Fr_RrDrModFlrSw 4;
BA_ "UserSigValidity" SG_ 3221225472 HKBD_Fr_RrDrModFlrSw 7;
BA_ "Version" SG_ 3221225472 HKBD_Fr_RrDrModFlrSw "23.08.13";
BA_ "GenSigSendType" SG_ 3221225472 HKBD_Fr_RrDrModBiLvlSw 4;
BA_ "UserSigValidity" SG_ 3221225472 HKBD_Fr_RrDrModBiLvlSw 7;
BA_ "Version" SG_ 3221225472 HKBD_Fr_RrDrModBiLvlSw "23.08.13";
BA_ "GenSigSendType" SG_ 3221225472 HKBD_Fr_RrDrAutoSw 4;
BA_ "UserSigValidity" SG_ 3221225472 HKBD_Fr_RrDrAutoSw 7;
BA_ "Version" SG_ 3221225472 HKBD_Fr_RrDrAutoSw "23.08.13";
BA_ "GenSigSendType" SG_ 3221225472 HKBD_Fr_RrDrMultiAutoSw 4;
BA_ "UserSigValidity" SG_ 3221225472 HKBD_Fr_RrDrMultiAutoSw 7;
BA_ "Version" SG_ 3221225472 HKBD_Fr_RrDrMultiAutoSw "23.08.13";
BA_ "GenSigSendType" SG_ 3221225472 HKBD_Fr_RrOffSw 4;
BA_ "UserSigValidity" SG_ 3221225472 HKBD_Fr_RrOffSw 7;
BA_ "Version" SG_ 3221225472 HKBD_Fr_RrOffSw "23.08.13";
BA_ "GenSigSendType" SG_ 3221225472 HKBD_Fr_RrSyncSw 4;
BA_ "UserSigValidity" SG_ 3221225472 HKBD_Fr_RrSyncSw 7;
BA_ "Version" SG_ 3221225472 HKBD_Fr_RrSyncSw "23.08.13";
BA_ "GenSigSendType" SG_ 3221225472 HKBD_Fr_RLStHeatSw 4;
BA_ "UserSigValidity" SG_ 3221225472 HKBD_Fr_RLStHeatSw 7;
BA_ "Version" SG_ 3221225472 HKBD_Fr_RLStHeatSw "23.08.13";
BA_ "GenSigSendType" SG_ 3221225472 HKBD_Fr_RLStVentSw 4;
BA_ "UserSigValidity" SG_ 3221225472 HKBD_Fr_RLStVentSw 7;
BA_ "Version" SG_ 3221225472 HKBD_Fr_RLStVentSw "23.08.13";
BA_ "GenSigSendType" SG_ 3221225472 HKBD_Fr_DrBlwDnSw 4;
BA_ "UserSigValidity" SG_ 3221225472 HKBD_Fr_DrBlwDnSw 7;
BA_ "Version" SG_ 3221225472 HKBD_Fr_DrBlwDnSw "23.08.13";
BA_ "GenSigSendType" SG_ 3221225472 HKBD_Fr_RRStHeatSw 4;
BA_ "UserSigValidity" SG_ 3221225472 HKBD_Fr_RRStHeatSw 7;
BA_ "Version" SG_ 3221225472 HKBD_Fr_RRStHeatSw "23.08.13";
BA_ "GenSigSendType" SG_ 3221225472 HKBD_Fr_RRStVentSw 4;
BA_ "UserSigValidity" SG_ 3221225472 HKBD_Fr_RRStVentSw 7;
BA_ "Version" SG_ 3221225472 HKBD_Fr_RRStVentSw "23.08.13";
BA_ "GenSigSendType" SG_ 3221225472 HKBD_Fr_RLStTumblrSw 4;
BA_ "UserSigValidity" SG_ 3221225472 HKBD_Fr_RLStTumblrSw 7;
BA_ "Version" SG_ 3221225472 HKBD_Fr_RLStTumblrSw "23.08.13";
BA_ "GenSigSendType" SG_ 3221225472 HKBD_Fr_RRStTumblrSw 4;
BA_ "UserSigValidity" SG_ 3221225472 HKBD_Fr_RRStTumblrSw 7;
BA_ "Version" SG_ 3221225472 HKBD_Fr_RRStTumblrSw "23.08.13";
BA_ "GenSigSendType" SG_ 3221225472 HKBD_Fr_RrPsModDnSw 4;
BA_ "UserSigValidity" SG_ 3221225472 HKBD_Fr_RrPsModDnSw 7;
BA_ "Version" SG_ 3221225472 HKBD_Fr_RrPsModDnSw "23.08.13";
BA_ "GenSigSendType" SG_ 3221225472 HKBD_Fr_RrPsModUpSw 4;
BA_ "UserSigValidity" SG_ 3221225472 HKBD_Fr_RrPsModUpSw 7;
BA_ "Version" SG_ 3221225472 HKBD_Fr_RrPsModUpSw "23.08.13";
BA_ "GenSigSendType" SG_ 3221225472 HKBD_Fr_RrPsModVntSw 4;
BA_ "UserSigValidity" SG_ 3221225472 HKBD_Fr_RrPsModVntSw 7;
BA_ "Version" SG_ 3221225472 HKBD_Fr_RrPsModVntSw "23.08.13";
BA_ "GenSigSendType" SG_ 3221225472 HKBD_Fr_RrPsModFlrSw 4;
BA_ "UserSigValidity" SG_ 3221225472 HKBD_Fr_RrPsModFlrSw 7;
BA_ "Version" SG_ 3221225472 HKBD_Fr_RrPsModFlrSw "23.08.13";
BA_ "GenSigSendType" SG_ 3221225472 HKBD_Fr_DrBlwDnOffSw 4;
BA_ "UserSigValidity" SG_ 3221225472 HKBD_Fr_DrBlwDnOffSw 7;
BA_ "Version" SG_ 3221225472 HKBD_Fr_DrBlwDnOffSw "23.08.13";
BA_ "GenSigSendType" SG_ 3221225472 HKBD_Fr_RrLockSw 4;
BA_ "UserSigValidity" SG_ 3221225472 HKBD_Fr_RrLockSw 7;
BA_ "Version" SG_ 3221225472 HKBD_Fr_RrLockSw "23.08.13";
BA_ "GenSigSendType" SG_ 3221225472 HKBD_Fr_RrPsModBiLvlSw 4;
BA_ "UserSigValidity" SG_ 3221225472 HKBD_Fr_RrPsModBiLvlSw 7;
BA_ "Version" SG_ 3221225472 HKBD_Fr_RrPsModBiLvlSw "23.08.13";
BA_ "GenSigSendType" SG_ 3221225472 HKBD_Fr_RrDrModSw 4;
BA_ "UserSigValidity" SG_ 3221225472 HKBD_Fr_RrDrModSw 7;
BA_ "Version" SG_ 3221225472 HKBD_Fr_RrDrModSw "23.08.13";
BA_ "GenSigSendType" SG_ 3221225472 HKBD_Fr_RrPsModSw 4;
BA_ "UserSigValidity" SG_ 3221225472 HKBD_Fr_RrPsModSw 7;
BA_ "Version" SG_ 3221225472 HKBD_Fr_RrPsModSw "23.08.13";
BA_ "GenSigSendType" SG_ 3221225472 HKBD_Fr_RrPsBlwSet 4;
BA_ "UserSigValidity" SG_ 3221225472 HKBD_Fr_RrPsBlwSet 7;
BA_ "Version" SG_ 3221225472 HKBD_Fr_RrPsBlwSet "23.08.13";
BA_ "GenSigSendType" SG_ 3221225472 HKBD_Fr_RrPsBlwUpSw 4;
BA_ "UserSigValidity" SG_ 3221225472 HKBD_Fr_RrPsBlwUpSw 7;
BA_ "Version" SG_ 3221225472 HKBD_Fr_RrPsBlwUpSw "23.08.13";
BA_ "GenSigSendType" SG_ 3221225472 HKBD_Fr_RrPsBlwDnSw 4;
BA_ "UserSigValidity" SG_ 3221225472 HKBD_Fr_RrPsBlwDnSw 7;
BA_ "Version" SG_ 3221225472 HKBD_Fr_RrPsBlwDnSw "23.08.13";
BA_ "GenSigSendType" SG_ 3221225472 HKBD_Fr_DrBlwUpSw 4;
BA_ "UserSigValidity" SG_ 3221225472 HKBD_Fr_DrBlwUpSw 7;
BA_ "Version" SG_ 3221225472 HKBD_Fr_DrBlwUpSw "23.08.13";
BA_ "GenSigSendType" SG_ 3221225472 HKBD_Fr_RrPsBlwDnOffSw 4;
BA_ "UserSigValidity" SG_ 3221225472 HKBD_Fr_RrPsBlwDnOffSw 7;
BA_ "Version" SG_ 3221225472 HKBD_Fr_RrPsBlwDnOffSw "23.08.13";
BA_ "GenSigSendType" SG_ 3221225472 HKBD_Fr_RrPsTempDnSw 4;
BA_ "UserSigValidity" SG_ 3221225472 HKBD_Fr_RrPsTempDnSw 7;
BA_ "Version" SG_ 3221225472 HKBD_Fr_RrPsTempDnSw "23.08.13";
BA_ "GenSigSendType" SG_ 3221225472 HKBD_Fr_RrPsTempUpSw 4;
BA_ "UserSigValidity" SG_ 3221225472 HKBD_Fr_RrPsTempUpSw 7;
BA_ "Version" SG_ 3221225472 HKBD_Fr_RrPsTempUpSw "23.08.13";
BA_ "GenSigSendType" SG_ 3221225472 HKBD_Fr_DrBlwSet 4;
BA_ "UserSigValidity" SG_ 3221225472 HKBD_Fr_DrBlwSet 7;
BA_ "Version" SG_ 3221225472 HKBD_Fr_DrBlwSet "23.08.13";
BA_ "UserSigValidity" SG_ 3221225472 L_ATCU_PCMActTgtPos 7;
BA_ "Version" SG_ 3221225472 L_ATCU_PCMActTgtPos "23.08.13";
BA_ "UserSigValidity" SG_ 3221225472 L_ATCU_VehPowerIGN2 7;
BA_ "Version" SG_ 3221225472 L_ATCU_VehPowerIGN2 "23.08.13";
BA_ "UserSigValidity" SG_ 3221225472 L_ATCU_VehPowerISGB 7;
BA_ "Version" SG_ 3221225472 L_ATCU_VehPowerISGB "23.08.13";
BA_ "Description" SG_ 3221225472 L_ATCU_Blwr1TgtSpd "0x0:On - Level #0 (0% - Off) 

 0x1:On - Level #1 ( 10% )

 0x2:On - Level #2 ( 20% )

 0x3:On - Level #3 ( 30% )

 0x4:On - Level #4 ( 40% )

 0x5:On - Level #5 ( 50% )

 0x6:On - Level #6 ( 60% )

 0x7:On - Level #7 ( 70% )

 0x8:On - Level #8 ( 80% )

";
BA_ "UserSigValidity" SG_ 3221225472 L_ATCU_Blwr1TgtSpd 7;
BA_ "Version" SG_ 3221225472 L_ATCU_Blwr1TgtSpd "23.08.13";
BA_ "Description" SG_ 3221225472 L_ATCU_Blwr2TgtSpd "0x0:On - Level #0 (0% - Off) 

 0x1:On - Level #1 ( 10% )

 0x2:On - Level #2 ( 20% )

 0x3:On - Level #3 ( 30% )

 0x4:On - Level #4 ( 40% )

 0x5:On - Level #5 ( 50% )

 0x6:On - Level #6 ( 60% )

 0x7:On - Level #7 ( 70% )

 0x8:On - Level #8 ( 80% )

";
BA_ "UserSigValidity" SG_ 3221225472 L_ATCU_Blwr2TgtSpd 7;
BA_ "Version" SG_ 3221225472 L_ATCU_Blwr2TgtSpd "23.08.13";
BA_ "Description" SG_ 3221225472 L_ATCU_CurrentDy "0x0:RESERVED ( not used )

 0x1 ~ 1xF:1 ~ 31

 0x2F ~ 0xFD:RESERVED

 0xFE:Factory reset

 0xFF:Error Indicator";
BA_ "UserSigValidity" SG_ 3221225472 L_ATCU_CurrentDy 7;
BA_ "Version" SG_ 3221225472 L_ATCU_CurrentDy "23.08.13";
BA_ "Description" SG_ 3221225472 L_ATCU_CurrentMon "0x0:RESERVED ( not used )

 0x1 ~ 0xC:Jan ~ Dec

 0xD ~ 0xE:RESERVED

 0xF:Error Indicator";
BA_ "UserSigValidity" SG_ 3221225472 L_ATCU_CurrentMon 7;
BA_ "Version" SG_ 3221225472 L_ATCU_CurrentMon "23.08.13";
BA_ "Description" SG_ 3221225472 L_ATCU_CurrentYrPre "0x0:19

 0x1:20

 0x2:21

 0x3:Factory reset

 0x4:Error Indicator

( Initial Value:0x0)";
BA_ "UserSigValidity" SG_ 3221225472 L_ATCU_CurrentYrPre 7;
BA_ "Version" SG_ 3221225472 L_ATCU_CurrentYrPre "23.08.13";
BA_ "Description" SG_ 3221225472 L_ATCU_CurrentYrPost "0x0 ~ 0x63:Year

 0x64 ~ 0xFD:RESERVED

 0xFE:Factory reset

 0xFF:Error Indicator";
BA_ "UserSigValidity" SG_ 3221225472 L_ATCU_CurrentYrPost 7;
BA_ "Version" SG_ 3221225472 L_ATCU_CurrentYrPost "23.08.13";
BA_ "UserSigValidity" SG_ 3221225472 L_ATCU_PCMActTgtSpd 7;
BA_ "Version" SG_ 3221225472 L_ATCU_PCMActTgtSpd "23.08.13";
BA_ "UserSigValidity" SG_ 3221225472 L_ATCU_VehPowerBatt 7;
BA_ "Version" SG_ 3221225472 L_ATCU_VehPowerBatt "23.08.13";
BA_ "UserSigValidity" SG_ 3221225472 L_ATCU_VehPowerIGN1_3 7;
BA_ "Version" SG_ 3221225472 L_ATCU_VehPowerIGN1_3 "23.08.13";
BA_ "GenSigSendType" SG_ 3221225472 HKBD_Fr_3rdRrTempDnSw 4;
BA_ "UserSigValidity" SG_ 3221225472 HKBD_Fr_3rdRrTempDnSw 7;
BA_ "Version" SG_ 3221225472 HKBD_Fr_3rdRrTempDnSw "23.08.13";
BA_ "GenSigSendType" SG_ 3221225472 HKBD_Fr_3rdRrTempUpSw 4;
BA_ "UserSigValidity" SG_ 3221225472 HKBD_Fr_3rdRrTempUpSw 7;
BA_ "Version" SG_ 3221225472 HKBD_Fr_3rdRrTempUpSw "23.08.13";
BA_ "GenSigSendType" SG_ 3221225472 HKBD_Fr_3rdRrModUpSw 4;
BA_ "UserSigValidity" SG_ 3221225472 HKBD_Fr_3rdRrModUpSw 7;
BA_ "Version" SG_ 3221225472 HKBD_Fr_3rdRrModUpSw "23.08.13";
BA_ "GenSigSendType" SG_ 3221225472 HKBD_Fr_3rdRrModVntSw 4;
BA_ "UserSigValidity" SG_ 3221225472 HKBD_Fr_3rdRrModVntSw 7;
BA_ "Version" SG_ 3221225472 HKBD_Fr_3rdRrModVntSw "23.08.13";
BA_ "GenSigSendType" SG_ 3221225472 HKBD_Fr_3rdRrModFlrSw 4;
BA_ "UserSigValidity" SG_ 3221225472 HKBD_Fr_3rdRrModFlrSw 7;
BA_ "Version" SG_ 3221225472 HKBD_Fr_3rdRrModFlrSw "23.08.13";
BA_ "GenSigSendType" SG_ 3221225472 HKBD_Fr_3rdRrAutoSw 4;
BA_ "UserSigValidity" SG_ 3221225472 HKBD_Fr_3rdRrAutoSw 7;
BA_ "Version" SG_ 3221225472 HKBD_Fr_3rdRrAutoSw "23.08.13";
BA_ "GenSigSendType" SG_ 3221225472 HKBD_Fr_3rdRrMultiAutoSw 4;
BA_ "UserSigValidity" SG_ 3221225472 HKBD_Fr_3rdRrMultiAutoSw 7;
BA_ "Version" SG_ 3221225472 HKBD_Fr_3rdRrMultiAutoSw "23.08.13";
BA_ "GenSigSendType" SG_ 3221225472 HKBD_Fr_3rdRrOffSw 4;
BA_ "UserSigValidity" SG_ 3221225472 HKBD_Fr_3rdRrOffSw 7;
BA_ "Version" SG_ 3221225472 HKBD_Fr_3rdRrOffSw "23.08.13";
BA_ "GenSigSendType" SG_ 3221225472 HKBD_Fr_3rdRrSyncSw 4;
BA_ "UserSigValidity" SG_ 3221225472 HKBD_Fr_3rdRrSyncSw 7;
BA_ "Version" SG_ 3221225472 HKBD_Fr_3rdRrSyncSw "23.08.13";
BA_ "GenSigSendType" SG_ 3221225472 HKBD_Fr_3rdRrLockSw 4;
BA_ "UserSigValidity" SG_ 3221225472 HKBD_Fr_3rdRrLockSw 7;
BA_ "Version" SG_ 3221225472 HKBD_Fr_3rdRrLockSw "23.08.13";
BA_ "GenSigSendType" SG_ 3221225472 HKBD_Fr_3rdRrBlwDnSw 4;
BA_ "UserSigValidity" SG_ 3221225472 HKBD_Fr_3rdRrBlwDnSw 7;
BA_ "Version" SG_ 3221225472 HKBD_Fr_3rdRrBlwDnSw "23.08.13";
BA_ "GenSigSendType" SG_ 3221225472 HKBD_Fr_3rdRrModBiLvlSw 4;
BA_ "UserSigValidity" SG_ 3221225472 HKBD_Fr_3rdRrModBiLvlSw 7;
BA_ "Version" SG_ 3221225472 HKBD_Fr_3rdRrModBiLvlSw "23.08.13";
BA_ "GenSigSendType" SG_ 3221225472 HKBD_FrRrTglSet 4;
BA_ "UserSigValidity" SG_ 3221225472 HKBD_FrRrTglSet 7;
BA_ "Version" SG_ 3221225472 HKBD_FrRrTglSet "23.08.13";
BA_ "GenSigSendType" SG_ 3221225472 HKBD_FrRrScrnSet 4;
BA_ "UserSigValidity" SG_ 3221225472 HKBD_FrRrScrnSet 7;
BA_ "Version" SG_ 3221225472 HKBD_FrRrScrnSet "23.08.13";
BA_ "GenSigSendType" SG_ 3221225472 HKBD_Fr_OnOffSet 4;
BA_ "UserSigValidity" SG_ 3221225472 HKBD_Fr_OnOffSet 7;
BA_ "Version" SG_ 3221225472 HKBD_Fr_OnOffSet "23.08.13";
BA_ "GenSigSendType" SG_ 3221225472 HKBD_Fr_RrOnOffSet 4;
BA_ "UserSigValidity" SG_ 3221225472 HKBD_Fr_RrOnOffSet 7;
BA_ "Version" SG_ 3221225472 HKBD_Fr_RrOnOffSet "23.08.13";
BA_ "GenSigSendType" SG_ 3221225472 HKBD_Fr_3rdRrOnOffSet 4;
BA_ "UserSigValidity" SG_ 3221225472 HKBD_Fr_3rdRrOnOffSet 7;
BA_ "Version" SG_ 3221225472 HKBD_Fr_3rdRrOnOffSet "23.08.13";
BA_ "GenSigSendType" SG_ 3221225472 HKBD_Fr_3rdRrBlwDnOffSw 4;
BA_ "UserSigValidity" SG_ 3221225472 HKBD_Fr_3rdRrBlwDnOffSw 7;
BA_ "Version" SG_ 3221225472 HKBD_Fr_3rdRrBlwDnOffSw "23.08.13";
BA_ "GenSigSendType" SG_ 3221225472 HKBD_Fr_RrPsAutoSw 4;
BA_ "UserSigValidity" SG_ 3221225472 HKBD_Fr_RrPsAutoSw 7;
BA_ "Version" SG_ 3221225472 HKBD_Fr_RrPsAutoSw "23.08.13";
BA_ "GenSigSendType" SG_ 3221225472 HKBD_Fr_RrPsMultiAutoSw 4;
BA_ "UserSigValidity" SG_ 3221225472 HKBD_Fr_RrPsMultiAutoSw 7;
BA_ "Version" SG_ 3221225472 HKBD_Fr_RrPsMultiAutoSw "23.08.13";
BA_ "GenSigSendType" SG_ 3221225472 HKBD_Fr_3rdRrModSw 4;
BA_ "UserSigValidity" SG_ 3221225472 HKBD_Fr_3rdRrModSw 7;
BA_ "Version" SG_ 3221225472 HKBD_Fr_3rdRrModSw "23.08.13";
BA_ "GenSigSendType" SG_ 3221225472 HKBD_Fr_3rdRrBlwUpSw 4;
BA_ "UserSigValidity" SG_ 3221225472 HKBD_Fr_3rdRrBlwUpSw 7;
BA_ "Version" SG_ 3221225472 HKBD_Fr_3rdRrBlwUpSw "23.08.13";
BA_ "GenSigSendType" SG_ 3221225472 HKBD_Fr_3rdRrBlwSet 4;
BA_ "UserSigValidity" SG_ 3221225472 HKBD_Fr_3rdRrBlwSet 7;
BA_ "Version" SG_ 3221225472 HKBD_Fr_3rdRrBlwSet "23.08.13";
BA_ "GenSigSendType" SG_ 3221225472 HKBD_Fr_3rdRrModDnSw 4;
BA_ "UserSigValidity" SG_ 3221225472 HKBD_Fr_3rdRrModDnSw 7;
BA_ "Version" SG_ 3221225472 HKBD_Fr_3rdRrModDnSw "23.08.13";
BA_ "Description" SG_ 3221225472 HKBD_SwBtnTyp "Each bit for button type is defined as

0-None/1-Hardkey/2-Touch(Used Beep)/3-Touch(Not Used Beep)

Bit 0~1 (Temp Button)/Bit 2~3 (Blower Button)/Bit 4~5 (Mode Button)/Bit 6~7 (Auto Button)/Bit 8~9 (A/C Button)

Bit 10~11 (Def Button)/Bit 12~13 (Intake B";
BA_ "GenSigSendType" SG_ 3221225472 HKBD_SwBtnTyp 4;
BA_ "UserSigValidity" SG_ 3221225472 HKBD_SwBtnTyp 7;
BA_ "Version" SG_ 3221225472 HKBD_SwBtnTyp "23.09.00";
BA_ "GenSigSendType" SG_ 3221225472 HKBD_Fr_RrDrTempClickCnt 4;
BA_ "UserSigValidity" SG_ 3221225472 HKBD_Fr_RrDrTempClickCnt 7;
BA_ "Version" SG_ 3221225472 HKBD_Fr_RrDrTempClickCnt "23.08.13";
BA_ "GenSigSendType" SG_ 3221225472 HKBD_Fr_RrPsTempClickCnt 4;
BA_ "UserSigValidity" SG_ 3221225472 HKBD_Fr_RrPsTempClickCnt 7;
BA_ "Version" SG_ 3221225472 HKBD_Fr_RrPsTempClickCnt "23.08.13";
BA_ "GenSigSendType" SG_ 3221225472 HKBD_Fr_RrPsBlwClickCnt 4;
BA_ "UserSigValidity" SG_ 3221225472 HKBD_Fr_RrPsBlwClickCnt 7;
BA_ "Version" SG_ 3221225472 HKBD_Fr_RrPsBlwClickCnt "23.08.13";
BA_ "GenSigSendType" SG_ 3221225472 HKBD_Fr_3rdRrTempClickCnt 4;
BA_ "UserSigValidity" SG_ 3221225472 HKBD_Fr_3rdRrTempClickCnt 7;
BA_ "Version" SG_ 3221225472 HKBD_Fr_3rdRrTempClickCnt "23.08.13";
BA_ "GenSigSendType" SG_ 3221225472 HKBD_Fr_3rdRrBlwClickCnt 4;
BA_ "UserSigValidity" SG_ 3221225472 HKBD_Fr_3rdRrBlwClickCnt 7;
BA_ "Version" SG_ 3221225472 HKBD_Fr_3rdRrBlwClickCnt "23.08.13";
BA_ "GenSigSendType" SG_ 3221225472 HKBD_Fr_RrTempKnobCnt 4;
BA_ "UserSigValidity" SG_ 3221225472 HKBD_Fr_RrTempKnobCnt 7;
BA_ "Version" SG_ 3221225472 HKBD_Fr_RrTempKnobCnt "23.08.13";
BA_ "GenSigSendType" SG_ 3221225472 HKBD_Fr_RrBlwKnobCnt 4;
BA_ "UserSigValidity" SG_ 3221225472 HKBD_Fr_RrBlwKnobCnt 7;
BA_ "Version" SG_ 3221225472 HKBD_Fr_RrBlwKnobCnt "23.08.13";
BA_ "GenSigSendType" SG_ 3221225472 HKBD_Fr_3rdTempKnobCnt 4;
BA_ "UserSigValidity" SG_ 3221225472 HKBD_Fr_3rdTempKnobCnt 7;
BA_ "Version" SG_ 3221225472 HKBD_Fr_3rdTempKnobCnt "23.08.13";
BA_ "GenSigSendType" SG_ 3221225472 HKBD_Fr_3rdBlwKnobCnt 4;
BA_ "UserSigValidity" SG_ 3221225472 HKBD_Fr_3rdBlwKnobCnt 7;
BA_ "Version" SG_ 3221225472 HKBD_Fr_3rdBlwKnobCnt "23.08.13";
BA_ "GenSigSendType" SG_ 3221225472 HKBD_Fr_RrDrBlwClickCnt 4;
BA_ "UserSigValidity" SG_ 3221225472 HKBD_Fr_RrDrBlwClickCnt 7;
BA_ "Version" SG_ 3221225472 HKBD_Fr_RrDrBlwClickCnt "23.08.13";
BA_ "Description" SG_ 3221225472 HKBD_SwOpt1 "Bit 0~1 (SeatWarm) 0 - None/1 - 2Step/2 - 3Step/3 - Invaild

Bit 2~3 (SeatVent) 0 - None/1 - 2Step/2- 3Step/3 - Invaild

Bit 4~5 (StrWheelWarm) 0 - None/1 - 1Step/2 - 2 Step/3 - invaild";
BA_ "GenSigSendType" SG_ 3221225472 HKBD_SwOpt1 4;
BA_ "UserSigValidity" SG_ 3221225472 HKBD_SwOpt1 7;
BA_ "Version" SG_ 3221225472 HKBD_SwOpt1 "23.08.13";
BA_ "GenSigSendType" SG_ 3221225472 HKBD_GatewayMode 4;
BA_ "UserSigValidity" SG_ 3221225472 HKBD_GatewayMode 7;
BA_ "Version" SG_ 3221225472 HKBD_GatewayMode "23.08.13";
BA_ "Description" SG_ 3221225472 HKBD_Typ1 "Bit0 (Climate Display Side):0 ? Left Side /1 ? Right Side

Bit1 (LCD/NON LCD TYPE): 0- NON LCD/1- LCD TYPE

Bit2~3 (Button Type):0 - HardKey (Push-Return)/1- Touch/2- HardKey + Touch/3 - RESERVED 

Bit4~5 (Button Arragement Type):0 ? Single (Blower-Temp-";
BA_ "GenSigSendType" SG_ 3221225472 HKBD_Typ1 4;
BA_ "UserSigValidity" SG_ 3221225472 HKBD_Typ1 7;
BA_ "Version" SG_ 3221225472 HKBD_Typ1 "23.08.13";
BA_ "Description" SG_ 3221225472 HKBD_Typ2 "Bit0 (Mode Def Type):0 ? Symbol Type/1 ? Arrow Type

Bit1 (Air Purifier Button):0 - None/1 - AIR PURIFIER BUTTON APPLIED

Bit2 (Haptic):0 - None/1 - Applied 

Bit3 (Multi Auto Button Type) :  0 - Push / 1 - Tumbler 

Bit4~ 5 (Climate OSD UI Type) : 0 - N";
BA_ "GenSigSendType" SG_ 3221225472 HKBD_Typ2 4;
BA_ "UserSigValidity" SG_ 3221225472 HKBD_Typ2 7;
BA_ "Version" SG_ 3221225472 HKBD_Typ2 "23.08.13";
BA_ "Description" SG_ 3221225472 HKBD_Typ3 "Bit0~1 (Dr AUTO Step) :0 ? None/1 ? Single(On/Off)/2 ? 2 Step Type (High/Low/Off)/3 ? 3 Step Type(High/Medium/Low/Off)

Bit2~3 (Front Multi Auto Text):0 - Multi Auto State Text Not Applied/1 - Multi Auto State Text Display Only Applied/2 - Multi Auto Sta";
BA_ "GenSigSendType" SG_ 3221225472 HKBD_Typ3 4;
BA_ "UserSigValidity" SG_ 3221225472 HKBD_Typ3 7;
BA_ "Version" SG_ 3221225472 HKBD_Typ3 "23.08.13";
BA_ "Description" SG_ 3221225472 HKBD_SwOpt2 "Bit 0 (FRWndShldHt):0 - Not Apllied/1 - Applied 

Bit 1~5:Reserved";
BA_ "GenSigSendType" SG_ 3221225472 HKBD_SwOpt2 4;
BA_ "UserSigValidity" SG_ 3221225472 HKBD_SwOpt2 7;
BA_ "Version" SG_ 3221225472 HKBD_SwOpt2 "23.08.13";
BA_ "GenSigSendType" SG_ 3221225472 HKBD_Fr_DrModDnSw 4;
BA_ "UserSigValidity" SG_ 3221225472 HKBD_Fr_DrModDnSw 7;
BA_ "Version" SG_ 3221225472 HKBD_Fr_DrModDnSw "23.08.13";
BA_ "GenSigSendType" SG_ 3221225472 HKBD_Fr_DrModUpSw 4;
BA_ "UserSigValidity" SG_ 3221225472 HKBD_Fr_DrModUpSw 7;
BA_ "Version" SG_ 3221225472 HKBD_Fr_DrModUpSw "23.08.13";
BA_ "GenSigSendType" SG_ 3221225472 HKBD_Fr_DrMultiAutoSw 4;
BA_ "UserSigValidity" SG_ 3221225472 HKBD_Fr_DrMultiAutoSw 7;
BA_ "Version" SG_ 3221225472 HKBD_Fr_DrMultiAutoSw "23.08.13";
BA_ "GenSigSendType" SG_ 3221225472 HKBD_Fr_PsAutoSw 4;
BA_ "UserSigValidity" SG_ 3221225472 HKBD_Fr_PsAutoSw 7;
BA_ "Version" SG_ 3221225472 HKBD_Fr_PsAutoSw "23.08.13";
BA_ "GenSigSendType" SG_ 3221225472 HKBD_Fr_PsMultiAutoSw 4;
BA_ "UserSigValidity" SG_ 3221225472 HKBD_Fr_PsMultiAutoSw 7;
BA_ "Version" SG_ 3221225472 HKBD_Fr_PsMultiAutoSw "23.08.13";
BA_ "GenSigSendType" SG_ 3221225472 HKBD_Fr_AcSw 4;
BA_ "UserSigValidity" SG_ 3221225472 HKBD_Fr_AcSw 7;
BA_ "Version" SG_ 3221225472 HKBD_Fr_AcSw "23.08.13";
BA_ "GenSigSendType" SG_ 3221225472 HKBD_Fr_DefSw 4;
BA_ "UserSigValidity" SG_ 3221225472 HKBD_Fr_DefSw 7;
BA_ "Version" SG_ 3221225472 HKBD_Fr_DefSw "23.08.13";
BA_ "GenSigSendType" SG_ 3221225472 HKBD_Fr_RecSw 4;
BA_ "UserSigValidity" SG_ 3221225472 HKBD_Fr_RecSw 7;
BA_ "Version" SG_ 3221225472 HKBD_Fr_RecSw "23.08.13";
BA_ "GenSigSendType" SG_ 3221225472 HKBD_Fr_DrModVntSw 4;
BA_ "UserSigValidity" SG_ 3221225472 HKBD_Fr_DrModVntSw 7;
BA_ "Version" SG_ 3221225472 HKBD_Fr_DrModVntSw "23.08.13";
BA_ "GenSigSendType" SG_ 3221225472 HKBD_Fr_FreSw 4;
BA_ "UserSigValidity" SG_ 3221225472 HKBD_Fr_FreSw 7;
BA_ "Version" SG_ 3221225472 HKBD_Fr_FreSw "23.08.13";
BA_ "GenSigSendType" SG_ 3221225472 HKBD_Fr_IntakeTglSw 4;
BA_ "UserSigValidity" SG_ 3221225472 HKBD_Fr_IntakeTglSw 7;
BA_ "Version" SG_ 3221225472 HKBD_Fr_IntakeTglSw "23.08.13";
BA_ "GenSigSendType" SG_ 3221225472 HKBD_Fr_OffSw 4;
BA_ "UserSigValidity" SG_ 3221225472 HKBD_Fr_OffSw 7;
BA_ "Version" SG_ 3221225472 HKBD_Fr_OffSw "23.08.13";
BA_ "GenSigSendType" SG_ 3221225472 HKBD_Fr_SyncSw 4;
BA_ "UserSigValidity" SG_ 3221225472 HKBD_Fr_SyncSw 7;
BA_ "Version" SG_ 3221225472 HKBD_Fr_SyncSw "23.08.13";
BA_ "GenSigSendType" SG_ 3221225472 HKBD_Fr_RrDefInd 4;
BA_ "UserSigValidity" SG_ 3221225472 HKBD_Fr_RrDefInd 7;
BA_ "Version" SG_ 3221225472 HKBD_Fr_RrDefInd "23.08.13";
BA_ "GenSigSendType" SG_ 3221225472 HKBD_Fr_RrDefSw 4;
BA_ "UserSigValidity" SG_ 3221225472 HKBD_Fr_RrDefSw 7;
BA_ "Version" SG_ 3221225472 HKBD_Fr_RrDefSw "23.08.13";
BA_ "GenSigSendType" SG_ 3221225472 HKBD_Fr_ArclnSw 4;
BA_ "UserSigValidity" SG_ 3221225472 HKBD_Fr_ArclnSw 7;
BA_ "Version" SG_ 3221225472 HKBD_Fr_ArclnSw "23.08.13";
BA_ "GenSigSendType" SG_ 3221225472 HKBD_Fr_DrOnlySw 4;
BA_ "UserSigValidity" SG_ 3221225472 HKBD_Fr_DrOnlySw 7;
BA_ "Version" SG_ 3221225472 HKBD_Fr_DrOnlySw "23.08.13";
BA_ "GenSigSendType" SG_ 3221225472 HKBD_Fr_ClimateSw 4;
BA_ "UserSigValidity" SG_ 3221225472 HKBD_Fr_ClimateSw 7;
BA_ "Version" SG_ 3221225472 HKBD_Fr_ClimateSw "23.08.13";
BA_ "GenSigSendType" SG_ 3221225472 HKBD_Fr_PerfumeSw 4;
BA_ "UserSigValidity" SG_ 3221225472 HKBD_Fr_PerfumeSw 7;
BA_ "Version" SG_ 3221225472 HKBD_Fr_PerfumeSw "23.08.13";
BA_ "GenSigSendType" SG_ 3221225472 HKBD_Fr_DrModFlrSw 4;
BA_ "UserSigValidity" SG_ 3221225472 HKBD_Fr_DrModFlrSw 7;
BA_ "Version" SG_ 3221225472 HKBD_Fr_DrModFlrSw "23.08.13";
BA_ "GenSigSendType" SG_ 3221225472 HKBD_Fr_HptIntnstySta 4;
BA_ "UserSigValidity" SG_ 3221225472 HKBD_Fr_HptIntnstySta 7;
BA_ "Version" SG_ 3221225472 HKBD_Fr_HptIntnstySta "23.08.13";
BA_ "GenSigSendType" SG_ 3221225472 HKBD_Fr_StrWhlHeatSw 4;
BA_ "UserSigValidity" SG_ 3221225472 HKBD_Fr_StrWhlHeatSw 7;
BA_ "Version" SG_ 3221225472 HKBD_Fr_StrWhlHeatSw "23.08.13";
BA_ "GenSigSendType" SG_ 3221225472 HKBD_FLStHeatSw 4;
BA_ "UserSigValidity" SG_ 3221225472 HKBD_FLStHeatSw 7;
BA_ "Version" SG_ 3221225472 HKBD_FLStHeatSw "23.08.13";
BA_ "GenSigSendType" SG_ 3221225472 HKBD_FLStVentSw 4;
BA_ "UserSigValidity" SG_ 3221225472 HKBD_FLStVentSw 7;
BA_ "Version" SG_ 3221225472 HKBD_FLStVentSw "23.08.13";
BA_ "GenSigSendType" SG_ 3221225472 HKBD_FRStHeatSw 4;
BA_ "UserSigValidity" SG_ 3221225472 HKBD_FRStHeatSw 7;
BA_ "Version" SG_ 3221225472 HKBD_FRStHeatSw "23.08.13";
BA_ "GenSigSendType" SG_ 3221225472 HKBD_FRStVentSw 4;
BA_ "UserSigValidity" SG_ 3221225472 HKBD_FRStVentSw 7;
BA_ "Version" SG_ 3221225472 HKBD_FRStVentSw "23.08.13";
BA_ "GenSigSendType" SG_ 3221225472 HKBD_FLStTumblrSw 4;
BA_ "UserSigValidity" SG_ 3221225472 HKBD_FLStTumblrSw 7;
BA_ "Version" SG_ 3221225472 HKBD_FLStTumblrSw "23.08.13";
BA_ "GenSigSendType" SG_ 3221225472 HKBD_Fr_DrModDefSw 4;
BA_ "UserSigValidity" SG_ 3221225472 HKBD_Fr_DrModDefSw 7;
BA_ "Version" SG_ 3221225472 HKBD_Fr_DrModDefSw "23.08.13";
BA_ "GenSigSendType" SG_ 3221225472 HKBD_FRStTumblrSw 4;
BA_ "UserSigValidity" SG_ 3221225472 HKBD_FRStTumblrSw 7;
BA_ "Version" SG_ 3221225472 HKBD_FRStTumblrSw "23.08.13";
BA_ "GenSigSendType" SG_ 3221225472 HKBD_Fr_FrWndShldHtSw 4;
BA_ "UserSigValidity" SG_ 3221225472 HKBD_Fr_FrWndShldHtSw 7;
BA_ "Version" SG_ 3221225472 HKBD_Fr_FrWndShldHtSw "23.08.13";
BA_ "Description" SG_ 3221225472 HKBD_Fr_DrAutoDnSw "This signal should be used for tumbler type AUTO switch";
BA_ "GenSigSendType" SG_ 3221225472 HKBD_Fr_DrAutoDnSw 4;
BA_ "UserSigValidity" SG_ 3221225472 HKBD_Fr_DrAutoDnSw 7;
BA_ "Version" SG_ 3221225472 HKBD_Fr_DrAutoDnSw "23.08.13";
BA_ "Description" SG_ 3221225472 HKBD_Fr_DrAutoUpSw "This signal should be used for tumbler type AUTO switch";
BA_ "GenSigSendType" SG_ 3221225472 HKBD_Fr_DrAutoUpSw 4;
BA_ "UserSigValidity" SG_ 3221225472 HKBD_Fr_DrAutoUpSw 7;
BA_ "Version" SG_ 3221225472 HKBD_Fr_DrAutoUpSw "23.08.13";
BA_ "GenSigSendType" SG_ 3221225472 HKBD_Fr_DrModSw 4;
BA_ "UserSigValidity" SG_ 3221225472 HKBD_Fr_DrModSw 7;
BA_ "Version" SG_ 3221225472 HKBD_Fr_DrModSw "23.08.13";
BA_ "GenSigSendType" SG_ 3221225472 HKBD_Fr_PsModSw 4;
BA_ "UserSigValidity" SG_ 3221225472 HKBD_Fr_PsModSw 7;
BA_ "Version" SG_ 3221225472 HKBD_Fr_PsModSw "23.08.13";
BA_ "GenSigSendType" SG_ 3221225472 HKBD_Fr_PsModDnSw 4;
BA_ "UserSigValidity" SG_ 3221225472 HKBD_Fr_PsModDnSw 7;
BA_ "Version" SG_ 3221225472 HKBD_Fr_PsModDnSw "23.08.13";
BA_ "GenSigSendType" SG_ 3221225472 HKBD_Fr_PsModUpSw 4;
BA_ "UserSigValidity" SG_ 3221225472 HKBD_Fr_PsModUpSw 7;
BA_ "Version" SG_ 3221225472 HKBD_Fr_PsModUpSw "23.08.13";
BA_ "GenSigSendType" SG_ 3221225472 HKBD_Fr_PsModVntSw 4;
BA_ "UserSigValidity" SG_ 3221225472 HKBD_Fr_PsModVntSw 7;
BA_ "Version" SG_ 3221225472 HKBD_Fr_PsModVntSw "23.08.13";
BA_ "GenSigSendType" SG_ 3221225472 HKBD_Fr_PsModFlrSw 4;
BA_ "UserSigValidity" SG_ 3221225472 HKBD_Fr_PsModFlrSw 7;
BA_ "Version" SG_ 3221225472 HKBD_Fr_PsModFlrSw "23.08.13";
BA_ "GenSigSendType" SG_ 3221225472 HKBD_Fr_DrAutoSw 4;
BA_ "UserSigValidity" SG_ 3221225472 HKBD_Fr_DrAutoSw 7;
BA_ "Version" SG_ 3221225472 HKBD_Fr_DrAutoSw "23.08.13";
BA_ "GenSigSendType" SG_ 3221225472 HKBD_Fr_DrTempClickCnt 4;
BA_ "UserSigValidity" SG_ 3221225472 HKBD_Fr_DrTempClickCnt 7;
BA_ "Version" SG_ 3221225472 HKBD_Fr_DrTempClickCnt "23.08.13";
BA_ "GenSigSendType" SG_ 3221225472 HKBD_Fr_RrTempClickCnt 4;
BA_ "UserSigValidity" SG_ 3221225472 HKBD_Fr_RrTempClickCnt 7;
BA_ "Version" SG_ 3221225472 HKBD_Fr_RrTempClickCnt "23.08.13";
BA_ "GenSigSendType" SG_ 3221225472 HKBD_Fr_DrBlwClickCnt 4;
BA_ "UserSigValidity" SG_ 3221225472 HKBD_Fr_DrBlwClickCnt 7;
BA_ "Version" SG_ 3221225472 HKBD_Fr_DrBlwClickCnt "23.08.13";
BA_ "GenSigSendType" SG_ 3221225472 HKBD_Fr_PsBlwClickCnt 4;
BA_ "UserSigValidity" SG_ 3221225472 HKBD_Fr_PsBlwClickCnt 7;
BA_ "Version" SG_ 3221225472 HKBD_Fr_PsBlwClickCnt "23.08.13";
BA_ "GenSigSendType" SG_ 3221225472 HKBD_FrTempKnobCnt 4;
BA_ "UserSigValidity" SG_ 3221225472 HKBD_FrTempKnobCnt 7;
BA_ "Version" SG_ 3221225472 HKBD_FrTempKnobCnt "23.08.13";
BA_ "GenSigSendType" SG_ 3221225472 HKBD_FrBlwKnobCnt 4;
BA_ "UserSigValidity" SG_ 3221225472 HKBD_FrBlwKnobCnt 7;
BA_ "Version" SG_ 3221225472 HKBD_FrBlwKnobCnt "23.08.13";
BA_ "GenSigSendType" SG_ 3221225472 HKBD_Fr_PsTempClickCnt 4;
BA_ "UserSigValidity" SG_ 3221225472 HKBD_Fr_PsTempClickCnt 7;
BA_ "Version" SG_ 3221225472 HKBD_Fr_PsTempClickCnt "23.08.13";
BA_ "Description" SG_ 3221225472 L_3HKBD_SwOpt1 "Bit0 (CoolSeat):0 - Non CoolSeat/1 ? CoolSeat

 Bit1:(HeatSeat):0 - Non HeatSeat/1 ? HeatSeat

 Bit2:(Seat):0 - 5 Seat/1 - 7 Seat

 Bit3~4:(Type):0 - None/1 - ATC/2 - MTC 

 Bit5:RESERVED   

 Bit6:RESERVED   

 Bit7:RESERVED";
BA_ "GenSigSendType" SG_ 3221225472 L_3HKBD_SwOpt1 4;
BA_ "UserSigValidity" SG_ 3221225472 L_3HKBD_SwOpt1 7;
BA_ "Version" SG_ 3221225472 L_3HKBD_SwOpt1 "23.09.01";
BA_ "Description" SG_ 3221225472 L_3HKBD_Typ2 "Bit 0~1 (2nd Rear Auto Step):0 ? None/1 ? Single(On/Off)/2 ? 2 Step Type (High/Low/Off)/3 ? 3 Step Type(High/Medium/Low/Off)

Bit 2~3 (2nd Rear Mode Control):0 ? None/1 ? Single/2 - Dual/3 ? (RESERVED) 

Bit 4 (2nd Rear SYNC):0 ? None/1 ? SYNC

Bit 5~6 (";
BA_ "GenSigSendType" SG_ 3221225472 L_3HKBD_Typ2 4;
BA_ "UserSigValidity" SG_ 3221225472 L_3HKBD_Typ2 7;
BA_ "Version" SG_ 3221225472 L_3HKBD_Typ2 "23.09.01";
BA_ "Description" SG_ 3221225472 L_3HKBD_Typ1 "Bit 0~1(2nd Rear Control Type):0 ? None/1 ? MTC/2 ? ATC (Single)

Bit 2~3 (2nd Rear Blower Control):0 ? None/1 ? Single/2 - Dual/3 ? (RESERVED)

Bit 4~5 (2nd Rear Temp Control):0 ? None/1 ? Single/2 - Dual/3 ? (RESERVED) 

Bit 6~7 (2nd Rear Auto Control)";
BA_ "GenSigSendType" SG_ 3221225472 L_3HKBD_Typ1 4;
BA_ "UserSigValidity" SG_ 3221225472 L_3HKBD_Typ1 7;
BA_ "Version" SG_ 3221225472 L_3HKBD_Typ1 "23.09.01";
BA_ "Description" SG_ 3221225472 L_3HKBD_SwBtnTyp "Each bit for button type is defined as

0-None/1-Hardkey/2-Touch(Used Beep)/3-Touch(Not Used Beep)

Bit 0~1 : 3rd Temp Button / Bit 2~3 : 3rd Blower Button / Bit 4~5 : 3rd Mode Button / Bit 6~7 : 3rd Auto Button / Bit 8~9 : 3rd A/C Button / Bit 10~11 : 3";
BA_ "GenSigSendType" SG_ 3221225472 L_3HKBD_SwBtnTyp 4;
BA_ "UserSigValidity" SG_ 3221225472 L_3HKBD_SwBtnTyp 7;
BA_ "Version" SG_ 3221225472 L_3HKBD_SwBtnTyp "23.09.01";
BA_ "UserSigValidity" SG_ 3221225472 L_3HKBD_Rr_TempActrFB 7;
BA_ "Version" SG_ 3221225472 L_3HKBD_Rr_TempActrFB "23.09.05";
BA_ "UserSigValidity" SG_ 3221225472 L_3HKBD_Rr_TempActrSt 7;
BA_ "Version" SG_ 3221225472 L_3HKBD_Rr_TempActrSt "23.09.01";
BA_ "UserSigValidity" SG_ 3221225472 L_3HKBD_Rr_TempAsstActrFB 7;
BA_ "Version" SG_ 3221225472 L_3HKBD_Rr_TempAsstActrFB "23.09.05";
BA_ "UserSigValidity" SG_ 3221225472 L_3HKBD_Rr_TempAsstActrSt 7;
BA_ "Version" SG_ 3221225472 L_3HKBD_Rr_TempAsstActrSt "23.09.01";
BA_ "UserSigValidity" SG_ 3221225472 L_3HKBD_Rr_ModeActrFB 7;
BA_ "Version" SG_ 3221225472 L_3HKBD_Rr_ModeActrFB "23.09.05";
BA_ "UserSigValidity" SG_ 3221225472 L_3HKBD_Rr_ModeActrSt 7;
BA_ "Version" SG_ 3221225472 L_3HKBD_Rr_ModeActrSt "23.09.01";
BA_ "UserSigValidity" SG_ 3221225472 L_3HKBD_Rr_BLDCError 7;
BA_ "Version" SG_ 3221225472 L_3HKBD_Rr_BLDCError "23.09.01";
BA_ "UserSigValidity" SG_ 3221225472 L_3HKBD_Rr_EvapVolVal 7;
BA_ "Version" SG_ 3221225472 L_3HKBD_Rr_EvapVolVal "23.09.05";
BA_ "Description" SG_ 3221225472 L_3HKBD_Rr_HVACBLDCRpmFB "00H~3E8H:RPM = Factor * Hex + Offset/3E9H ~ FFFFH:RESERVED";
BA_ "UserSigValidity" SG_ 3221225472 L_3HKBD_Rr_HVACBLDCRpmFB 7;
BA_ "Version" SG_ 3221225472 L_3HKBD_Rr_HVACBLDCRpmFB "23.09.05";
BA_ "UserSigValidity" SG_ 3221225472 HKBD_Fr_IncarRaw 7;
BA_ "Version" SG_ 3221225472 HKBD_Fr_IncarRaw "23.08.13";
BA_ "GenSigSendType" SG_ 3221225472 L_3HKBD_RrFlrDuctSnsr 4;
BA_ "UserSigValidity" SG_ 3221225472 L_3HKBD_RrFlrDuctSnsr 7;
BA_ "Version" SG_ 3221225472 L_3HKBD_RrFlrDuctSnsr "23.09.05";
BA_ "GenSigSendType" SG_ 3221225472 L_3HKBD_RrVntDuctSnsr 4;
BA_ "UserSigValidity" SG_ 3221225472 L_3HKBD_RrVntDuctSnsr 7;
BA_ "Version" SG_ 3221225472 L_3HKBD_RrVntDuctSnsr "23.09.05";
BA_ "GenSigSendType" SG_ 3221225472 L_3HKBD_RrTempDnSw 4;
BA_ "UserSigValidity" SG_ 3221225472 L_3HKBD_RrTempDnSw 7;
BA_ "Version" SG_ 3221225472 L_3HKBD_RrTempDnSw "23.09.01";
BA_ "GenSigSendType" SG_ 3221225472 L_3HKBD_RrTempUpSw 4;
BA_ "UserSigValidity" SG_ 3221225472 L_3HKBD_RrTempUpSw 7;
BA_ "Version" SG_ 3221225472 L_3HKBD_RrTempUpSw "23.09.01";
BA_ "GenSigSendType" SG_ 3221225472 L_3HKBD_RrAutoSw 4;
BA_ "UserSigValidity" SG_ 3221225472 L_3HKBD_RrAutoSw 7;
BA_ "Version" SG_ 3221225472 L_3HKBD_RrAutoSw "23.09.01";
BA_ "GenSigSendType" SG_ 3221225472 L_3HKBD_RrOffSw 4;
BA_ "UserSigValidity" SG_ 3221225472 L_3HKBD_RrOffSw 7;
BA_ "Version" SG_ 3221225472 L_3HKBD_RrOffSw "23.09.01";
BA_ "GenSigSendType" SG_ 3221225472 L_3HKBD_RrSyncSw 4;
BA_ "UserSigValidity" SG_ 3221225472 L_3HKBD_RrSyncSw 7;
BA_ "Version" SG_ 3221225472 L_3HKBD_RrSyncSw "23.09.01";
BA_ "GenSigSendType" SG_ 3221225472 L_3HKBD_RLStHtrSwReq 4;
BA_ "UserSigValidity" SG_ 3221225472 L_3HKBD_RLStHtrSwReq 7;
BA_ "Version" SG_ 3221225472 L_3HKBD_RLStHtrSwReq "23.09.01";
BA_ "GenSigSendType" SG_ 3221225472 L_3HKBD_RLStVentSwReq 4;
BA_ "UserSigValidity" SG_ 3221225472 L_3HKBD_RLStVentSwReq 7;
BA_ "Version" SG_ 3221225472 L_3HKBD_RLStVentSwReq "23.09.01";
BA_ "GenSigSendType" SG_ 3221225472 L_3HKBD_RRStHtrSwReq 4;
BA_ "UserSigValidity" SG_ 3221225472 L_3HKBD_RRStHtrSwReq 7;
BA_ "Version" SG_ 3221225472 L_3HKBD_RRStHtrSwReq "23.09.01";
BA_ "GenSigSendType" SG_ 3221225472 L_3HKBD_RRStVentSwReq 4;
BA_ "UserSigValidity" SG_ 3221225472 L_3HKBD_RRStVentSwReq 7;
BA_ "Version" SG_ 3221225472 L_3HKBD_RRStVentSwReq "23.09.01";
BA_ "GenSigSendType" SG_ 3221225472 L_3HKBD_RrBlwDnOffSw 4;
BA_ "UserSigValidity" SG_ 3221225472 L_3HKBD_RrBlwDnOffSw 7;
BA_ "Version" SG_ 3221225472 L_3HKBD_RrBlwDnOffSw "23.09.01";
BA_ "GenSigSendType" SG_ 3221225472 L_3HKBD_RrOnOffSet 4;
BA_ "UserSigValidity" SG_ 3221225472 L_3HKBD_RrOnOffSet 7;
BA_ "Version" SG_ 3221225472 L_3HKBD_RrOnOffSet "23.09.01";
BA_ "GenSigSendType" SG_ 3221225472 L_3HKBD_RrBlwDnSw 4;
BA_ "UserSigValidity" SG_ 3221225472 L_3HKBD_RrBlwDnSw 7;
BA_ "Version" SG_ 3221225472 L_3HKBD_RrBlwDnSw "23.09.01";
BA_ "GenSigSendType" SG_ 3221225472 L_3HKBD_RrBlwUpSw 4;
BA_ "UserSigValidity" SG_ 3221225472 L_3HKBD_RrBlwUpSw 7;
BA_ "Version" SG_ 3221225472 L_3HKBD_RrBlwUpSw "23.09.01";
BA_ "GenSigSendType" SG_ 3221225472 L_3HKBD_RrModeDnSw 4;
BA_ "UserSigValidity" SG_ 3221225472 L_3HKBD_RrModeDnSw 7;
BA_ "Version" SG_ 3221225472 L_3HKBD_RrModeDnSw "23.09.01";
BA_ "GenSigSendType" SG_ 3221225472 L_3HKBD_RrModeUpSw 4;
BA_ "UserSigValidity" SG_ 3221225472 L_3HKBD_RrModeUpSw 7;
BA_ "Version" SG_ 3221225472 L_3HKBD_RrModeUpSw "23.09.01";
BA_ "GenSigSendType" SG_ 3221225472 L_3HKBD_RrModeSw 4;
BA_ "UserSigValidity" SG_ 3221225472 L_3HKBD_RrModeSw 7;
BA_ "Version" SG_ 3221225472 L_3HKBD_RrModeSw "23.09.01";
BA_ "GenSigSendType" SG_ 3221225472 L_3HKBD_RrModeVentSw 4;
BA_ "UserSigValidity" SG_ 3221225472 L_3HKBD_RrModeVentSw 7;
BA_ "Version" SG_ 3221225472 L_3HKBD_RrModeVentSw "23.09.01";
BA_ "GenSigSendType" SG_ 3221225472 L_3HKBD_RrModeFloorSw 4;
BA_ "UserSigValidity" SG_ 3221225472 L_3HKBD_RrModeFloorSw 7;
BA_ "Version" SG_ 3221225472 L_3HKBD_RrModeFloorSw "23.09.01";
BA_ "GenSigSendType" SG_ 3221225472 L_3HKBD_RrModeBiLvlSw 4;
BA_ "UserSigValidity" SG_ 3221225472 L_3HKBD_RrModeBiLvlSw 7;
BA_ "Version" SG_ 3221225472 L_3HKBD_RrModeBiLvlSw "23.09.01";
BA_ "GenSigSendType" SG_ 3221225472 L_3HKBD_RrTempClickCnt 4;
BA_ "UserSigValidity" SG_ 3221225472 L_3HKBD_RrTempClickCnt 7;
BA_ "Version" SG_ 3221225472 L_3HKBD_RrTempClickCnt "23.09.01";
BA_ "GenSigSendType" SG_ 3221225472 L_3HKBD_TempKnobCnt 4;
BA_ "UserSigValidity" SG_ 3221225472 L_3HKBD_TempKnobCnt 7;
BA_ "Version" SG_ 3221225472 L_3HKBD_TempKnobCnt "23.09.01";
BA_ "GenSigSendType" SG_ 3221225472 L_3HKBD_BlwKnobCnt 4;
BA_ "UserSigValidity" SG_ 3221225472 L_3HKBD_BlwKnobCnt 7;
BA_ "Version" SG_ 3221225472 L_3HKBD_BlwKnobCnt "23.09.01";
BA_ "GenSigSendType" SG_ 3221225472 L_3HKBD_RrBlwrClickCnt 4;
BA_ "UserSigValidity" SG_ 3221225472 L_3HKBD_RrBlwrClickCnt 7;
BA_ "Version" SG_ 3221225472 L_3HKBD_RrBlwrClickCnt "23.09.01";
BA_ "GenSigSendType" SG_ 3221225472 PCM_Cart2UsdDay 4;
BA_ "UserSigValidity" SG_ 3221225472 PCM_Cart2UsdDay 7;
BA_ "Version" SG_ 3221225472 PCM_Cart2UsdDay "23.08.08";
BA_ "GenSigSendType" SG_ 3221225472 PCM_Cart2UsdYrPre2 4;
BA_ "UserSigValidity" SG_ 3221225472 PCM_Cart2UsdYrPre2 7;
BA_ "Version" SG_ 3221225472 PCM_Cart2UsdYrPre2 "23.08.08";
BA_ "GenSigSendType" SG_ 3221225472 PCM_Cart2UsedYrPost2 4;
BA_ "UserSigValidity" SG_ 3221225472 PCM_Cart2UsedYrPost2 7;
BA_ "Version" SG_ 3221225472 PCM_Cart2UsedYrPost2 "23.08.08";
BA_ "GenSigSendType" SG_ 3221225472 PCM_Cart2VectorX 4;
BA_ "UserSigValidity" SG_ 3221225472 PCM_Cart2VectorX 7;
BA_ "Version" SG_ 3221225472 PCM_Cart2VectorX "23.08.08";
BA_ "GenSigSendType" SG_ 3221225472 PCM_Cart2VectorY 4;
BA_ "UserSigValidity" SG_ 3221225472 PCM_Cart2VectorY 7;
BA_ "Version" SG_ 3221225472 PCM_Cart2VectorY "23.08.08";
BA_ "GenSigSendType" SG_ 3221225472 PCM_Cart2Rmn 4;
BA_ "UserSigValidity" SG_ 3221225472 PCM_Cart2Rmn 7;
BA_ "Version" SG_ 3221225472 PCM_Cart2Rmn "23.08.08";
BA_ "GenSigSendType" SG_ 3221225472 PCM_Cart2UsdMon 4;
BA_ "UserSigValidity" SG_ 3221225472 PCM_Cart2UsdMon 7;
BA_ "Version" SG_ 3221225472 PCM_Cart2UsdMon "23.08.08";
BA_ "GenSigSendType" SG_ 3221225472 PCM_Cart1UsdDay 4;
BA_ "UserSigValidity" SG_ 3221225472 PCM_Cart1UsdDay 7;
BA_ "Version" SG_ 3221225472 PCM_Cart1UsdDay "23.08.08";
BA_ "GenSigSendType" SG_ 3221225472 PCM_Cart1UsdYrPre2 4;
BA_ "UserSigValidity" SG_ 3221225472 PCM_Cart1UsdYrPre2 7;
BA_ "Version" SG_ 3221225472 PCM_Cart1UsdYrPre2 "23.08.08";
BA_ "GenSigSendType" SG_ 3221225472 PCM_Cart1UsedYrPost2 4;
BA_ "UserSigValidity" SG_ 3221225472 PCM_Cart1UsedYrPost2 7;
BA_ "Version" SG_ 3221225472 PCM_Cart1UsedYrPost2 "23.08.08";
BA_ "GenSigSendType" SG_ 3221225472 PCM_Cart1VectorX 4;
BA_ "UserSigValidity" SG_ 3221225472 PCM_Cart1VectorX 7;
BA_ "Version" SG_ 3221225472 PCM_Cart1VectorX "23.08.08";
BA_ "GenSigSendType" SG_ 3221225472 PCM_Cart1VectorY 4;
BA_ "UserSigValidity" SG_ 3221225472 PCM_Cart1VectorY 7;
BA_ "Version" SG_ 3221225472 PCM_Cart1VectorY "23.08.08";
BA_ "GenSigSendType" SG_ 3221225472 PCM_Cart1Rmn 4;
BA_ "UserSigValidity" SG_ 3221225472 PCM_Cart1Rmn 7;
BA_ "Version" SG_ 3221225472 PCM_Cart1Rmn "23.08.08";
BA_ "GenSigSendType" SG_ 3221225472 PCM_Cart1UsdMon 4;
BA_ "UserSigValidity" SG_ 3221225472 PCM_Cart1UsdMon 7;
BA_ "Version" SG_ 3221225472 PCM_Cart1UsdMon "23.08.08";
BA_ "UserSigValidity" SG_ 3221225472 PCM_ActPosFB 7;
BA_ "Version" SG_ 3221225472 PCM_ActPosFB "23.08.08";
BA_ "UserSigValidity" SG_ 3221225472 PCM_ActFailStall 7;
BA_ "Version" SG_ 3221225472 PCM_ActFailStall "23.08.08";
BA_ "UserSigValidity" SG_ 3221225472 PCM_ActFailMtrOpnShrt 7;
BA_ "Version" SG_ 3221225472 PCM_ActFailMtrOpnShrt "23.08.08";
BA_ "UserSigValidity" SG_ 3221225472 PCM_ActFailMtrOverTemp 7;
BA_ "Version" SG_ 3221225472 PCM_ActFailMtrOverTemp "23.08.08";
BA_ "UserSigValidity" SG_ 3221225472 PCM_ActFaillnVtg 7;
BA_ "Version" SG_ 3221225472 PCM_ActFaillnVtg "23.08.08";
BA_ "UserSigValidity" SG_ 3221225472 PCM_Blwr1Sta 7;
BA_ "Version" SG_ 3221225472 PCM_Blwr1Sta "23.08.08";
BA_ "UserSigValidity" SG_ 3221225472 PCM_Blwr1SpdFB 7;
BA_ "Version" SG_ 3221225472 PCM_Blwr1SpdFB "23.08.08";
BA_ "UserSigValidity" SG_ 3221225472 PCM_Blwr2Sta 7;
BA_ "Version" SG_ 3221225472 PCM_Blwr2Sta "23.08.08";
BA_ "UserSigValidity" SG_ 3221225472 PCM_Blwr2SpdFB 7;
BA_ "Version" SG_ 3221225472 PCM_Blwr2SpdFB "23.08.08";
BA_ "UserSigValidity" SG_ 3221225472 PCM_Blwr1FailCircuitShrt 7;
BA_ "Version" SG_ 3221225472 PCM_Blwr1FailCircuitShrt "23.08.08";
BA_ "UserSigValidity" SG_ 3221225472 PCM_Blwr1FailMtrLck 7;
BA_ "Version" SG_ 3221225472 PCM_Blwr1FailMtrLck "23.08.08";
BA_ "UserSigValidity" SG_ 3221225472 PCM_Blwr1FailOverCurrent 7;
BA_ "Version" SG_ 3221225472 PCM_Blwr1FailOverCurrent "23.08.08";
BA_ "UserSigValidity" SG_ 3221225472 PCM_Blwr1FailOverTemp 7;
BA_ "Version" SG_ 3221225472 PCM_Blwr1FailOverTemp "23.08.08";
BA_ "UserSigValidity" SG_ 3221225472 PCM_Blwr1FailUnderVtg 7;
BA_ "Version" SG_ 3221225472 PCM_Blwr1FailUnderVtg "23.08.08";
BA_ "UserSigValidity" SG_ 3221225472 PCM_Blwr1FailOverVtg 7;
BA_ "Version" SG_ 3221225472 PCM_Blwr1FailOverVtg "23.08.08";
BA_ "UserSigValidity" SG_ 3221225472 PCM_Blwr2FailCircuitShrt 7;
BA_ "Version" SG_ 3221225472 PCM_Blwr2FailCircuitShrt "23.08.08";
BA_ "UserSigValidity" SG_ 3221225472 PCM_Blwr2FailMtrLck 7;
BA_ "Version" SG_ 3221225472 PCM_Blwr2FailMtrLck "23.08.08";
BA_ "UserSigValidity" SG_ 3221225472 PCM_ActSpdFB_RPM 7;
BA_ "Version" SG_ 3221225472 PCM_ActSpdFB_RPM "23.08.08";
BA_ "UserSigValidity" SG_ 3221225472 PCM_Blwr2FailOverCurrent 7;
BA_ "Version" SG_ 3221225472 PCM_Blwr2FailOverCurrent "23.08.08";
BA_ "UserSigValidity" SG_ 3221225472 PCM_Blwr2FailOverTemp 7;
BA_ "Version" SG_ 3221225472 PCM_Blwr2FailOverTemp "23.08.08";
BA_ "UserSigValidity" SG_ 3221225472 PCM_Blwr2FailUnderVtg 7;
BA_ "Version" SG_ 3221225472 PCM_Blwr2FailUnderVtg "23.08.08";
BA_ "UserSigValidity" SG_ 3221225472 PCM_Blwr2FailOverVtg 7;
BA_ "Version" SG_ 3221225472 PCM_Blwr2FailOverVtg "23.08.08";
BA_ "UserSigValidity" SG_ 3221225472 PCM_Cart1Sta 7;
BA_ "Version" SG_ 3221225472 PCM_Cart1Sta "23.08.08";
BA_ "UserSigValidity" SG_ 3221225472 PCM_Cart1GenuinePart 7;
BA_ "Version" SG_ 3221225472 PCM_Cart1GenuinePart "23.08.08";
BA_ "UserSigValidity" SG_ 3221225472 PCM_Cart1Kinds 7;
BA_ "Version" SG_ 3221225472 PCM_Cart1Kinds "23.08.08";
BA_ "UserSigValidity" SG_ 3221225472 PCM_Cart2Sta 7;
BA_ "Version" SG_ 3221225472 PCM_Cart2Sta "23.08.08";
BA_ "UserSigValidity" SG_ 3221225472 PCM_Cart2GenuinePart 7;
BA_ "Version" SG_ 3221225472 PCM_Cart2GenuinePart "23.08.08";
BA_ "UserSigValidity" SG_ 3221225472 PCM_Cart2Kinds 7;
BA_ "Version" SG_ 3221225472 PCM_Cart2Kinds "23.08.08";
BA_ "UserSigValidity" SG_ 3221225472 PCM_ActSta 7;
BA_ "Version" SG_ 3221225472 PCM_ActSta "23.08.08";
BA_ "GenSigSendType" SG_ 3221225472 L_2HKBD_RrDrTempClickCnt 4;
BA_ "UserSigValidity" SG_ 3221225472 L_2HKBD_RrDrTempClickCnt 7;
BA_ "Version" SG_ 3221225472 L_2HKBD_RrDrTempClickCnt "23.09.01";
BA_ "GenSigSendType" SG_ 3221225472 L_2HKBD_RrPsTempClickCnt 4;
BA_ "UserSigValidity" SG_ 3221225472 L_2HKBD_RrPsTempClickCnt 7;
BA_ "Version" SG_ 3221225472 L_2HKBD_RrPsTempClickCnt "23.09.01";
BA_ "GenSigSendType" SG_ 3221225472 L_2HKBD_RrPsBlwrClickCnt 4;
BA_ "UserSigValidity" SG_ 3221225472 L_2HKBD_RrPsBlwrClickCnt 7;
BA_ "Version" SG_ 3221225472 L_2HKBD_RrPsBlwrClickCnt "23.09.01";
BA_ "GenSigSendType" SG_ 3221225472 L_2HKBD_RrTempKnobCnt 4;
BA_ "UserSigValidity" SG_ 3221225472 L_2HKBD_RrTempKnobCnt 7;
BA_ "Version" SG_ 3221225472 L_2HKBD_RrTempKnobCnt "23.09.01";
BA_ "GenSigSendType" SG_ 3221225472 L_2HKBD_RrBlwKnobCnt 4;
BA_ "UserSigValidity" SG_ 3221225472 L_2HKBD_RrBlwKnobCnt 7;
BA_ "Version" SG_ 3221225472 L_2HKBD_RrBlwKnobCnt "23.09.01";
BA_ "GenSigSendType" SG_ 3221225472 L_2HKBD_RrDrBlwrClickCnt 4;
BA_ "UserSigValidity" SG_ 3221225472 L_2HKBD_RrDrBlwrClickCnt 7;
BA_ "Version" SG_ 3221225472 L_2HKBD_RrDrBlwrClickCnt "23.09.01";
BA_ "Description" SG_ 3221225472 L_ATCU_DrTempCDis "This signal indicates Outside temperature (¡É).

(Use for display only)";
BA_ "GenSigSendType" SG_ 3221225472 L_ATCU_DrTempCDis 4;
BA_ "UserSigValidity" SG_ 3221225472 L_ATCU_DrTempCDis 7;
BA_ "Version" SG_ 3221225472 L_ATCU_DrTempCDis "23.08.13";
BA_ "GenSigSendType" SG_ 3221225472 L_ATCU_DrTempFDis 4;
BA_ "UserSigValidity" SG_ 3221225472 L_ATCU_DrTempFDis 7;
BA_ "Version" SG_ 3221225472 L_ATCU_DrTempFDis "23.08.13";
BA_ "GenSigSendType" SG_ 3221225472 L_ATCU_PassTempFDis 4;
BA_ "UserSigValidity" SG_ 3221225472 L_ATCU_PassTempFDis 7;
BA_ "Version" SG_ 3221225472 L_ATCU_PassTempFDis "23.08.13";
BA_ "GenSigSendType" SG_ 3221225472 L_ATCU_FrDrModDis 4;
BA_ "UserSigValidity" SG_ 3221225472 L_ATCU_FrDrModDis 7;
BA_ "Version" SG_ 3221225472 L_ATCU_FrDrModDis "23.08.13";
BA_ "GenSigSendType" SG_ 3221225472 L_ATCU_FrPassModDis 4;
BA_ "UserSigValidity" SG_ 3221225472 L_ATCU_FrPassModDis 7;
BA_ "Version" SG_ 3221225472 L_ATCU_FrPassModDis "23.08.13";
BA_ "Description" SG_ 3221225472 L_ATCU_FrDrBlwDis "This signal indicates step of Front Blower graphic.

This signal occurs when Front Blower siwtch(button) is selected either manually or automatically.";
BA_ "GenSigSendType" SG_ 3221225472 L_ATCU_FrDrBlwDis 4;
BA_ "UserSigValidity" SG_ 3221225472 L_ATCU_FrDrBlwDis 7;
BA_ "Version" SG_ 3221225472 L_ATCU_FrDrBlwDis "23.08.13";
BA_ "GenSigSendType" SG_ 3221225472 L_ATCU_FrPassBlwDis 4;
BA_ "UserSigValidity" SG_ 3221225472 L_ATCU_FrPassBlwDis 7;
BA_ "Version" SG_ 3221225472 L_ATCU_FrPassBlwDis "23.08.13";
BA_ "GenSigSendType" SG_ 3221225472 L_ATCU_DrAutoDis 4;
BA_ "UserSigValidity" SG_ 3221225472 L_ATCU_DrAutoDis 7;
BA_ "Version" SG_ 3221225472 L_ATCU_DrAutoDis "23.08.13";
BA_ "GenSigSendType" SG_ 3221225472 L_ATCU_PassAutoDis 4;
BA_ "UserSigValidity" SG_ 3221225472 L_ATCU_PassAutoDis 7;
BA_ "Version" SG_ 3221225472 L_ATCU_PassAutoDis "23.08.13";
BA_ "GenSigSendType" SG_ 3221225472 L_ATCU_DrMultiAutoBlwDis 4;
BA_ "UserSigValidity" SG_ 3221225472 L_ATCU_DrMultiAutoBlwDis 7;
BA_ "Version" SG_ 3221225472 L_ATCU_DrMultiAutoBlwDis "23.08.13";
BA_ "GenSigSendType" SG_ 3221225472 L_ATCU_PassMultiAutoBlwDis 4;
BA_ "UserSigValidity" SG_ 3221225472 L_ATCU_PassMultiAutoBlwDis 7;
BA_ "Version" SG_ 3221225472 L_ATCU_PassMultiAutoBlwDis "23.08.13";
BA_ "GenSigSendType" SG_ 3221225472 L_ATCU_AcDis 4;
BA_ "UserSigValidity" SG_ 3221225472 L_ATCU_AcDis 7;
BA_ "Version" SG_ 3221225472 L_ATCU_AcDis "23.08.13";
BA_ "GenSigSendType" SG_ 3221225472 L_ATCU_IntakeDis 4;
BA_ "UserSigValidity" SG_ 3221225472 L_ATCU_IntakeDis 7;
BA_ "Version" SG_ 3221225472 L_ATCU_IntakeDis "23.08.13";
BA_ "GenSigSendType" SG_ 3221225472 L_ATCU_SyncDis 4;
BA_ "UserSigValidity" SG_ 3221225472 L_ATCU_SyncDis 7;
BA_ "Version" SG_ 3221225472 L_ATCU_SyncDis "23.08.13";
BA_ "GenSigSendType" SG_ 3221225472 L_ATCU_FrDefDis 4;
BA_ "UserSigValidity" SG_ 3221225472 L_ATCU_FrDefDis 7;
BA_ "Version" SG_ 3221225472 L_ATCU_FrDefDis "23.08.13";
BA_ "Description" SG_ 3221225472 L_ATCU_PassTempCDis "This signal indicates Outside Temperature (¢µ)

(Use for display only)";
BA_ "GenSigSendType" SG_ 3221225472 L_ATCU_PassTempCDis 4;
BA_ "UserSigValidity" SG_ 3221225472 L_ATCU_PassTempCDis 7;
BA_ "Version" SG_ 3221225472 L_ATCU_PassTempCDis "23.08.13";
BA_ "GenSigSendType" SG_ 3221225472 L_ATCU_DrOnlyDis 4;
BA_ "UserSigValidity" SG_ 3221225472 L_ATCU_DrOnlyDis 7;
BA_ "Version" SG_ 3221225472 L_ATCU_DrOnlyDis "23.08.13";
BA_ "GenSigSendType" SG_ 3221225472 L_ATCU_SmrtVntDis 4;
BA_ "UserSigValidity" SG_ 3221225472 L_ATCU_SmrtVntDis 7;
BA_ "Version" SG_ 3221225472 L_ATCU_SmrtVntDis "23.08.13";
BA_ "GenSigSendType" SG_ 3221225472 L_ATCU_FrWndShldHtInd 4;
BA_ "UserSigValidity" SG_ 3221225472 L_ATCU_FrWndShldHtInd 7;
BA_ "Version" SG_ 3221225472 L_ATCU_FrWndShldHtInd "23.08.13";
BA_ "GenSigSendType" SG_ 3221225472 L_ATCU_SchedClimate_EnIndSta 4;
BA_ "UserSigValidity" SG_ 3221225472 L_ATCU_SchedClimate_EnIndSta 7;
BA_ "Version" SG_ 3221225472 L_ATCU_SchedClimate_EnIndSta "23.08.13";
BA_ "Description" SG_ 3221225472 L_ATCU_LanguageInfo "This signal indicates System Language information for Font display";
BA_ "GenSigSendType" SG_ 3221225472 L_ATCU_LanguageInfo 4;
BA_ "UserSigValidity" SG_ 3221225472 L_ATCU_LanguageInfo 7;
BA_ "Version" SG_ 3221225472 L_ATCU_LanguageInfo "23.08.13";
BA_ "GenSigSendType" SG_ 3221225472 L_ATCU_RrDefInd 4;
BA_ "UserSigValidity" SG_ 3221225472 L_ATCU_RrDefInd 7;
BA_ "Version" SG_ 3221225472 L_ATCU_RrDefInd "23.08.13";
BA_ "GenSigSendType" SG_ 3221225472 L_ATCU_AftBlwInfo 4;
BA_ "UserSigValidity" SG_ 3221225472 L_ATCU_AftBlwInfo 7;
BA_ "Version" SG_ 3221225472 L_ATCU_AftBlwInfo "23.08.13";
BA_ "GenSigSendType" SG_ 3221225472 L_ATCU_Reserve_Venti_Indi 4;
BA_ "UserSigValidity" SG_ 3221225472 L_ATCU_Reserve_Venti_Indi 7;
BA_ "Version" SG_ 3221225472 L_ATCU_Reserve_Venti_Indi "23.08.13";
BA_ "GenSigSendType" SG_ 3221225472 L_ATCU_IncarMtrOnReq 4;
BA_ "UserSigValidity" SG_ 3221225472 L_ATCU_IncarMtrOnReq 7;
BA_ "Version" SG_ 3221225472 L_ATCU_IncarMtrOnReq "23.08.13";
BA_ "GenSigSendType" SG_ 3221225472 L_ATCU_FLStHeatSwHInd 4;
BA_ "UserSigValidity" SG_ 3221225472 L_ATCU_FLStHeatSwHInd 7;
BA_ "Version" SG_ 3221225472 L_ATCU_FLStHeatSwHInd "23.08.13";
BA_ "GenSigSendType" SG_ 3221225472 L_ATCU_FLStHeatSwMInd 4;
BA_ "UserSigValidity" SG_ 3221225472 L_ATCU_FLStHeatSwMInd 7;
BA_ "Version" SG_ 3221225472 L_ATCU_FLStHeatSwMInd "23.08.13";
BA_ "GenSigSendType" SG_ 3221225472 L_ATCU_ADSBlinkDis 4;
BA_ "UserSigValidity" SG_ 3221225472 L_ATCU_ADSBlinkDis 7;
BA_ "Version" SG_ 3221225472 L_ATCU_ADSBlinkDis "23.08.13";
BA_ "GenSigSendType" SG_ 3221225472 L_ATCU_FLStHeatSwLInd 4;
BA_ "UserSigValidity" SG_ 3221225472 L_ATCU_FLStHeatSwLInd 7;
BA_ "Version" SG_ 3221225472 L_ATCU_FLStHeatSwLInd "23.08.13";
BA_ "GenSigSendType" SG_ 3221225472 L_ATCU_FLStVntSwHInd 4;
BA_ "UserSigValidity" SG_ 3221225472 L_ATCU_FLStVntSwHInd 7;
BA_ "Version" SG_ 3221225472 L_ATCU_FLStVntSwHInd "23.08.13";
BA_ "GenSigSendType" SG_ 3221225472 L_ATCU_FLStVntSwMInd 4;
BA_ "UserSigValidity" SG_ 3221225472 L_ATCU_FLStVntSwMInd 7;
BA_ "Version" SG_ 3221225472 L_ATCU_FLStVntSwMInd "23.08.13";
BA_ "GenSigSendType" SG_ 3221225472 L_ATCU_FLStVntSwLInd 4;
BA_ "UserSigValidity" SG_ 3221225472 L_ATCU_FLStVntSwLInd 7;
BA_ "Version" SG_ 3221225472 L_ATCU_FLStVntSwLInd "23.08.13";
BA_ "GenSigSendType" SG_ 3221225472 L_ATCU_FRStHeatSwHInd 4;
BA_ "UserSigValidity" SG_ 3221225472 L_ATCU_FRStHeatSwHInd 7;
BA_ "Version" SG_ 3221225472 L_ATCU_FRStHeatSwHInd "23.08.13";
BA_ "GenSigSendType" SG_ 3221225472 L_ATCU_FRStHeatSwMInd 4;
BA_ "UserSigValidity" SG_ 3221225472 L_ATCU_FRStHeatSwMInd 7;
BA_ "Version" SG_ 3221225472 L_ATCU_FRStHeatSwMInd "23.08.13";
BA_ "GenSigSendType" SG_ 3221225472 L_ATCU_FRStHeatSwLInd 4;
BA_ "UserSigValidity" SG_ 3221225472 L_ATCU_FRStHeatSwLInd 7;
BA_ "Version" SG_ 3221225472 L_ATCU_FRStHeatSwLInd "23.08.13";
BA_ "GenSigSendType" SG_ 3221225472 L_ATCU_FRStVntSwHInd 4;
BA_ "UserSigValidity" SG_ 3221225472 L_ATCU_FRStVntSwHInd 7;
BA_ "Version" SG_ 3221225472 L_ATCU_FRStVntSwHInd "23.08.13";
BA_ "GenSigSendType" SG_ 3221225472 L_ATCU_FRStVntSwMInd 4;
BA_ "UserSigValidity" SG_ 3221225472 L_ATCU_FRStVntSwMInd 7;
BA_ "Version" SG_ 3221225472 L_ATCU_FRStVntSwMInd "23.08.13";
BA_ "GenSigSendType" SG_ 3221225472 L_ATCU_FRStVntSwLInd 4;
BA_ "UserSigValidity" SG_ 3221225472 L_ATCU_FRStVntSwLInd 7;
BA_ "Version" SG_ 3221225472 L_ATCU_FRStVntSwLInd "23.08.13";
BA_ "Description" SG_ 3221225472 L_ATCU_StrWhlHeatInd "This signal indicates the status of Steering Wheel Heater";
BA_ "GenSigSendType" SG_ 3221225472 L_ATCU_StrWhlHeatInd 4;
BA_ "UserSigValidity" SG_ 3221225472 L_ATCU_StrWhlHeatInd 7;
BA_ "Version" SG_ 3221225472 L_ATCU_StrWhlHeatInd "23.08.13";
BA_ "Description" SG_ 3221225472 L_ATCU_RhstaLvlSta "This signal is used for a rheostat level of CLUSTER from 1 to 21 level (21 level:Detent) for a Unified Illumination System.



¡Ø Start Value:Current Value";
BA_ "GenSigSendType" SG_ 3221225472 L_ATCU_RhstaLvlSta 4;
BA_ "UserSigValidity" SG_ 3221225472 L_ATCU_RhstaLvlSta 7;
BA_ "Version" SG_ 3221225472 L_ATCU_RhstaLvlSta "23.08.13";
BA_ "GenSigSendType" SG_ 3221225472 L_ATCU_IntTailOnOff 4;
BA_ "UserSigValidity" SG_ 3221225472 L_ATCU_IntTailOnOff 7;
BA_ "Version" SG_ 3221225472 L_ATCU_IntTailOnOff "23.08.13";
BA_ "Description" SG_ 3221225472 L_ATCU_AutoLightSta "This signal indicates autolight sensor output";
BA_ "GenSigSendType" SG_ 3221225472 L_ATCU_AutoLightSta 4;
BA_ "UserSigValidity" SG_ 3221225472 L_ATCU_AutoLightSta 7;
BA_ "Version" SG_ 3221225472 L_ATCU_AutoLightSta "23.08.13";
BA_ "GenSigSendType" SG_ 3221225472 L_ATCU_FrBckLightSta 4;
BA_ "UserSigValidity" SG_ 3221225472 L_ATCU_FrBckLightSta 7;
BA_ "Version" SG_ 3221225472 L_ATCU_FrBckLightSta "23.08.13";
BA_ "GenSigSendType" SG_ 3221225472 L_ATCU_ADSOffDis 4;
BA_ "UserSigValidity" SG_ 3221225472 L_ATCU_ADSOffDis 7;
BA_ "Version" SG_ 3221225472 L_ATCU_ADSOffDis "23.08.13";
BA_ "GenSigSendType" SG_ 3221225472 L_ATCU_DisplayTheme 4;
BA_ "UserSigValidity" SG_ 3221225472 L_ATCU_DisplayTheme 7;
BA_ "Version" SG_ 3221225472 L_ATCU_DisplayTheme "23.08.13";
BA_ "GenSigSendType" SG_ 3221225472 L_ATCU_GUIBlankDis 4;
BA_ "UserSigValidity" SG_ 3221225472 L_ATCU_GUIBlankDis 7;
BA_ "Version" SG_ 3221225472 L_ATCU_GUIBlankDis "23.08.13";
BA_ "GenSigSendType" SG_ 3221225472 L_ATCU_HptFdbckLvl 4;
BA_ "UserSigValidity" SG_ 3221225472 L_ATCU_HptFdbckLvl 7;
BA_ "Version" SG_ 3221225472 L_ATCU_HptFdbckLvl "23.08.13";
BA_ "Description" SG_ 3221225472 L_ATCU_TlltLmpDis "This signal means information regarding Occupant status.

0) 00Xb:X position means PAB OFF Lamp indication. When this bit set as 1 PAB OFF lamp turns ON. 

    0Y0b:Y position means PAB ON Lamp indication. When this bit set as 1 PAB ON lamp turns ON.



";
BA_ "GenSigSendType" SG_ 3221225472 L_ATCU_TlltLmpDis 4;
BA_ "UserSigValidity" SG_ 3221225472 L_ATCU_TlltLmpDis 7;
BA_ "Version" SG_ 3221225472 L_ATCU_TlltLmpDis "23.08.13";
BA_ "GenSigSendType" SG_ 3221225472 L_ATCU_AvTailOnOff 4;
BA_ "UserSigValidity" SG_ 3221225472 L_ATCU_AvTailOnOff 7;
BA_ "Version" SG_ 3221225472 L_ATCU_AvTailOnOff "23.08.13";
BA_ "GenSigSendType" SG_ 3221225472 L_ATCU_AirClnDis 4;
BA_ "UserSigValidity" SG_ 3221225472 L_ATCU_AirClnDis 7;
BA_ "Version" SG_ 3221225472 L_ATCU_AirClnDis "23.08.13";
BA_ "GenSigSendType" SG_ 3221225472 L_ATCU_CO2WrngDis 4;
BA_ "UserSigValidity" SG_ 3221225472 L_ATCU_CO2WrngDis 7;
BA_ "Version" SG_ 3221225472 L_ATCU_CO2WrngDis "23.08.13";
BA_ "GenSigSendType" SG_ 3221225472 L_2HKBD_RrDrModeDnSw 4;
BA_ "UserSigValidity" SG_ 3221225472 L_2HKBD_RrDrModeDnSw 7;
BA_ "Version" SG_ 3221225472 L_2HKBD_RrDrModeDnSw "23.09.01";
BA_ "GenSigSendType" SG_ 3221225472 L_2HKBD_RrDrModeUpSw 4;
BA_ "UserSigValidity" SG_ 3221225472 L_2HKBD_RrDrModeUpSw 7;
BA_ "Version" SG_ 3221225472 L_2HKBD_RrDrModeUpSw "23.09.01";
BA_ "GenSigSendType" SG_ 3221225472 L_2HKBD_RrDrAutoSw 4;
BA_ "UserSigValidity" SG_ 3221225472 L_2HKBD_RrDrAutoSw 7;
BA_ "Version" SG_ 3221225472 L_2HKBD_RrDrAutoSw "23.09.01";
BA_ "GenSigSendType" SG_ 3221225472 L_2HKBD_Rr_OffSw 4;
BA_ "UserSigValidity" SG_ 3221225472 L_2HKBD_Rr_OffSw 7;
BA_ "Version" SG_ 3221225472 L_2HKBD_Rr_OffSw "23.09.01";
BA_ "GenSigSendType" SG_ 3221225472 L_2HKBD_RrSyncSw 4;
BA_ "UserSigValidity" SG_ 3221225472 L_2HKBD_RrSyncSw 7;
BA_ "Version" SG_ 3221225472 L_2HKBD_RrSyncSw "23.09.01";
BA_ "GenSigSendType" SG_ 3221225472 L_2HKBD_RrAcSw 4;
BA_ "UserSigValidity" SG_ 3221225472 L_2HKBD_RrAcSw 7;
BA_ "Version" SG_ 3221225472 L_2HKBD_RrAcSw "23.09.01";
BA_ "GenSigSendType" SG_ 3221225472 L_2HKBD_RLStHtrSwReq 4;
BA_ "UserSigValidity" SG_ 3221225472 L_2HKBD_RLStHtrSwReq 7;
BA_ "Version" SG_ 3221225472 L_2HKBD_RLStHtrSwReq "23.09.01";
BA_ "GenSigSendType" SG_ 3221225472 L_2HKBD_RLStVentSwReq 4;
BA_ "UserSigValidity" SG_ 3221225472 L_2HKBD_RLStVentSwReq 7;
BA_ "Version" SG_ 3221225472 L_2HKBD_RLStVentSwReq "23.09.01";
BA_ "GenSigSendType" SG_ 3221225472 L_2HKBD_RRStHtrSwReq 4;
BA_ "UserSigValidity" SG_ 3221225472 L_2HKBD_RRStHtrSwReq 7;
BA_ "Version" SG_ 3221225472 L_2HKBD_RRStHtrSwReq "23.09.01";
BA_ "GenSigSendType" SG_ 3221225472 L_2HKBD_RRStVentSwReq 4;
BA_ "UserSigValidity" SG_ 3221225472 L_2HKBD_RRStVentSwReq 7;
BA_ "Version" SG_ 3221225472 L_2HKBD_RRStVentSwReq "23.09.01";
BA_ "GenSigSendType" SG_ 3221225472 L_2HKBD_RrDrMultiAutoSw 4;
BA_ "UserSigValidity" SG_ 3221225472 L_2HKBD_RrDrMultiAutoSw 7;
BA_ "Version" SG_ 3221225472 L_2HKBD_RrDrMultiAutoSw "23.09.01";
BA_ "GenSigSendType" SG_ 3221225472 L_2HKBD_RrDrModeSw 4;
BA_ "UserSigValidity" SG_ 3221225472 L_2HKBD_RrDrModeSw 7;
BA_ "Version" SG_ 3221225472 L_2HKBD_RrDrModeSw "23.09.01";
BA_ "GenSigSendType" SG_ 3221225472 L_2HKBD_RrPsModeSw 4;
BA_ "UserSigValidity" SG_ 3221225472 L_2HKBD_RrPsModeSw 7;
BA_ "Version" SG_ 3221225472 L_2HKBD_RrPsModeSw "23.09.01";
BA_ "GenSigSendType" SG_ 3221225472 L_2HKBD_RrPsModeDnSw 4;
BA_ "UserSigValidity" SG_ 3221225472 L_2HKBD_RrPsModeDnSw 7;
BA_ "Version" SG_ 3221225472 L_2HKBD_RrPsModeDnSw "23.09.01";
BA_ "GenSigSendType" SG_ 3221225472 L_2HKBD_RrPsModeUpSw 4;
BA_ "UserSigValidity" SG_ 3221225472 L_2HKBD_RrPsModeUpSw 7;
BA_ "Version" SG_ 3221225472 L_2HKBD_RrPsModeUpSw "23.09.01";
BA_ "GenSigSendType" SG_ 3221225472 L_2HKBD_RrPsModeVentSw 4;
BA_ "UserSigValidity" SG_ 3221225472 L_2HKBD_RrPsModeVentSw 7;
BA_ "Version" SG_ 3221225472 L_2HKBD_RrPsModeVentSw "23.09.01";
BA_ "GenSigSendType" SG_ 3221225472 L_2HKBD_RrPsModeFloorSw 4;
BA_ "UserSigValidity" SG_ 3221225472 L_2HKBD_RrPsModeFloorSw 7;
BA_ "Version" SG_ 3221225472 L_2HKBD_RrPsModeFloorSw "23.09.01";
BA_ "GenSigSendType" SG_ 3221225472 L_2HKBD_RrPsModeBiLvlSw 4;
BA_ "UserSigValidity" SG_ 3221225472 L_2HKBD_RrPsModeBiLvlSw 7;
BA_ "Version" SG_ 3221225472 L_2HKBD_RrPsModeBiLvlSw "23.09.01";
BA_ "GenSigSendType" SG_ 3221225472 L_2HKBD_RrPsTempDnSw 4;
BA_ "UserSigValidity" SG_ 3221225472 L_2HKBD_RrPsTempDnSw 7;
BA_ "Version" SG_ 3221225472 L_2HKBD_RrPsTempDnSw "23.09.01";
BA_ "GenSigSendType" SG_ 3221225472 L_2HKBD_RrPsTempUpSw 4;
BA_ "UserSigValidity" SG_ 3221225472 L_2HKBD_RrPsTempUpSw 7;
BA_ "Version" SG_ 3221225472 L_2HKBD_RrPsTempUpSw "23.09.01";
BA_ "GenSigSendType" SG_ 3221225472 L_2HKBD_RrPsBlwUpSw 4;
BA_ "UserSigValidity" SG_ 3221225472 L_2HKBD_RrPsBlwUpSw 7;
BA_ "Version" SG_ 3221225472 L_2HKBD_RrPsBlwUpSw "23.09.01";
BA_ "GenSigSendType" SG_ 3221225472 L_2HKBD_RrDRModeVentSw 4;
BA_ "UserSigValidity" SG_ 3221225472 L_2HKBD_RrDRModeVentSw 7;
BA_ "Version" SG_ 3221225472 L_2HKBD_RrDRModeVentSw "23.09.01";
BA_ "GenSigSendType" SG_ 3221225472 L_2HKBD_RrPsBlwDnSw 4;
BA_ "UserSigValidity" SG_ 3221225472 L_2HKBD_RrPsBlwDnSw 7;
BA_ "Version" SG_ 3221225472 L_2HKBD_RrPsBlwDnSw "23.09.01";
BA_ "GenSigSendType" SG_ 3221225472 L_2HKBD_RrPsAutoSw 4;
BA_ "UserSigValidity" SG_ 3221225472 L_2HKBD_RrPsAutoSw 7;
BA_ "Version" SG_ 3221225472 L_2HKBD_RrPsAutoSw "23.09.01";
BA_ "GenSigSendType" SG_ 3221225472 L_2HKBD_RrPsMultiAutoSw 4;
BA_ "UserSigValidity" SG_ 3221225472 L_2HKBD_RrPsMultiAutoSw 7;
BA_ "Version" SG_ 3221225472 L_2HKBD_RrPsMultiAutoSw "23.09.01";
BA_ "GenSigSendType" SG_ 3221225472 L_2HKBD_RrDrBlwDnOffSw 4;
BA_ "UserSigValidity" SG_ 3221225472 L_2HKBD_RrDrBlwDnOffSw 7;
BA_ "Version" SG_ 3221225472 L_2HKBD_RrDrBlwDnOffSw "23.09.01";
BA_ "GenSigSendType" SG_ 3221225472 L_2HKBD_RrPsBlwDnOffSw 4;
BA_ "UserSigValidity" SG_ 3221225472 L_2HKBD_RrPsBlwDnOffSw 7;
BA_ "Version" SG_ 3221225472 L_2HKBD_RrPsBlwDnOffSw "23.09.01";
BA_ "GenSigSendType" SG_ 3221225472 L_2HKBD_RrOnOffSet 4;
BA_ "UserSigValidity" SG_ 3221225472 L_2HKBD_RrOnOffSet 7;
BA_ "Version" SG_ 3221225472 L_2HKBD_RrOnOffSet "23.09.01";
BA_ "GenSigSendType" SG_ 3221225472 L_2HKBD_RrDrModeFloorSw 4;
BA_ "UserSigValidity" SG_ 3221225472 L_2HKBD_RrDrModeFloorSw 7;
BA_ "Version" SG_ 3221225472 L_2HKBD_RrDrModeFloorSw "23.09.01";
VAL_ 3221225472 HKBD_Fr_DrTempDnSw 0 "Off" 1 "On" ;
VAL_ 3221225472 HKBD_Fr_DrTempUpSw 0 "Off" 1 "On" ;
VAL_ 3221225472 HKBD_Fr_PsBlwDnSw 0 "Off" 1 "On" ;
VAL_ 3221225472 HKBD_Fr_PsBlwDnOffSw 0 "Off" 1 "On" ;
VAL_ 3221225472 HKBD_Fr_PsBlwUpSw 0 "Off" 1 "On" ;
VAL_ 3221225472 HKBD_Fr_PsBlwSet 0 "Off" 1 "0 Level" 2 "1 Level" 3 "2 Level" 4 "3 Level" 5 "4 Level" 6 "5 Level" 7 "6 Level" 8 "7 Level" 9 "8 Level" 15 "Invalid" ;
VAL_ 3221225472 HKBD_Fr_RrDrTempDnSw 0 "Off" 1 "On" ;
VAL_ 3221225472 HKBD_Fr_RrDrTempUpSw 0 "Off" 1 "On" ;
VAL_ 3221225472 HKBD_Fr_PsTempDnSw 0 "Off" 1 "On" ;
VAL_ 3221225472 HKBD_Fr_RrDrBlwDnSw 0 "Off" 1 "On" ;
VAL_ 3221225472 HKBD_Fr_RrDrBlwDnOffSw 0 "Off" 1 "On" ;
VAL_ 3221225472 HKBD_Fr_RrDrBlwUpSw 0 "Off" 1 "On" ;
VAL_ 3221225472 HKBD_Fr_RrDrBlwSet 0 "Off" 1 "0 Level" 2 "1 Level" 3 "2 Level" 4 "3 Level" 5 "4 Level" 6 "5 Level" 7 "6 Level" 8 "7 Level" 9 "8 Level" 15 "Invalid" ;
VAL_ 3221225472 HKBD_Fr_RrDrModDnSw 0 "Off" 1 "On" ;
VAL_ 3221225472 HKBD_Fr_RrDrModUpSw 0 "Off" 1 "On" ;
VAL_ 3221225472 HKBD_Fr_RrDrModVntSw 0 "Off" 1 "On" ;
VAL_ 3221225472 HKBD_Fr_PsTempUpSw 0 "Off" 1 "On" ;
VAL_ 3221225472 HKBD_Fr_RrDrModFlrSw 0 "Off" 1 "On" ;
VAL_ 3221225472 HKBD_Fr_RrDrModBiLvlSw 0 "Off" 1 "On" ;
VAL_ 3221225472 HKBD_Fr_RrDrAutoSw 0 "Off" 1 "On" ;
VAL_ 3221225472 HKBD_Fr_RrDrMultiAutoSw 0 "RESERVED" 1 "Low" 2 "Medium" 3 "High" 4 "RESERVED" 5 "RESERVED" 6 "RESERVED" 7 "Invalid" ;
VAL_ 3221225472 HKBD_Fr_RrOffSw 0 "Off" 1 "On" ;
VAL_ 3221225472 HKBD_Fr_RrSyncSw 0 "Off" 1 "On" ;
VAL_ 3221225472 HKBD_Fr_RLStHeatSw 0 "Off" 1 "On" ;
VAL_ 3221225472 HKBD_Fr_RLStVentSw 0 "Off" 1 "On" ;
VAL_ 3221225472 HKBD_Fr_DrBlwDnSw 0 "Off" 1 "On" ;
VAL_ 3221225472 HKBD_Fr_RRStHeatSw 0 "Off" 1 "On" ;
VAL_ 3221225472 HKBD_Fr_RRStVentSw 0 "Off" 1 "On" ;
VAL_ 3221225472 HKBD_Fr_RLStTumblrSw 0 "Default" 1 "Up" 2 "Down" 3 "Error Indicator" ;
VAL_ 3221225472 HKBD_Fr_RRStTumblrSw 0 "Default" 1 "Up" 2 "Down" 3 "Error Indicator" ;
VAL_ 3221225472 HKBD_Fr_RrPsModDnSw 0 "Off" 1 "On" ;
VAL_ 3221225472 HKBD_Fr_RrPsModUpSw 0 "Off" 1 "On" ;
VAL_ 3221225472 HKBD_Fr_RrPsModVntSw 0 "Off" 1 "On" ;
VAL_ 3221225472 HKBD_Fr_RrPsModFlrSw 0 "Off" 1 "On" ;
VAL_ 3221225472 HKBD_Fr_DrBlwDnOffSw 0 "Off" 1 "On" ;
VAL_ 3221225472 HKBD_Fr_RrLockSw 0 "Off" 1 "On" ;
VAL_ 3221225472 HKBD_Fr_RrPsModBiLvlSw 0 "Off" 1 "On" ;
VAL_ 3221225472 HKBD_Fr_RrDrModSw 0 "Off" 1 "On" ;
VAL_ 3221225472 HKBD_Fr_RrPsModSw 0 "Off" 1 "On" ;
VAL_ 3221225472 HKBD_Fr_RrPsBlwSet 0 "Off" 1 "0 Level" 2 "1 Level" 3 "2 Level" 4 "3 Level" 5 "4 Level" 6 "5 Level" 7 "6 Level" 8 "7 Level" 9 "8 Level" 15 "Invalid" ;
VAL_ 3221225472 HKBD_Fr_RrPsBlwUpSw 0 "Off" 1 "On" ;
VAL_ 3221225472 HKBD_Fr_RrPsBlwDnSw 0 "Off" 1 "On" ;
VAL_ 3221225472 HKBD_Fr_DrBlwUpSw 0 "Off" 1 "On" ;
VAL_ 3221225472 HKBD_Fr_RrPsBlwDnOffSw 0 "Off" 1 "On" ;
VAL_ 3221225472 HKBD_Fr_RrPsTempDnSw 0 "Off" 1 "On" ;
VAL_ 3221225472 HKBD_Fr_RrPsTempUpSw 0 "Off" 1 "On" ;
VAL_ 3221225472 HKBD_Fr_DrBlwSet 0 "Off" 1 "0 Level" 2 "1 Level" 3 "2 Level" 4 "3 Level" 5 "4 Level" 6 "5 Level" 7 "6 Level" 8 "7 Level" 9 "8 Level" 15 "Invalid" ;
VAL_ 3221225472 L_ATCU_PCMActTgtPos 0 "OFF" 1 "Cartridge#1" 2 "Cartridge#2" 3 "Calibrating" 4 "RESERVED" 5 "RESERVED" 6 "RESERVED" 7 "RESERVED" 8 "RESERVED" 9 "RESERVED" 10 "RESERVED" 11 "RESERVED" 12 "RESERVED" 13 "RESERVED" 14 "RESERVED" 15 "Error Indicator" ;
VAL_ 3221225472 L_ATCU_VehPowerIGN2 0 "Off" 1 "On" ;
VAL_ 3221225472 L_ATCU_VehPowerISGB 0 "Off" 1 "On" ;
VAL_ 3221225472 L_ATCU_PCMActTgtSpd 15 "Error Indicator" ;
VAL_ 3221225472 L_ATCU_VehPowerBatt 0 "Off" 1 "On" ;
VAL_ 3221225472 L_ATCU_VehPowerIGN1_3 0 "Off" 1 "On" ;
VAL_ 3221225472 HKBD_Fr_3rdRrTempDnSw 0 "Off" 1 "On" ;
VAL_ 3221225472 HKBD_Fr_3rdRrTempUpSw 0 "Off" 1 "On" ;
VAL_ 3221225472 HKBD_Fr_3rdRrModUpSw 0 "Off" 1 "On" ;
VAL_ 3221225472 HKBD_Fr_3rdRrModVntSw 0 "Off" 1 "On" ;
VAL_ 3221225472 HKBD_Fr_3rdRrModFlrSw 0 "Off" 1 "On" ;
VAL_ 3221225472 HKBD_Fr_3rdRrAutoSw 0 "Off" 1 "On" ;
VAL_ 3221225472 HKBD_Fr_3rdRrMultiAutoSw 0 "RESERVED" 1 "Low" 2 "Medium" 3 "High" 4 "RESERVED" 5 "RESERVED" 6 "RESERVED" 7 "Invalid" ;
VAL_ 3221225472 HKBD_Fr_3rdRrOffSw 0 "Off" 1 "On" ;
VAL_ 3221225472 HKBD_Fr_3rdRrSyncSw 0 "Off" 1 "On" ;
VAL_ 3221225472 HKBD_Fr_3rdRrLockSw 0 "Off" 1 "On" ;
VAL_ 3221225472 HKBD_Fr_3rdRrBlwDnSw 0 "Off" 1 "On" ;
VAL_ 3221225472 HKBD_Fr_3rdRrModBiLvlSw 0 "Off" 1 "On" ;
VAL_ 3221225472 HKBD_FrRrTglSet 0 "Default" 1 "Front" 2 "2nd Rear" 3 "3rd Rear" ;
VAL_ 3221225472 HKBD_FrRrScrnSet 0 "Default" 1 "On" 2 "Off" 3 "Invalid" ;
VAL_ 3221225472 HKBD_Fr_OnOffSet 0 "Default" 1 "On" 2 "Off" 3 "Invalid" ;
VAL_ 3221225472 HKBD_Fr_RrOnOffSet 0 "Default" 1 "On" 2 "Off" 3 "Invalid" ;
VAL_ 3221225472 HKBD_Fr_3rdRrOnOffSet 0 "Off" 1 "On" ;
VAL_ 3221225472 HKBD_Fr_3rdRrBlwDnOffSw 0 "Off" 1 "On" ;
VAL_ 3221225472 HKBD_Fr_RrPsAutoSw 0 "Off" 1 "On" ;
VAL_ 3221225472 HKBD_Fr_RrPsMultiAutoSw 0 "RESERVED" 1 "Low" 2 "Medium" 3 "High" 4 "RESERVED" 5 "RESERVED" 6 "RESERVED" 7 "Invalid" ;
VAL_ 3221225472 HKBD_Fr_3rdRrModSw 0 "Off" 1 "On" ;
VAL_ 3221225472 HKBD_Fr_3rdRrBlwUpSw 0 "Off" 1 "On" ;
VAL_ 3221225472 HKBD_Fr_3rdRrBlwSet 0 "Off" 1 "0 Level" 2 "1 Level" 3 "2 Level" 4 "3 Level" 5 "4 Level" 6 "5 Level" 7 "6 Level" 8 "7 Level" 9 "8 Level" 15 "Invalid" ;
VAL_ 3221225472 HKBD_Fr_3rdRrModDnSw 0 "Off" 1 "On" ;
VAL_ 3221225472 HKBD_Fr_RrDrTempClickCnt 0 "RESERVED" 1 "0x1~0x7F:clockwise" 127 "0x1~0x7F:clockwise" 128 "0x80~0xFE:Counterclockwise" 254 "0x80~0xFE:Counterclockwise" 255 "Invalid" ;
VAL_ 3221225472 HKBD_Fr_RrPsTempClickCnt 0 "RESERVED" 1 "0x1~0x7F:clockwise" 127 "0x1~0x7F:clockwise" 128 "0x80~0xFE:Counterclockwise" 254 "0x80~0xFE:Counterclockwise" 255 "Invalid" ;
VAL_ 3221225472 HKBD_Fr_RrPsBlwClickCnt 0 "RESERVED" 1 "0x1~0x7F:clockwise" 127 "0x1~0x7F:clockwise" 128 "0x80~0xFE:Counterclockwise" 254 "0x80~0xFE:Counterclockwise" 255 "Invalid" ;
VAL_ 3221225472 HKBD_Fr_3rdRrTempClickCnt 0 "RESERVED" 1 "0x1~0x7F:clockwise" 127 "0x1~0x7F:clockwise" 128 "0x80~0xFE:Counterclockwise" 254 "0x80~0xFE:Counterclockwise" 255 "Invalid" ;
VAL_ 3221225472 HKBD_Fr_3rdRrBlwClickCnt 0 "RESERVED" 1 "0x1~0x7F:clockwise" 127 "0x1~0x7F:clockwise" 128 "0x80~0xFE:Counterclockwise" 254 "0x80~0xFE:Counterclockwise" 255 "Invalid" ;
VAL_ 3221225472 HKBD_Fr_RrTempKnobCnt 0 "0" 1 "1" 2 "2" 3 "invalid" ;
VAL_ 3221225472 HKBD_Fr_RrBlwKnobCnt 0 "0" 1 "1" 2 "2" 3 "invalid" ;
VAL_ 3221225472 HKBD_Fr_3rdTempKnobCnt 0 "0" 1 "1" 2 "2" 3 "invalid" ;
VAL_ 3221225472 HKBD_Fr_3rdBlwKnobCnt 0 "0" 1 "1" 2 "2" 3 "invalid" ;
VAL_ 3221225472 HKBD_Fr_RrDrBlwClickCnt 0 "RESERVED" 1 "0x1~0x7F:clockwise" 127 "0x1~0x7F:clockwise" 128 "0x80~0xFE:Counterclockwise" 254 "0x80~0xFE:Counterclockwise" 255 "Invalid" ;
VAL_ 3221225472 HKBD_GatewayMode 0 "No GateWay Mode" 1 "Front GateWay Mode" 2 "Rear GateWay Mode" 3 "Invalid" ;
VAL_ 3221225472 HKBD_Fr_DrModDnSw 0 "Off" 1 "On" ;
VAL_ 3221225472 HKBD_Fr_DrModUpSw 0 "Off" 1 "On" ;
VAL_ 3221225472 HKBD_Fr_DrMultiAutoSw 0 "RESERVED" 1 "Low" 2 "Medium" 3 "High" 4 "RESERVED" 5 "RESERVED" 6 "RESERVED" 7 "Invalid" ;
VAL_ 3221225472 HKBD_Fr_PsAutoSw 0 "Off" 1 "On" ;
VAL_ 3221225472 HKBD_Fr_PsMultiAutoSw 0 "RESERVED" 1 "Low" 2 "Medium" 3 "High" 4 "RESERVED" 5 "RESERVED" 6 "RESERVED" 7 "Invalid" ;
VAL_ 3221225472 HKBD_Fr_AcSw 0 "Off" 1 "On" ;
VAL_ 3221225472 HKBD_Fr_DefSw 0 "Off" 1 "On" ;
VAL_ 3221225472 HKBD_Fr_RecSw 0 "Off" 1 "On" ;
VAL_ 3221225472 HKBD_Fr_DrModVntSw 0 "Off" 1 "On" ;
VAL_ 3221225472 HKBD_Fr_FreSw 0 "Off" 1 "On" ;
VAL_ 3221225472 HKBD_Fr_IntakeTglSw 0 "Off" 1 "On" ;
VAL_ 3221225472 HKBD_Fr_OffSw 0 "Off" 1 "On" ;
VAL_ 3221225472 HKBD_Fr_SyncSw 0 "Off" 1 "On" ;
VAL_ 3221225472 HKBD_Fr_RrDefInd 0 "Off" 1 "On" ;
VAL_ 3221225472 HKBD_Fr_RrDefSw 0 "Off" 1 "On" ;
VAL_ 3221225472 HKBD_Fr_ArclnSw 0 "Off" 1 "On" ;
VAL_ 3221225472 HKBD_Fr_DrOnlySw 0 "Off" 1 "On" ;
VAL_ 3221225472 HKBD_Fr_ClimateSw 0 "Off" 1 "On" ;
VAL_ 3221225472 HKBD_Fr_PerfumeSw 0 "Off" 1 "On" ;
VAL_ 3221225472 HKBD_Fr_DrModFlrSw 0 "Off" 1 "On" ;
VAL_ 3221225472 HKBD_Fr_HptIntnstySta 0 "Default" 1 "Haptic Intensity LOW" 2 "Haptic Intensity MID" 3 "Haptic Intensity HIGH" 4 "RESERVED" 5 "RESERVED" 6 "RESERVED" 7 "RESERVED" 8 "RESERVED" 9 "RESERVED" 10 "RESERVED" 11 "RESERVED" 12 "RESERVED" 13 "RESERVED" 14 "RESERVED" 15 "Invalid" ;
VAL_ 3221225472 HKBD_Fr_StrWhlHeatSw 0 "Off" 1 "On" ;
VAL_ 3221225472 HKBD_FLStHeatSw 0 "Off" 1 "On" ;
VAL_ 3221225472 HKBD_FLStVentSw 0 "Off" 1 "On" ;
VAL_ 3221225472 HKBD_FRStHeatSw 0 "Off" 1 "On" ;
VAL_ 3221225472 HKBD_FRStVentSw 0 "Off" 1 "On" ;
VAL_ 3221225472 HKBD_FLStTumblrSw 0 "Default" 1 "Up" 2 "Down" 3 "Error Indicator" ;
VAL_ 3221225472 HKBD_Fr_DrModDefSw 0 "Off" 1 "On" ;
VAL_ 3221225472 HKBD_FRStTumblrSw 0 "Default" 1 "Up" 2 "Down" 3 "Error Indicator" ;
VAL_ 3221225472 HKBD_Fr_FrWndShldHtSw 0 "Off" 1 "On" ;
VAL_ 3221225472 HKBD_Fr_DrAutoDnSw 0 "Off" 1 "On" ;
VAL_ 3221225472 HKBD_Fr_DrAutoUpSw 0 "Off" 1 "On" ;
VAL_ 3221225472 HKBD_Fr_DrModSw 0 "Off" 1 "On" ;
VAL_ 3221225472 HKBD_Fr_PsModSw 0 "Off" 1 "On" ;
VAL_ 3221225472 HKBD_Fr_PsModDnSw 0 "Off" 1 "On" ;
VAL_ 3221225472 HKBD_Fr_PsModUpSw 0 "Off" 1 "On" ;
VAL_ 3221225472 HKBD_Fr_PsModVntSw 0 "Off" 1 "On" ;
VAL_ 3221225472 HKBD_Fr_PsModFlrSw 0 "Off" 1 "On" ;
VAL_ 3221225472 HKBD_Fr_DrAutoSw 0 "Off" 1 "On" ;
VAL_ 3221225472 HKBD_Fr_DrTempClickCnt 0 "RESERVED" 1 "0x1~0x7F:clockwise" 127 "0x1~0x7F:clockwise" 128 "0x80~0xFE:Counterclockwise" 254 "0x80~0xFE:Counterclockwise" 255 "Invalid" ;
VAL_ 3221225472 HKBD_Fr_RrTempClickCnt 0 "RESERVED" 1 "0x1~0x7F:clockwise" 127 "0x1~0x7F:clockwise" 128 "0x80~0xFE:Counterclockwise" 254 "0x80~0xFE:Counterclockwise" 255 "Invalid" ;
VAL_ 3221225472 HKBD_Fr_DrBlwClickCnt 0 "RESERVED" 1 "0x1~0x7F:clockwise" 127 "0x1~0x7F:clockwise" 128 "0x80~0xFE:Counterclockwise" 254 "0x80~0xFE:Counterclockwise" 255 "Invalid" ;
VAL_ 3221225472 HKBD_Fr_PsBlwClickCnt 0 "RESERVED" 1 "0x1~0x7F:clockwise" 127 "0x1~0x7F:clockwise" 128 "0x80~0xFE:Counterclockwise" 254 "0x80~0xFE:Counterclockwise" 255 "Invalid" ;
VAL_ 3221225472 HKBD_FrTempKnobCnt 0 "0" 1 "1" 2 "2" 3 "invalid" ;
VAL_ 3221225472 HKBD_FrBlwKnobCnt 0 "0" 1 "1" 2 "2" 3 "invalid" ;
VAL_ 3221225472 HKBD_Fr_PsTempClickCnt 0 "RESERVED" 1 "0x1~0x7F:clockwise" 127 "0x1~0x7F:clockwise" 128 "0x80~0xFE:Counterclockwise" 254 "0x80~0xFE:Counterclockwise" 255 "Invalid" ;
VAL_ 3221225472 L_3HKBD_Rr_TempActrFB 1023 "Error Indicator" ;
VAL_ 3221225472 L_3HKBD_Rr_TempActrSt 0 "Normal" 1 "Open" 2 "Short" 3 "Stuck" ;
VAL_ 3221225472 L_3HKBD_Rr_TempAsstActrFB 1023 "Error Indicator" ;
VAL_ 3221225472 L_3HKBD_Rr_TempAsstActrSt 0 "Normal" 1 "Open" 2 "Short" 3 "Stuck" ;
VAL_ 3221225472 L_3HKBD_Rr_ModeActrFB 1023 "Error Indicator" ;
VAL_ 3221225472 L_3HKBD_Rr_ModeActrSt 0 "Normal" 1 "Open" 2 "Short" 3 "Stuck" ;
VAL_ 3221225472 L_3HKBD_Rr_BLDCError 0 "No error" 1 "Over Current" 2 "Under Voltage" 3 "Over Voltage" 4 "Stall" 5 "Over Temperature" 6 "Controller Shutdown (Internal Error)" 7 "Current Limit" 8 "Limp mode" 9 "LIN Fail" 10 "RESERVED" 11 "RESERVED" 12 "RESERVED" 13 "RESERVED" 14 "RESERVED" 15 "RESERVED" ;
VAL_ 3221225472 L_3HKBD_Rr_EvapVolVal 0 "0x0x0~0xFA:0~5V" 250 "0x0x0~0xFA:0~5V" 255 "Error Indicator" ;
VAL_ 3221225472 HKBD_Fr_IncarRaw 1023 "Error Indicator" ;
VAL_ 3221225472 L_3HKBD_RrFlrDuctSnsr 0 "Default" 1 "Not used" 2 "0x2~0x11A:-40¡É ~ 100¡É/ 0x1FF:Error Indicator" 282 "0x2~0x11A:-40¡É ~ 100¡É/ 0x1FF:Error Indicator" ;
VAL_ 3221225472 L_3HKBD_RrVntDuctSnsr 0 "Default" 1 "Not used" 2 "0x2~0x11A:-40¡É ~ 100¡É/ 0x1FF:Error Indicator" 282 "0x2~0x11A:-40¡É ~ 100¡É/ 0x1FF:Error Indicator" ;
VAL_ 3221225472 L_3HKBD_RrTempDnSw 0 "Off" 1 "On" ;
VAL_ 3221225472 L_3HKBD_RrTempUpSw 0 "Off" 1 "On" ;
VAL_ 3221225472 L_3HKBD_RrAutoSw 0 "Off" 1 "On" ;
VAL_ 3221225472 L_3HKBD_RrOffSw 0 "Off" 1 "On" ;
VAL_ 3221225472 L_3HKBD_RrSyncSw 0 "Off" 1 "On" ;
VAL_ 3221225472 L_3HKBD_RLStHtrSwReq 0 "Off" 1 "On" ;
VAL_ 3221225472 L_3HKBD_RLStVentSwReq 0 "Off" 1 "On" ;
VAL_ 3221225472 L_3HKBD_RRStHtrSwReq 0 "Off" 1 "On" ;
VAL_ 3221225472 L_3HKBD_RRStVentSwReq 0 "Off" 1 "On" ;
VAL_ 3221225472 L_3HKBD_RrBlwDnOffSw 0 "Off" 1 "On" ;
VAL_ 3221225472 L_3HKBD_RrOnOffSet 0 "Default" 1 "On" 2 "Off" 3 "Invalid" ;
VAL_ 3221225472 L_3HKBD_RrBlwDnSw 0 "Off" 1 "On" ;
VAL_ 3221225472 L_3HKBD_RrBlwUpSw 0 "Off" 1 "On" ;
VAL_ 3221225472 L_3HKBD_RrModeDnSw 0 "Off" 1 "On" ;
VAL_ 3221225472 L_3HKBD_RrModeUpSw 0 "Off" 1 "On" ;
VAL_ 3221225472 L_3HKBD_RrModeSw 0 "Off" 1 "On" ;
VAL_ 3221225472 L_3HKBD_RrModeVentSw 0 "Off" 1 "On" ;
VAL_ 3221225472 L_3HKBD_RrModeFloorSw 0 "Off" 1 "On" ;
VAL_ 3221225472 L_3HKBD_RrModeBiLvlSw 0 "Off" 1 "On" ;
VAL_ 3221225472 L_3HKBD_RrTempClickCnt 0 "RESERVED" 1 "0x01~0x7F:Clockwise" 127 "0x01~0x7F:Clockwise" 128 "0x80~0xFE:Counter Clockwise" 254 "0x80~0xFE:Counter Clockwise" 255 "Invalid" ;
VAL_ 3221225472 L_3HKBD_TempKnobCnt 0 "0" 1 "1" 2 "2" 3 "invalid" ;
VAL_ 3221225472 L_3HKBD_BlwKnobCnt 0 "0" 1 "1" 2 "2" 3 "invalid" ;
VAL_ 3221225472 L_3HKBD_RrBlwrClickCnt 0 "RESERVED" 1 "0x01~0x7F:Clockwise" 127 "0x01~0x7F:Clockwise" 128 "0x80~0xFE:Counter Clockwise" 254 "0x80~0xFE:Counter Clockwise" 255 "Invalid" ;
VAL_ 3221225472 PCM_Cart2UsdDay 0 "RESERVED (not used)" 1 "1~31" 2 "1~31" 3 "1~31" 4 "1~31" 5 "1~31" 6 "1~31" 7 "1~31" 8 "1~31" 9 "1~31" 10 "1~31" 11 "1~31" 12 "1~31" 13 "1~31" 14 "1~31" 15 "1~31" 16 "1~31" 17 "1~31" 18 "1~31" 19 "1~31" 20 "1~31" 21 "1~31" 22 "1~31" 23 "1~31" 24 "1~31" 25 "1~31" 26 "1~31" 27 "1~31" 28 "1~31" 29 "1~31" 30 "1~31" 31 "1~31" 47 "0x2F~0xFD:RESERVED" 253 "0x2F~0xFD:RESERVED" 254 "Factory reset" 255 "Error Indicator" ;
VAL_ 3221225472 PCM_Cart2UsdYrPre2 0 "19" 1 "20" 2 "21" 3 "Factory reset" 7 "Error Indicator" ;
VAL_ 3221225472 PCM_Cart2UsedYrPost2 0 "Year" 1 "Year" 2 "Year" 3 "Year" 4 "Year" 5 "Year" 6 "Year" 7 "Year" 8 "Year" 9 "Year" 10 "Year" 11 "Year" 12 "Year" 13 "Year" 14 "Year" 15 "Year" 16 "Year" 17 "Year" 18 "Year" 19 "Year" 20 "Year" 21 "Year" 22 "Year" 23 "Year" 24 "Year" 25 "Year" 26 "Year" 27 "Year" 28 "Year" 29 "Year" 30 "Year" 31 "Year" 32 "Year" 33 "Year" 34 "Year" 35 "Year" 36 "Year" 37 "Year" 38 "Year" 39 "Year" 40 "Year" 41 "Year" 42 "Year" 43 "Year" 44 "Year" 45 "Year" 46 "Year" 47 "Year" 48 "Year" 49 "Year" 50 "Year" 51 "Year" 52 "Year" 53 "Year" 54 "Year" 55 "Year" 56 "Year" 57 "Year" 58 "Year" 59 "Year" 60 "Year" 61 "Year" 62 "Year" 63 "Year" 64 "Year" 65 "Year" 66 "Year" 67 "Year" 68 "Year" 69 "Year" 70 "Year" 71 "Year" 72 "Year" 73 "Year" 74 "Year" 75 "Year" 76 "Year" 77 "Year" 78 "Year" 79 "Year" 80 "Year" 81 "Year" 82 "Year" 83 "Year" 84 "Year" 85 "Year" 86 "Year" 87 "Year" 88 "Year" 89 "Year" 90 "Year" 91 "Year" 92 "Year" 93 "Year" 94 "Year" 95 "Year" 96 "Year" 97 "Year" 98 "Year" 99 "Year" 100 "0x64~0xFD:RESERVED" 253 "0x64~0xFD:RESERVED" 254 "Factory reset" 255 "Error Indicator" ;
VAL_ 3221225472 PCM_Cart2VectorX 0 "coordinate" 1 "coordinate" 2 "coordinate" 3 "coordinate" 4 "coordinate" 5 "coordinate" 6 "coordinate" 7 "coordinate" 8 "coordinate" 9 "coordinate" 10 "coordinate" 11 "coordinate" 12 "coordinate" 13 "coordinate" 14 "coordinate" 15 "coordinate" 16 "coordinate" 17 "coordinate" 18 "coordinate" 19 "coordinate" 20 "coordinate" 21 "0x15~0xFD:RESERVED" 253 "0x15~0xFD:RESERVED" 254 "Cartridge Not Contacted" 255 "Error Indicator" ;
VAL_ 3221225472 PCM_Cart2VectorY 0 "coordinate" 1 "coordinate" 2 "coordinate" 3 "coordinate" 4 "coordinate" 5 "coordinate" 6 "coordinate" 7 "coordinate" 8 "coordinate" 9 "coordinate" 10 "coordinate" 11 "coordinate" 12 "coordinate" 13 "coordinate" 14 "coordinate" 15 "coordinate" 16 "coordinate" 17 "coordinate" 18 "coordinate" 19 "coordinate" 20 "coordinate" 21 "0x15~0xFD:RESERVED" 253 "0x15~0xFD:RESERVED" 254 "Cartridge Not Contacted" 255 "Error Indicator" ;
VAL_ 3221225472 PCM_Cart2Rmn 16777215 "Error Indicator" ;
VAL_ 3221225472 PCM_Cart2UsdMon 0 "RESERVED (not used)" 1 "Jan~Dec" 2 "Jan~Dec" 3 "Jan~Dec" 4 "Jan~Dec" 5 "Jan~Dec" 6 "Jan~Dec" 7 "Jan~Dec" 8 "Jan~Dec" 9 "Jan~Dec" 10 "Jan~Dec" 11 "Jan~Dec" 12 "Jan~Dec" 13 "RESERVED" 14 "RESERVED" 15 "Error Indicator" ;
VAL_ 3221225472 PCM_Cart1UsdDay 0 "RESERVED (not used)" 1 "1~31" 2 "1~31" 3 "1~31" 4 "1~31" 5 "1~31" 6 "1~31" 7 "1~31" 8 "1~31" 9 "1~31" 10 "1~31" 11 "1~31" 12 "1~31" 13 "1~31" 14 "1~31" 15 "1~31" 16 "1~31" 17 "1~31" 18 "1~31" 19 "1~31" 20 "1~31" 21 "1~31" 22 "1~31" 23 "1~31" 24 "1~31" 25 "1~31" 26 "1~31" 27 "1~31" 28 "1~31" 29 "1~31" 30 "1~31" 31 "1~31" 47 "0x2F~0xFD:RESERVED" 253 "0x2F~0xFD:RESERVED" 254 "Factory reset" 255 "Error Indicator" ;
VAL_ 3221225472 PCM_Cart1UsdYrPre2 0 "19" 1 "20" 2 "21" 3 "Factory reset" 7 "Error Indicator" ;
VAL_ 3221225472 PCM_Cart1UsedYrPost2 0 "Year" 1 "Year" 2 "Year" 3 "Year" 4 "Year" 5 "Year" 6 "Year" 7 "Year" 8 "Year" 9 "Year" 10 "Year" 11 "Year" 12 "Year" 13 "Year" 14 "Year" 15 "Year" 16 "Year" 17 "Year" 18 "Year" 19 "Year" 20 "Year" 21 "Year" 22 "Year" 23 "Year" 24 "Year" 25 "Year" 26 "Year" 27 "Year" 28 "Year" 29 "Year" 30 "Year" 31 "Year" 32 "Year" 33 "Year" 34 "Year" 35 "Year" 36 "Year" 37 "Year" 38 "Year" 39 "Year" 40 "Year" 41 "Year" 42 "Year" 43 "Year" 44 "Year" 45 "Year" 46 "Year" 47 "Year" 48 "Year" 49 "Year" 50 "Year" 51 "Year" 52 "Year" 53 "Year" 54 "Year" 55 "Year" 56 "Year" 57 "Year" 58 "Year" 59 "Year" 60 "Year" 61 "Year" 62 "Year" 63 "Year" 64 "Year" 65 "Year" 66 "Year" 67 "Year" 68 "Year" 69 "Year" 70 "Year" 71 "Year" 72 "Year" 73 "Year" 74 "Year" 75 "Year" 76 "Year" 77 "Year" 78 "Year" 79 "Year" 80 "Year" 81 "Year" 82 "Year" 83 "Year" 84 "Year" 85 "Year" 86 "Year" 87 "Year" 88 "Year" 89 "Year" 90 "Year" 91 "Year" 92 "Year" 93 "Year" 94 "Year" 95 "Year" 96 "Year" 97 "Year" 98 "Year" 99 "Year" 100 "0x64~0xFD:RESERVED" 253 "0x64~0xFD:RESERVED" 254 "Factory reset" 255 "Error Indicator" ;
VAL_ 3221225472 PCM_Cart1VectorX 0 "coordinate" 1 "coordinate" 2 "coordinate" 3 "coordinate" 4 "coordinate" 5 "coordinate" 6 "coordinate" 7 "coordinate" 8 "coordinate" 9 "coordinate" 10 "coordinate" 11 "coordinate" 12 "coordinate" 13 "coordinate" 14 "coordinate" 15 "coordinate" 16 "coordinate" 17 "coordinate" 18 "coordinate" 19 "coordinate" 20 "coordinate" 21 "0x15~0xFD:RESERVED" 253 "0x15~0xFD:RESERVED" 254 "Cartridge Not Contacted" 255 "Error Indicator" ;
VAL_ 3221225472 PCM_Cart1VectorY 0 "coordinate" 1 "coordinate" 2 "coordinate" 3 "coordinate" 4 "coordinate" 5 "coordinate" 6 "coordinate" 7 "coordinate" 8 "coordinate" 9 "coordinate" 10 "coordinate" 11 "coordinate" 12 "coordinate" 13 "coordinate" 14 "coordinate" 15 "coordinate" 16 "coordinate" 17 "coordinate" 18 "coordinate" 19 "coordinate" 20 "coordinate" 21 "0x15~0xFD:RESERVED" 253 "0x15~0xFD:RESERVED" 254 "Cartridge Not Contacted" 255 "Error Indicator" ;
VAL_ 3221225472 PCM_Cart1Rmn 16777215 "Error Indicator" ;
VAL_ 3221225472 PCM_Cart1UsdMon 0 "RESERVED (not used)" 1 "Jan~Dec" 2 "Jan~Dec" 3 "Jan~Dec" 4 "Jan~Dec" 5 "Jan~Dec" 6 "Jan~Dec" 7 "Jan~Dec" 8 "Jan~Dec" 9 "Jan~Dec" 10 "Jan~Dec" 11 "Jan~Dec" 12 "Jan~Dec" 13 "RESERVED" 14 "RESERVED" 15 "Error Indicator" ;
VAL_ 3221225472 PCM_ActPosFB 0 "OFF" 1 "Cartridge#1" 2 "Cartridge#2" 3 "Calibrating" 4 "Moving - #1 to #2" 5 "Moving - #1 to Off" 6 "Moving - #2 to #1" 7 "Moving - #2 to Off" 8 "Moving Off to #1" 9 "Moving Off to #2" 10 "RESERVED" 11 "RESERVED" 12 "RESERVED" 13 "RESERVED" 14 "RESERVED" 15 "Error Indicator" ;
VAL_ 3221225472 PCM_ActFailStall 0 "Normal" 1 "Motor Stall" ;
VAL_ 3221225472 PCM_ActFailMtrOpnShrt 0 "Normal" 1 "Motor circuit open/short" ;
VAL_ 3221225472 PCM_ActFailMtrOverTemp 0 "Normal" 1 "Over temperature" ;
VAL_ 3221225472 PCM_ActFaillnVtg 0 "Normal" 1 "Input voltage" ;
VAL_ 3221225472 PCM_Blwr1Sta 0 "Normal OFF" 1 "Normal ON" 2 "RESERVED" 3 "RESERVED" 4 "RESERVED" 5 "RESERVED" 6 "RESERVED" 7 "RESERVED" 8 "RESERVED" 9 "RESERVED" 10 "RESERVED" 11 "RESERVED" 12 "RESERVED" 13 "RESERVED" 14 "RESERVED" 15 "Error Indicator" ;
VAL_ 3221225472 PCM_Blwr1SpdFB 0 "On - Level #0 (0% - Off)" 1 "On - Level #1 (10%)" 2 "On - Level #2 (20%)" 3 "On - Level #3 (30%)" 4 "On - Level #4 (40%)" 5 "On - Level #5 (50%)" 6 "On - Level #6 (60%)" 7 "On - Level #7 (70%)" 8 "On - Level #8 (80%)" 9 "On - Level #9 (90%)" 10 "On - Level #10 (Max)" 11 "Off - PCM Function Off" 12 "RESERVED" 13 "RESERVED" 14 "RESERVED" 15 "Error Indicator" ;
VAL_ 3221225472 PCM_Blwr2Sta 0 "Normal OFF" 1 "Normal ON" 2 "RESERVED" 3 "RESERVED" 4 "RESERVED" 5 "RESERVED" 6 "RESERVED" 7 "RESERVED" 8 "RESERVED" 9 "RESERVED" 10 "RESERVED" 11 "RESERVED" 12 "RESERVED" 13 "RESERVED" 14 "RESERVED" 15 "Error Indicator" ;
VAL_ 3221225472 PCM_Blwr2SpdFB 0 "On - Level #0 (0% - Off)" 1 "On - Level #1 (10%)" 2 "On - Level #2 (20%)" 3 "On - Level #3 (30%)" 4 "On - Level #4 (40%)" 5 "On - Level #5 (50%)" 6 "On - Level #6 (60%)" 7 "On - Level #7 (70%)" 8 "On - Level #8 (80%)" 9 "On - Level #9 (90%)" 10 "On - Level #10 (Max)" 11 "Off - PCM Function Off" 12 "RESERVED" 13 "RESERVED" 14 "RESERVED" 15 "Error Indicator" ;
VAL_ 3221225472 PCM_Blwr1FailCircuitShrt 0 "Normal" 1 "Circuit Short" ;
VAL_ 3221225472 PCM_Blwr1FailMtrLck 0 "Normal" 1 "Motor Lock" ;
VAL_ 3221225472 PCM_Blwr1FailOverCurrent 0 "Normal" 1 "Over Current" ;
VAL_ 3221225472 PCM_Blwr1FailOverTemp 0 "Normal" 1 "Over Temperature" ;
VAL_ 3221225472 PCM_Blwr1FailUnderVtg 0 "Normal" 1 "Under Voltage" ;
VAL_ 3221225472 PCM_Blwr1FailOverVtg 0 "Normal" 1 "Over Voltage" ;
VAL_ 3221225472 PCM_Blwr2FailCircuitShrt 0 "Normal" 1 "Circuit Short" ;
VAL_ 3221225472 PCM_Blwr2FailMtrLck 0 "Normal" 1 "Motor Lock" ;
VAL_ 3221225472 PCM_ActSpdFB_RPM 15 "Error Indicator" ;
VAL_ 3221225472 PCM_Blwr2FailOverCurrent 0 "Normal" 1 "Over Current" ;
VAL_ 3221225472 PCM_Blwr2FailOverTemp 0 "Normal" 1 "Over Temperature" ;
VAL_ 3221225472 PCM_Blwr2FailUnderVtg 0 "Normal" 1 "Under Voltage" ;
VAL_ 3221225472 PCM_Blwr2FailOverVtg 0 "Normal" 1 "Over Voltage" ;
VAL_ 3221225472 PCM_Cart1Sta 0 "Contacted, Normal" 1 "Contacted, Abnormal(I2C communication error etc.)" 2 "Not-Contacted" 3 "Failure" ;
VAL_ 3221225472 PCM_Cart1GenuinePart 0 "Not Genuine Parts" 1 "Genuine Parts" 2 "Not-Contacted" 3 "Error Indicator" ;
VAL_ 3221225472 PCM_Cart1Kinds 0 "Default" 1 "THE DRIVER'S AWAKENING" 2 "MY FAVOURITE PLACE" 3 "THE CREAT OUTDOORS" 4 "RESERVED" 5 "RESERVED" 6 "RESERVED" 7 "RESERVED" 8 "RESERVED" 9 "RESERVED" 10 "RESERVED" 11 "RESERVED" 12 "New Frangrance Mounted(Genuine cartidge, Not registered new frangrance)" 13 "No Cartridge Mounted" 14 "Unknown Cartridge Mounted (Not Genuine cartidge)" 15 "Error Indicator" ;
VAL_ 3221225472 PCM_Cart2Sta 0 "Contacted, Normal" 1 "Contacted, Abnormal(I2C communication error etc.)" 2 "Not-Contacted" 3 "Failure" ;
VAL_ 3221225472 PCM_Cart2GenuinePart 0 "Not Genuine Parts" 1 "Genuine Parts" 2 "Not-Contacted" 3 "Error Indicator" ;
VAL_ 3221225472 PCM_Cart2Kinds 0 "Default" 1 "THE DRIVER'S AWAKENING" 2 "MY FAVOURITE PLACE" 3 "THE CREAT OUTDOORS" 4 "RESERVED" 5 "RESERVED" 6 "RESERVED" 7 "RESERVED" 8 "RESERVED" 9 "RESERVED" 10 "RESERVED" 11 "RESERVED" 12 "New Frangrance Mounted(Genuine cartidge, Not registered new frangrance)" 13 "No Cartridge Mounted" 14 "Unknown Cartridge Mounted (Not Genuine cartidge)" 15 "Error Indicator" ;
VAL_ 3221225472 PCM_ActSta 0 "Normal Stop" 1 "Normal Moving" 2 "Calibration" 3 "RESERVED" 4 "RESERVED" 5 "RESERVED" 6 "RESERVED" 7 "RESERVED" 8 "RESERVED" 9 "RESERVED" 10 "RESERVED" 11 "RESERVED" 12 "RESERVED" 13 "RESERVED" 14 "RESERVED" 15 "Error Indicator" ;
VAL_ 3221225472 L_2HKBD_RrDrTempClickCnt 0 "RESERVED" 1 "0x01~0x7F:Clockwise" 127 "0x01~0x7F:Clockwise" 128 "0x80~0xFE:Counter Clockwise" 254 "0x80~0xFE:Counter Clockwise" 255 "Invalid" ;
VAL_ 3221225472 L_2HKBD_RrPsTempClickCnt 0 "RESERVED" 1 "0x01~0x7F:Clockwise" 127 "0x01~0x7F:Clockwise" 128 "0x80~0xFE:Counter Clockwise" 254 "0x80~0xFE:Counter Clockwise" 255 "Invalid" ;
VAL_ 3221225472 L_2HKBD_RrPsBlwrClickCnt 0 "RESERVED" 1 "0x01~0x7F:Clockwise" 127 "0x01~0x7F:Clockwise" 128 "0x80~0xFE:Counter Clockwise" 254 "0x80~0xFE:Counter Clockwise" 255 "Invalid" ;
VAL_ 3221225472 L_2HKBD_RrTempKnobCnt 0 "0" 1 "1" 2 "2" 3 "invlaid" ;
VAL_ 3221225472 L_2HKBD_RrBlwKnobCnt 0 "0" 1 "1" 2 "2" 3 "invlaid" ;
VAL_ 3221225472 L_2HKBD_RrDrBlwrClickCnt 0 "RESERVED" 1 "0x01~0x7F:Clockwise" 127 "0x01~0x7F:Clockwise" 128 "0x80~0xFE:Counter Clockwise" 254 "0x80~0xFE:Counter Clockwise" 255 "Invalid" ;
VAL_ 3221225472 L_ATCU_DrTempCDis 0 "Blank Display (Default)" 1 "'LO' Display" 2 "15.0¡É~32.0¡É" 3 "15.0¡É~32.0¡É" 4 "15.0¡É~32.0¡É" 5 "15.0¡É~32.0¡É" 6 "15.0¡É~32.0¡É" 7 "15.0¡É~32.0¡É" 8 "15.0¡É~32.0¡É" 9 "15.0¡É~32.0¡É" 10 "15.0¡É~32.0¡É" 11 "15.0¡É~32.0¡É" 12 "15.0¡É~32.0¡É" 13 "15.0¡É~32.0¡É" 14 "15.0¡É~32.0¡É" 15 "15.0¡É~32.0¡É" 16 "15.0¡É~32.0¡É" 17 "15.0¡É~32.0¡É" 18 "15.0¡É~32.0¡É" 19 "15.0¡É~32.0¡É" 20 "15.0¡É~32.0¡É" 21 "15.0¡É~32.0¡É" 22 "15.0¡É~32.0¡É" 23 "15.0¡É~32.0¡É" 24 "15.0¡É~32.0¡É" 25 "15.0¡É~32.0¡É" 26 "15.0¡É~32.0¡É" 27 "15.0¡É~32.0¡É" 28 "15.0¡É~32.0¡É" 29 "15.0¡É~32.0¡É" 30 "15.0¡É~32.0¡É" 31 "15.0¡É~32.0¡É" 32 "15.0¡É~32.0¡É" 33 "15.0¡É~32.0¡É" 34 "15.0¡É~32.0¡É" 35 "15.0¡É~32.0¡É" 36 "15.0¡É~32.0¡É" 37 "0x25~0xFD:RESERVED" 253 "0x25~0xFD:RESERVED" 254 "'HI' Display" 255 "Error Indicator" ;
VAL_ 3221225472 L_ATCU_DrTempFDis 0 "Blank Display(Default)" 1 "'LO' Display" 2 "58¢µ~92¢µ" 3 "58¢µ~92¢µ" 4 "58¢µ~92¢µ" 5 "58¢µ~92¢µ" 6 "58¢µ~92¢µ" 7 "58¢µ~92¢µ" 8 "58¢µ~92¢µ" 9 "58¢µ~92¢µ" 10 "58¢µ~92¢µ" 11 "58¢µ~92¢µ" 12 "58¢µ~92¢µ" 13 "58¢µ~92¢µ" 14 "58¢µ~92¢µ" 15 "58¢µ~92¢µ" 16 "58¢µ~92¢µ" 17 "58¢µ~92¢µ" 18 "58¢µ~92¢µ" 19 "58¢µ~92¢µ" 20 "58¢µ~92¢µ" 21 "58¢µ~92¢µ" 22 "58¢µ~92¢µ" 23 "58¢µ~92¢µ" 24 "58¢µ~92¢µ" 25 "58¢µ~92¢µ" 26 "58¢µ~92¢µ" 27 "58¢µ~92¢µ" 28 "58¢µ~92¢µ" 29 "58¢µ~92¢µ" 30 "58¢µ~92¢µ" 31 "58¢µ~92¢µ" 32 "58¢µ~92¢µ" 33 "58¢µ~92¢µ" 34 "58¢µ~92¢µ" 35 "58¢µ~92¢µ" 36 "58¢µ~92¢µ" 37 "0x25~0xFD:RESERVED" 253 "0x25~0xFD:RESERVED" 254 "'HI' Display" 255 "Error Indicator" ;
VAL_ 3221225472 L_ATCU_PassTempFDis 0 "Blank Display(Default)" 1 "'LO' Display" 2 "58¢µ~92¢µ" 3 "58¢µ~92¢µ" 4 "58¢µ~92¢µ" 5 "58¢µ~92¢µ" 6 "58¢µ~92¢µ" 7 "58¢µ~92¢µ" 8 "58¢µ~92¢µ" 9 "58¢µ~92¢µ" 10 "58¢µ~92¢µ" 11 "58¢µ~92¢µ" 12 "58¢µ~92¢µ" 13 "58¢µ~92¢µ" 14 "58¢µ~92¢µ" 15 "58¢µ~92¢µ" 16 "58¢µ~92¢µ" 17 "58¢µ~92¢µ" 18 "58¢µ~92¢µ" 19 "58¢µ~92¢µ" 20 "58¢µ~92¢µ" 21 "58¢µ~92¢µ" 22 "58¢µ~92¢µ" 23 "58¢µ~92¢µ" 24 "58¢µ~92¢µ" 25 "58¢µ~92¢µ" 26 "58¢µ~92¢µ" 27 "58¢µ~92¢µ" 28 "58¢µ~92¢µ" 29 "58¢µ~92¢µ" 30 "58¢µ~92¢µ" 31 "58¢µ~92¢µ" 32 "58¢µ~92¢µ" 33 "58¢µ~92¢µ" 34 "58¢µ~92¢µ" 35 "58¢µ~92¢µ" 36 "58¢µ~92¢µ" 37 "0x25~0xFD:RESERVED" 253 "0x25~0xFD:RESERVED" 254 "'HI' Display" 255 "Error Indicator" ;
VAL_ 3221225472 L_ATCU_FrDrModDis 0 "Off(Blank Display, Vent mode not Display ex) Auto(Default)" 1 "VENT" 2 "B_L" 3 "FLOOR" 4 "MIX (7 MODE DEF FLOOR)" 5 "DEF (MAX DEF)" 6 "AUTO DEFOG" 7 "7 MODE DEF VENT" 8 "MODE AUTO" 9 "7 MODE DEF VENT FLOOR" 10 "7 MODE DEF" 11 "DEF VENT (Arrow)" 12 "DEF FLOOR (Arrow)" 13 "DEF VENT FLOOR (Arrow)" 14 "DEF (Arrow)" 15 "Error Indicator" ;
VAL_ 3221225472 L_ATCU_FrPassModDis 0 "Off(Blank Display, Vent mode not Display ex) Auto(Default)" 1 "VENT" 2 "B_L" 3 "FLOOR" 4 "MIX (7 MODE DEF FLOOR)" 5 "DEF (MAX DEF)" 6 "AUTO DEFOG" 7 "7 MODE DEF VENT" 8 "MODE AUTO" 9 "7 MODE DEF VENT FLOOR" 10 "7 MODE DEF" 11 "DEF VENT (Arrow)" 12 "DEF FLOOR (Arrow)" 13 "DEF VENT FLOOR (Arrow)" 14 "DEF (Arrow)" 15 "Error Indicator" ;
VAL_ 3221225472 L_ATCU_FrDrBlwDis 0 "OFF(System Off)" 1 "Blank Display(No Blower level display, ex)Auto" 2 "1 Level" 3 "2 Level" 4 "3 Level" 5 "4 Level" 6 "5 Level" 7 "6 Level" 8 "7 Level" 9 "8 Level" 10 "Not used" 11 "Not used" 12 "Not used" 13 "Not used" 14 "Not used" 15 "Error Indicator" ;
VAL_ 3221225472 L_ATCU_FrPassBlwDis 0 "OFF(System Off)" 1 "Blank Display(No Blower level display, ex)Auto" 2 "1 Level" 3 "2 Level" 4 "3 Level" 5 "4 Level" 6 "5 Level" 7 "6 Level" 8 "7 Level" 9 "8 Level" 10 "Not used" 11 "Not used" 12 "Not used" 13 "Not used" 14 "Not used" 15 "Error Indicator" ;
VAL_ 3221225472 L_ATCU_DrAutoDis 0 "DrAUTO Off" 1 "DrAUTO On" 2 "Not used" 3 "Error Indicator" ;
VAL_ 3221225472 L_ATCU_PassAutoDis 0 "PsAUTO Off" 1 "PsAUTO On" 2 "Not used" 3 "Error Indicator" ;
VAL_ 3221225472 L_ATCU_DrMultiAutoBlwDis 0 "MultiAutoBlr Display Off" 1 "Multi Auto Blower Low" 2 "Multi Auto Blower Mid" 3 "Multi Auto Blower High" ;
VAL_ 3221225472 L_ATCU_PassMultiAutoBlwDis 0 "MultiAutoBlr Display Off" 1 "Multi Auto Blower Low" 2 "Multi Auto Blower Mid" 3 "Multi Auto Blower High" ;
VAL_ 3221225472 L_ATCU_AcDis 0 "A/C Off" 1 "A/C ON" 2 "Not used" 3 "Error Indicator" ;
VAL_ 3221225472 L_ATCU_IntakeDis 0 "Default" 1 "REC (Fresh off)" 2 "FRE (REC off)" 3 "Error Indicator" ;
VAL_ 3221225472 L_ATCU_SyncDis 0 "SYNC Off" 1 "SYNC On" 2 "Not used" 3 "Error Indicator" ;
VAL_ 3221225472 L_ATCU_FrDefDis 0 "Front Def Off" 1 "Front Def On" 2 "Not used" 3 "Error Indicator" ;
VAL_ 3221225472 L_ATCU_PassTempCDis 0 "Blank Display (Default)" 1 "'LO' Display" 2 "15.0¡É~32.0¡É" 3 "15.0¡É~32.0¡É" 4 "15.0¡É~32.0¡É" 5 "15.0¡É~32.0¡É" 6 "15.0¡É~32.0¡É" 7 "15.0¡É~32.0¡É" 8 "15.0¡É~32.0¡É" 9 "15.0¡É~32.0¡É" 10 "15.0¡É~32.0¡É" 11 "15.0¡É~32.0¡É" 12 "15.0¡É~32.0¡É" 13 "15.0¡É~32.0¡É" 14 "15.0¡É~32.0¡É" 15 "15.0¡É~32.0¡É" 16 "15.0¡É~32.0¡É" 17 "15.0¡É~32.0¡É" 18 "15.0¡É~32.0¡É" 19 "15.0¡É~32.0¡É" 20 "15.0¡É~32.0¡É" 21 "15.0¡É~32.0¡É" 22 "15.0¡É~32.0¡É" 23 "15.0¡É~32.0¡É" 24 "15.0¡É~32.0¡É" 25 "15.0¡É~32.0¡É" 26 "15.0¡É~32.0¡É" 27 "15.0¡É~32.0¡É" 28 "15.0¡É~32.0¡É" 29 "15.0¡É~32.0¡É" 30 "15.0¡É~32.0¡É" 31 "15.0¡É~32.0¡É" 32 "15.0¡É~32.0¡É" 33 "15.0¡É~32.0¡É" 34 "15.0¡É~32.0¡É" 35 "15.0¡É~32.0¡É" 36 "15.0¡É~32.0¡É" 37 "0x25~0xFD:RESERVED" 253 "0x25~0xFD:RESERVED" 254 "'HI' Display" 255 "Error Indicator" ;
VAL_ 3221225472 L_ATCU_DrOnlyDis 0 "Initial (Dual Temp Display)" 1 "Driver Only Status (Only Display Driver Temp)" 2 "Not used" 3 "Error Indicator" ;
VAL_ 3221225472 L_ATCU_SmrtVntDis 0 "Off" 1 "Smart Ventilation" 2 "Smart CO2" 3 "Error Indicator" ;
VAL_ 3221225472 L_ATCU_FrWndShldHtInd 0 "Off" 1 "On" 2 "RESERVED" ;
VAL_ 3221225472 L_ATCU_SchedClimate_EnIndSta 0 "Reservation not set" 1 "Reservation set" ;
VAL_ 3221225472 L_ATCU_LanguageInfo 0 "Off" 1 "Korea" 2 "English(US)" 3 "English(UK)" 4 "Simplified chinese" 5 "Traditional chinese" 6 "French(EU)" 7 "Spanish(EU)" 8 "Arabic" 9 "Czech" 10 "Danish" 11 "German" 12 "Italian" 13 "Dutch" 14 "Polish" 15 "Portuguese" 16 "Russain" 17 "Slovak" 18 "Swedish" 19 "Turkish" 20 "French(US)" 21 "Spanish(US)" 22 "English(India)" 23 "Norwegian" 24 "Finnish" 25 "Indonesian" 26 "Brazilian Portuguese" 27 "Malay" 28 "Hungarian" 29 "English (Australia)" 30 "Japanese" 31 "Hindi" 32 "Hebrew" 33 "Greek" 34 "Ukrainian" 35 "Slovenian" 36 "Bulgarian" 37 "Croatian" 38 "Romanian" 39 "Bengali" 40 "Marathi" 41 "Telugu" 42 "Tamil" 43 "Gujarati" 44 "Kannada" 45 "Odia" 46 "Malayalam" 47 "Punjabi" 48 "Thai" 49 "Tagalog" 50 "Vietnamese" 51 "0x33~0xFE:RESERVED" 254 "0x33~0xFE:RESERVED" 255 "Invalid" ;
VAL_ 3221225472 L_ATCU_RrDefInd 0 "OFF" 1 "ON" ;
VAL_ 3221225472 L_ATCU_AftBlwInfo 0 "Default" 1 "AfterBlower Waiting" 2 "AfterBlower Operating(Symbol Off)" 3 "AfterBlower Operating(Symbol On)" ;
VAL_ 3221225472 L_ATCU_Reserve_Venti_Indi 0 "OFF" 1 "ON" ;
VAL_ 3221225472 L_ATCU_IncarMtrOnReq 0 "OFF" 1 "ON" ;
VAL_ 3221225472 L_ATCU_FLStHeatSwHInd 0 "OFF" 1 "ON" ;
VAL_ 3221225472 L_ATCU_FLStHeatSwMInd 0 "OFF" 1 "ON" ;
VAL_ 3221225472 L_ATCU_ADSBlinkDis 0 "AutoDefogBlink Non Request" 1 "AutoDefogBlink Request" 2 "Not used" 3 "Error Indicator" ;
VAL_ 3221225472 L_ATCU_FLStHeatSwLInd 0 "OFF" 1 "ON" ;
VAL_ 3221225472 L_ATCU_FLStVntSwHInd 0 "OFF" 1 "ON" ;
VAL_ 3221225472 L_ATCU_FLStVntSwMInd 0 "OFF" 1 "ON" ;
VAL_ 3221225472 L_ATCU_FLStVntSwLInd 0 "OFF" 1 "ON" ;
VAL_ 3221225472 L_ATCU_FRStHeatSwHInd 0 "OFF" 1 "ON" ;
VAL_ 3221225472 L_ATCU_FRStHeatSwMInd 0 "OFF" 1 "ON" ;
VAL_ 3221225472 L_ATCU_FRStHeatSwLInd 0 "OFF" 1 "ON" ;
VAL_ 3221225472 L_ATCU_FRStVntSwHInd 0 "OFF" 1 "ON" ;
VAL_ 3221225472 L_ATCU_FRStVntSwMInd 0 "OFF" 1 "ON" ;
VAL_ 3221225472 L_ATCU_FRStVntSwLInd 0 "OFF" 1 "ON" ;
VAL_ 3221225472 L_ATCU_StrWhlHeatInd 0 "OFF" 1 "Step1" 2 "Step2" 3 "RESERVED" ;
VAL_ 3221225472 L_ATCU_RhstaLvlSta 0 "RESERVED" 1 "Step1" 2 "Step2" 3 "Step 3" 4 "Step 4" 5 "Step5" 6 "Step 6" 7 "Step 7" 8 "Step8" 9 "Step 9" 10 "Step 10" 11 "Step11" 12 "Step 12" 13 "Step 13" 14 "Step14" 15 "Step 15" 16 "Step 16" 17 "Step17" 18 "Step 18" 19 "Step 19" 20 "Step 20 (Max)" ;
VAL_ 3221225472 L_ATCU_IntTailOnOff 0 "OFF" 1 "ON" ;
VAL_ 3221225472 L_ATCU_AutoLightSta 0 "Off (not Night)" 1 "Night" ;
VAL_ 3221225472 L_ATCU_FrBckLightSta 0 "OFF" 1 "ON" ;
VAL_ 3221225472 L_ATCU_ADSOffDis 0 "'ADS OFF' display Off" 1 "'ADS OFF' display On" 2 "Not Used(Non-ADS)" 3 "Error Indicator" ;
VAL_ 3221225472 L_ATCU_DisplayTheme 0 "Default" 1 "White Theme" 2 "Black Theme" 3 "Invalid" ;
VAL_ 3221225472 L_ATCU_GUIBlankDis 0 "Default" 1 "GUI Blank Display" ;
VAL_ 3221225472 L_ATCU_HptFdbckLvl 0 "Default" 1 "off" 2 "Level 1" 3 "Level 2" 4 "Level 3" 5 "Level 4" 6 "Level 5" 7 "RESERVED" 8 "RESERVED" 9 "RESERVED" 10 "RESERVED" 11 "RESERVED" 12 "RESERVED" 13 "RESERVED" 14 "RESERVED" 15 "Invalid" ;
VAL_ 3221225472 L_ATCU_TlltLmpDis 0 "ON Lamp off OFF Lamp off" 1 "ON Lamp off OFF Lamp on" 2 "ON Lamp on Off Lamp off" 3 "ON Lamp on OFF Lamp on" 4 "RESERVED" 5 "RESERVED" 6 "RESERVED" 7 "Error Indicator" ;
VAL_ 3221225472 L_ATCU_AvTailOnOff 0 "OFF" 1 "ON" ;
VAL_ 3221225472 L_ATCU_AirClnDis 0 "AirClean Off" 1 "AirClean On" 2 "Not used" 3 "Error Indicator" ;
VAL_ 3221225472 L_ATCU_CO2WrngDis 0 "Co2 Warning Off" 1 "Co2 Warning On" 2 "Not used" 3 "Error Indicator" ;
VAL_ 3221225472 L_2HKBD_RrDrModeDnSw 0 "Off" 1 "On" ;
VAL_ 3221225472 L_2HKBD_RrDrModeUpSw 0 "Off" 1 "On" ;
VAL_ 3221225472 L_2HKBD_RrDrAutoSw 0 "Off" 1 "On" ;
VAL_ 3221225472 L_2HKBD_Rr_OffSw 0 "Off" 1 "On" ;
VAL_ 3221225472 L_2HKBD_RrSyncSw 0 "Off" 1 "On" ;
VAL_ 3221225472 L_2HKBD_RrAcSw 0 "Off" 1 "On" ;
VAL_ 3221225472 L_2HKBD_RLStHtrSwReq 0 "Off" 1 "On" ;
VAL_ 3221225472 L_2HKBD_RLStVentSwReq 0 "Off" 1 "On" ;
VAL_ 3221225472 L_2HKBD_RRStHtrSwReq 0 "Off" 1 "On" ;
VAL_ 3221225472 L_2HKBD_RRStVentSwReq 0 "Off" 1 "On" ;
VAL_ 3221225472 L_2HKBD_RrDrMultiAutoSw 0 "Reserved" 1 "Low" 2 "Medium" 3 "High" 4 "Reserved" 5 "Reserved" 6 "Reserved" 7 "Invalid" ;
VAL_ 3221225472 L_2HKBD_RrDrModeSw 0 "Off" 1 "On" ;
VAL_ 3221225472 L_2HKBD_RrPsModeSw 0 "Off" 1 "On" ;
VAL_ 3221225472 L_2HKBD_RrPsModeDnSw 0 "Off" 1 "On" ;
VAL_ 3221225472 L_2HKBD_RrPsModeUpSw 0 "Off" 1 "On" ;
VAL_ 3221225472 L_2HKBD_RrPsModeVentSw 0 "Off" 1 "On" ;
VAL_ 3221225472 L_2HKBD_RrPsModeFloorSw 0 "Off" 1 "On" ;
VAL_ 3221225472 L_2HKBD_RrPsModeBiLvlSw 0 "Off" 1 "On" ;
VAL_ 3221225472 L_2HKBD_RrPsTempDnSw 0 "Off" 1 "On" ;
VAL_ 3221225472 L_2HKBD_RrPsTempUpSw 0 "Off" 1 "On" ;
VAL_ 3221225472 L_2HKBD_RrPsBlwUpSw 0 "Off" 1 "On" ;
VAL_ 3221225472 L_2HKBD_RrDRModeVentSw 0 "Off" 1 "On" ;
VAL_ 3221225472 L_2HKBD_RrPsBlwDnSw 0 "Off" 1 "On" ;
VAL_ 3221225472 L_2HKBD_RrPsAutoSw 0 "Off" 1 "On" ;
VAL_ 3221225472 L_2HKBD_RrPsMultiAutoSw 0 "Reserved" 1 "Low" 2 "Medium" 3 "High" 4 "Reserved" 5 "Reserved" 6 "Reserved" 7 "Invalid" ;
VAL_ 3221225472 L_2HKBD_RrDrBlwDnOffSw 0 "Off" 1 "On" ;
VAL_ 3221225472 L_2HKBD_RrPsBlwDnOffSw 0 "Off" 1 "On" ;
VAL_ 3221225472 L_2HKBD_RrOnOffSet 0 "Default" 1 "On" 2 "Off" 3 "Invalid" ;
VAL_ 3221225472 L_2HKBD_RrDrModeFloorSw 0 "Off" 1 "On" ;
